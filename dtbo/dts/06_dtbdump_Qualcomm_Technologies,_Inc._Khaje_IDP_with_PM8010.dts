/dts-v1/;

/ {
	model = "Qualcomm Technologies, Inc. Khaje IDP with PM8010";
	compatible = "qcom,khaje-idp\0qcom,khaje\0qcom,idp";
	qcom,msm-id = <0x24a 0x10000 0x206 0x10000>;
	qcom,board-id = <0x10222 0x00>;
	qcom,pmic-id = <0x2d 0x2e 0x00 0x00>;

	fragment@0 {
		target = <0xffffffff>;

		__overlay__ {

			pm6125-tz {

				cooling-maps {

					trip0_cpu0 {
						trip = <0xffffffff>;
						cooling-device = <0xffffffff 0x07 0x07>;
					};

					trip0_cpu4 {
						trip = <0xffffffff>;
						cooling-device = <0xffffffff 0x06 0xffffffff>;
					};

					trip1_cpu1 {
						trip = <0xffffffff>;
						cooling-device = <0xffffffff 0x01 0x01>;
					};

					trip1_cpu2 {
						trip = <0xffffffff>;
						cooling-device = <0xffffffff 0x01 0x01>;
					};

					trip1_cpu3 {
						trip = <0xffffffff>;
						cooling-device = <0xffffffff 0x01 0x01>;
					};

					trip1_cpu4 {
						trip = <0xffffffff>;
						cooling-device = <0xffffffff 0x01 0x01>;
					};

					trip1_cpu5 {
						trip = <0xffffffff>;
						cooling-device = <0xffffffff 0x01 0x01>;
					};

					trip1_cpu6 {
						trip = <0xffffffff>;
						cooling-device = <0xffffffff 0x01 0x01>;
					};

					trip1_cpu7 {
						trip = <0xffffffff>;
						cooling-device = <0xffffffff 0x01 0x01>;
					};
				};
			};
		};
	};

	fragment@1 {
		target = <0xffffffff>;

		__overlay__ {

			fingerprint_xiaomi {
				compatible = "xiaomi,xiaomi-fp";
				xiaomi,gpio_irq = <0xffffffff 0x53 0x00>;
				vfp-supply = <0xffffffff>;
				netlink-event = <0x1d>;
				fp-gpio-pwr = <0xffffffff 0x41 0x00>;
				pinctrl-names = "reset_high\0reset_low\0eint_default\0eint_pulldown\0pwr_high\0pwr_low";
				pinctrl-0 = <0x01>;
				pinctrl-1 = <0x02>;
				pinctrl-2 = <0x03>;
				pinctrl-3 = <0x04>;
				pinctrl-4 = <0x05>;
				pinctrl-5 = <0x06>;
				status = "okay";
			};
		};
	};

	fragment@2 {
		target = <0xffffffff>;

		__overlay__ {

			fingerprints_reset_high {
				phandle = <0x01>;

				mux {
					pins = "gpio104";
					function = "gpio";
				};

				config {
					pins = "gpio104";
					drive-strength = <0x02>;
					bias-disable;
					output-high;
				};
			};

			fingerprints_reset_low {
				phandle = <0x02>;

				mux {
					pins = "gpio104";
					function = "gpio";
				};

				config {
					pins = "gpio104";
					drive-strength = <0x02>;
					bias-disable;
					output-low;
				};
			};

			fingerprints_eint_default {
				phandle = <0x03>;

				mux {
					pins = "gpio83";
					function = "gpio";
				};

				config {
					pins = "gpio83";
					drive-strength = <0x02>;
					bias-disable;
				};
			};

			fingerprints_eint_pulldown {
				phandle = <0x04>;

				mux {
					pins = "gpio83";
					function = "gpio";
				};

				config {
					pins = "gpio83";
					drive-strength = <0x02>;
					bias-pull-down;
				};
			};

			fingerprints_pwr_high {
				phandle = <0x05>;

				mux {
					pins = "gpio65";
					function = "gpio";
				};

				config {
					pins = "gpio65";
					drive-strength = <0x02>;
					bias-disable;
					output-high;
				};
			};

			fingerprints_pwr_low {
				phandle = <0x06>;

				mux {
					pins = "gpio65";
					function = "gpio";
				};

				config {
					pins = "gpio65";
					drive-strength = <0x02>;
					bias-disable;
					output-high;
				};
			};
		};
	};

	fragment@3 {
		target = <0xffffffff>;

		__overlay__ {
			pinctrl-0 = <0xffffffff 0xffffffff 0x07>;

			rf_pa1_therm {
				reg = <0x55>;
				label = "rf_pa1_therm";
				qcom,ratiometric;
				qcom,hw-settle-time = <0xc8>;
				qcom,pre-scaling = <0x01 0x01>;
			};
		};
	};

	fragment@4 {
		target = <0xffffffff>;

		__overlay__ {
			status = "ok";

			rf_pa1_therm {
				reg = <0x03>;
				io-channels = <0xffffffff 0x55>;
				qcom,ratiometric;
				qcom,hw-settle-time-us = <0xc8>;
			};
		};
	};

	fragment@5 {
		target = <0xffffffff>;

		__overlay__ {

			rf-pa1-therm-usr {
				polling-delay-passive = <0x00>;
				polling-delay = <0x00>;
				thermal-governor = "user_space";
				thermal-sensors = <0xffffffff 0x03>;
				wake-capable-sensor;

				trips {

					active-config0 {
						temperature = <0x1e848>;
						hysteresis = <0x3e8>;
						type = "passive";
					};
				};
			};
		};
	};

	fragment@6 {
		target = <0xffffffff>;

		__overlay__ {

			oled_vci {

				oled_vci_default {
					pins = "gpio9";
					function = "normal";
					input-disable;
					power-source = <0x00>;
					bias-disable;
					output-high;
					qcom,drive-strength = <0x02>;
					phandle = <0x0b>;
				};

				oled_vci_suspend {
					pins = "gpio9";
					function = "normal";
					input-disable;
					power-source = <0x00>;
					bias-disable;
					output-low;
					qcom,drive-strength = <0x02>;
					phandle = <0x0c>;
				};
			};

			cam_avdd1 {

				cam_sensor_avdd1_default {
					pins = "gpio2";
					function = "normal";
					bias-disable;
					power-source = <0x00>;
					qcom,drive-strength = <0x02>;
					phandle = <0x0d>;
				};

				cam_sensor_avdd1_suspend {
					pins = "gpio2";
					function = "normal";
					output-low;
					bias-disable;
					power-source = <0x00>;
					qcom,drive-strength = <0x02>;
					phandle = <0x0e>;
				};
			};

			flash {

				flash_default {
					pins = "gpio8";
					function = "normal";
					output-high;
					bias-pull-up;
					power-source = <0x01>;
					qcom,drive-strength = <0x02>;
					phandle = <0x0f>;
				};

				flash_suspend {
					pins = "gpio8";
					function = "normal";
					output-low;
					bias-disable;
					power-source = <0x01>;
					qcom,drive-strength = <0x02>;
					phandle = <0x10>;
				};
			};

			rf_pa1_therm {

				rf_pa1_therm_default {
					pins = "gpio7";
					bias-high-impedance;
					phandle = <0x07>;
				};
			};

			key_vol_up {

				key_vol_up_default {
					pins = "gpio5";
					function = "normal";
					input-enable;
					bias-pull-up;
					power-source = <0x00>;
					phandle = <0x08>;
				};
			};

			eldo9_pin {

				gpio@c000 {
					pins = "gpio1";
					function = "normal";
					qcom,drive-strength = <0x02>;
					power-source = <0x00>;
					bias-disable;
					output-high;
					phandle = <0x09>;
				};
			};
		};
	};

	fragment@7 {
		target = <0xffffffff>;

		__overlay__ {

			gpio_keys {
				compatible = "gpio-keys";
				label = "gpio-keys";
				pinctrl-names = "default";
				pinctrl-0 = <0x08>;

				vol_up {
					label = "volume_up";
					gpios = <0xffffffff 0x05 0x01>;
					linux,input-type = <0x01>;
					linux,code = <0x73>;
					linux,can-disable;
					debounce-interval = <0x0f>;
					gpio-key,wakeup;
				};
			};

			ant_check {
				compatible = "ant_check";
				interrupt-parent = <0xffffffff>;
				ant_check_gpio = <0xffffffff 0x6b 0x00>;
				pinctrl-names = "default";
				pinctrl-0 = <0xffffffff>;
			};

			ant_check_div {
				compatible = "ant_check_div";
				interrupt-parent = <0xffffffff>;
				ant_check_div_gpio = <0xffffffff 0x19 0x00>;
				pinctrl-names = "default";
				pinctrl-0 = <0xffffffff>;
			};

			vdda_usb_ss_dp_core {
				compatible = "regulator-fixed";
				regulator-name = "vdd_supply";
				regulator-min-microvolt = <0xd6d80>;
				regulator-max-microvolt = <0xd6d80>;
				enable-active-high;
				gpio = <0xffffffff 0x01 0x00>;
				pinctrl-names = "default";
				pinctrl-0 = <0x09>;
				phandle = <0x0a>;
			};
		};
	};

	fragment@8 {
		target = <0xffffffff>;

		__overlay__ {
			vdd-supply = <0x0a>;
		};
	};

	fragment@9 {
		target = <0xffffffff>;

		__overlay__ {
			vdd-supply = <0xffffffff>;
			qcom,vdd-voltage-level = <0x2d2a80 0x2d2a80>;
			qcom,vdd-current-level = <0x00 0x8b290>;
			vdd-io-supply = <0xffffffff>;
			qcom,vdd-io-always-on;
			qcom,vdd-io-lpm-sup;
			qcom,vdd-io-voltage-level = <0x1b7740 0x1b7740>;
			qcom,vdd-io-current-level = <0x00 0x4f588>;
			pinctrl-names = "default\0sleep";
			pinctrl-0 = <0xffffffff>;
			pinctrl-1 = <0xffffffff>;
			status = "ok";
		};
	};

	fragment@10 {
		target = <0xffffffff>;

		__overlay__ {
			vdd-supply = <0xffffffff>;
			qcom,vdd-voltage-level = <0x2d2a80 0x2d2a80>;
			qcom,vdd-current-level = <0x00 0xc3500>;
			vdd-io-supply = <0xffffffff>;
			qcom,vdd-io-voltage-level = <0x1b7740 0x2d2a80>;
			qcom,vdd-io-current-level = <0x00 0x55f0>;
			vdd-io-bias-supply = <0xffffffff>;
			qcom,vdd-io-bias-voltage-level = <0x132a40 0x132a40>;
			qcom,vdd-io-bias-current-level = <0x00 0x1770>;
			pinctrl-names = "default\0sleep";
			pinctrl-0 = <0xffffffff>;
			pinctrl-1 = <0xffffffff>;
			cd-gpios = <0xffffffff 0x58 0x01>;
			status = "ok";
		};
	};

	fragment@11 {
		target = <0xffffffff>;

		__overlay__ {
			compatible = "qcom,ufs-phy-qmp-v4-khaje";
			vdda-phy-supply = <0xffffffff>;
			vdda-pll-supply = <0xffffffff>;
			vdda-phy-max-microamp = <0x14ec4>;
			vdda-pll-max-microamp = <0x477c>;
			status = "ok";
		};
	};

	fragment@12 {
		target = <0xffffffff>;

		__overlay__ {
			vdd-hba-supply = <0xffffffff>;
			vdd-hba-fixed-regulator;
			vcc-supply = <0xffffffff>;
			vcc-max-microamp = "\0\f5";
			vccq2-supply = <0xffffffff>;
			vccq2-max-microamp = "\0\f5";
			qcom,vddp-ref-clk-supply = <0xffffffff>;
			qcom,vddp-ref-clk-max-microamp = <0x64>;
			reset-gpios = <0xffffffff 0x71 0x01>;
			resets = <0xffffffff 0x04>;
			reset-names = "rst";
			status = "ok";
		};
	};

	fragment@13 {
		target = <0xffffffff>;

		__overlay__ {
			status = "ok";
		};
	};

	fragment@14 {
		target = <0xffffffff>;

		__overlay__ {
			status = "okay";
			qcom,i2c-touch-active = "synaptics,tcm-i2c";

			synaptics_tcm@20 {
				compatible = "synaptics,tcm-i2c";
				reg = <0x20>;
				interrupt-parent = <0xffffffff>;
				interrupts = <0x50 0x2008>;
				pinctrl-names = "pmx_ts_active\0pmx_ts_suspend\0pmx_ts_release";
				pinctrl-0 = <0xffffffff 0xffffffff>;
				pinctrl-1 = <0xffffffff 0xffffffff>;
				pinctrl-2 = <0xffffffff>;
				synaptics,irq-gpio = <0xffffffff 0x50 0x2008>;
				synaptics,irq-on-state = <0x00>;
				synaptics,reset-gpio = <0xffffffff 0x56 0x00>;
				synaptics,reset-on-state = <0x00>;
				synaptics,reset-active-ms = <0x14>;
				synaptics,reset-delay-ms = <0xc8>;
				synaptics,power-delay-ms = <0xc8>;
				synaptics,ubl-i2c-addr = <0x20>;
				synaptics,extend_report;
				synaptics,firmware-name = "synaptics_firmware_k.img";
			};

			novatek@62 {
				reg = <0x62>;
				status = "ok";
				interrupt-parent = <0xffffffff>;
				interrupts = <0x50 0x2008>;
				pinctrl-names = "pmx_ts_active\0pmx_ts_suspend\0pmx_ts_release";
				pinctrl-0 = <0xffffffff 0xffffffff>;
				pinctrl-1 = <0xffffffff 0xffffffff>;
				pinctrl-2 = <0xffffffff>;
				novatek,reset-gpio = <0xffffffff 0x56 0x00>;
				novatek,irq-gpio = <0xffffffff 0x50 0x2008>;
			};
		};
	};

	fragment@15 {
		target = <0xffffffff>;

		__overlay__ {
		};
	};

	fragment@16 {
		target = <0xffffffff>;

		__overlay__ {
			compatible = "qcom,pm8010-regulator";
		};
	};

	fragment@17 {
		target = <0xffffffff>;

		__overlay__ {
			qcom,min-dropout-voltage = <0x9c40>;
		};
	};

	fragment@18 {
		target = <0xffffffff>;

		__overlay__ {
			qcom,min-dropout-voltage = <0xfa00>;
		};
	};

	fragment@19 {
		target = <0xffffffff>;

		__overlay__ {
			qcom,min-dropout-voltage = <0x17700>;
		};
	};

	fragment@20 {
		target = <0xffffffff>;

		__overlay__ {
			qcom,min-dropout-voltage = <0x21340>;
		};
	};

	fragment@21 {
		target = <0xffffffff>;

		__overlay__ {
			qcom,min-dropout-voltage = <0x2af80>;
		};
	};

	fragment@22 {
		target = <0xffffffff>;

		__overlay__ {
			qcom,min-dropout-voltage = <0x29040>;
		};
	};

	fragment@23 {
		target = <0xffffffff>;

		__overlay__ {
			qcom,min-dropout-voltage = <0x13880>;
		};
	};

	__symbols__ {
		clock_audio_va_2 = "/fragment@27/__overlay__/va_npl_clk";
		clock_audio_va_1 = "/fragment@27/__overlay__/va_core_clk";
		clock_audio_tx_2 = "/fragment@27/__overlay__/tx_npl_clk";
		clock_audio_tx_1 = "/fragment@27/__overlay__/tx_core_clk";
		clock_audio_rx_2 = "/fragment@27/__overlay__/rx_npl_clk";
		clock_audio_rx_1 = "/fragment@27/__overlay__/rx_core_clk";
		wsa881x_analog_clk = "/fragment@27/__overlay__/wsa_ana_clk";
		wsa881x_analog_reset_gpio = "/fragment@27/__overlay__/msm_cdc_pinctrl@106";
		wcd937x_rst_gpio = "/fragment@27/__overlay__/msm_cdc_pinctrl@92";
		wsa881x_i2c_44 = "/fragment@26/__overlay__/wsa881x-i2c-codec@44";
		wsa881x_i2c_e = "/fragment@26/__overlay__/wsa881x-i2c-codec@e";
		cdc_sec_mi2s_gpios = "/fragment@25/__overlay__/sec_mi2s_pinctrl";
		cdc_pri_mi2s_gpios = "/fragment@25/__overlay__/pri_mi2s_pinctrl";
		bengal_snd = "/fragment@25/__overlay__/sound";
		wcd937x_codec = "/fragment@24/__overlay__/wcd937x-codec";
		wcd937x_tx_slave = "/fragment@24/__overlay__/va-macro@a730000/va_swr_master/wcd937x-tx-slave";
		swr0 = "/fragment@24/__overlay__/va-macro@a730000/va_swr_master";
		va_macro = "/fragment@24/__overlay__/va-macro@a730000";
		wcd937x_rx_slave = "/fragment@24/__overlay__/rx-macro@a600000/rx_swr_master/wcd937x-rx-slave";
		swr1 = "/fragment@24/__overlay__/rx-macro@a600000/rx_swr_master";
		rx_macro = "/fragment@24/__overlay__/rx-macro@a600000";
		tx_macro = "/fragment@24/__overlay__/tx-macro@a620000";
		fingerprints_reset_high = "/fragment@2/__overlay__/fingerprints_reset_high";
		fingerprints_reset_low = "/fragment@2/__overlay__/fingerprints_reset_low";
		fingerprints_eint_default = "/fragment@2/__overlay__/fingerprints_eint_default";
		fingerprints_eint_pulldown = "/fragment@2/__overlay__/fingerprints_eint_pulldown";
		fingerprints_pwr_high = "/fragment@2/__overlay__/fingerprints_pwr_high";
		fingerprints_pwr_low = "/fragment@2/__overlay__/fingerprints_pwr_low";
		oled_vci_default = "/fragment@6/__overlay__/oled_vci/oled_vci_default";
		oled_vci_suspend = "/fragment@6/__overlay__/oled_vci/oled_vci_suspend";
		cam_sensor_avdd1_default = "/fragment@6/__overlay__/cam_avdd1/cam_sensor_avdd1_default";
		cam_sensor_avdd1_suspend = "/fragment@6/__overlay__/cam_avdd1/cam_sensor_avdd1_suspend";
		flash_default = "/fragment@6/__overlay__/flash/flash_default";
		flash_suspend = "/fragment@6/__overlay__/flash/flash_suspend";
		rf_pa1_therm_default = "/fragment@6/__overlay__/rf_pa1_therm/rf_pa1_therm_default";
		key_vol_up_default = "/fragment@6/__overlay__/key_vol_up/key_vol_up_default";
		usb_eldo9 = "/fragment@6/__overlay__/eldo9_pin/gpio@c000";
		vdda_usb_ss_dp_core = "/fragment@7/__overlay__/vdda_usb_ss_dp_core";
	};

	__fixups__ {
		adsp_loader = "/fragment@28:target:0";
		spkr_1_sd_n_sleep = "/fragment@27/__overlay__/msm_cdc_pinctrl@106:pinctrl-1:0";
		spkr_1_sd_n_active = "/fragment@27/__overlay__/msm_cdc_pinctrl@106:pinctrl-0:0";
		wcd937x_reset_sleep = "/fragment@27/__overlay__/msm_cdc_pinctrl@92:pinctrl-1:0";
		wcd937x_reset_active = "/fragment@27/__overlay__/msm_cdc_pinctrl@92:pinctrl-0:0";
		wsa881x_analog_clk_gpio = "/fragment@26/__overlay__/wsa881x-i2c-codec@e:qcom,wsa-analog-clk-gpio:0";
		qupv3_se1_i2c = "/fragment@26:target:0";
		lpi_i2s2_sd1_sleep = "/fragment@25/__overlay__/sec_mi2s_pinctrl:pinctrl-1:12";
		lpi_i2s2_sd0_sleep = "/fragment@25/__overlay__/sec_mi2s_pinctrl:pinctrl-1:8";
		lpi_i2s2_ws_sleep = "/fragment@25/__overlay__/sec_mi2s_pinctrl:pinctrl-1:4";
		lpi_i2s2_sck_sleep = "/fragment@25/__overlay__/sec_mi2s_pinctrl:pinctrl-1:0";
		lpi_i2s2_sd1_active = "/fragment@25/__overlay__/sec_mi2s_pinctrl:pinctrl-0:12";
		lpi_i2s2_sd0_active = "/fragment@25/__overlay__/sec_mi2s_pinctrl:pinctrl-0:8";
		lpi_i2s2_ws_active = "/fragment@25/__overlay__/sec_mi2s_pinctrl:pinctrl-0:4";
		lpi_i2s2_sck_active = "/fragment@25/__overlay__/sec_mi2s_pinctrl:pinctrl-0:0";
		lpi_i2s1_sd1_sleep = "/fragment@25/__overlay__/pri_mi2s_pinctrl:pinctrl-1:12";
		lpi_i2s1_sd0_sleep = "/fragment@25/__overlay__/pri_mi2s_pinctrl:pinctrl-1:8";
		lpi_i2s1_ws_sleep = "/fragment@25/__overlay__/pri_mi2s_pinctrl:pinctrl-1:4";
		lpi_i2s1_sck_sleep = "/fragment@25/__overlay__/pri_mi2s_pinctrl:pinctrl-1:0";
		lpi_i2s1_sd1_active = "/fragment@25/__overlay__/pri_mi2s_pinctrl:pinctrl-0:12";
		lpi_i2s1_sd0_active = "/fragment@25/__overlay__/pri_mi2s_pinctrl:pinctrl-0:8";
		lpi_i2s1_ws_active = "/fragment@25/__overlay__/pri_mi2s_pinctrl:pinctrl-0:4";
		lpi_i2s1_sck_active = "/fragment@25/__overlay__/pri_mi2s_pinctrl:pinctrl-0:0";
		lpi_tlmm = "/fragment@25/__overlay__/sound:qcom,msm_audio_ssr_devs:4";
		audio_gpr = "/fragment@25/__overlay__/sound:qcom,msm_audio_ssr_devs:0";
		stub_codec = "/fragment@25/__overlay__/sound:asoc-codec:0";
		adsp_variant = "/fragment@25/__overlay__/sound:nvmem-cells:0\0/fragment@28/__overlay__:nvmem-cells:0";
		cdc_dmic23_gpios = "/fragment@25/__overlay__/sound:qcom,cdc-dmic23-gpios:0";
		cdc_dmic01_gpios = "/fragment@25/__overlay__/sound:qcom,cdc-dmic01-gpios:0";
		spf_core_platform = "/fragment@25:target:0";
		L14A = "/fragment@24/__overlay__/wcd937x-codec:cdc-vdd-buck-supply:0";
		L9A = "/fragment@24/__overlay__/wcd937x-codec:cdc-vdd-rxtx-supply:0\0/fragment@24/__overlay__/wcd937x-codec:cdc-vddpx-supply:0";
		va_swr_gpios = "/fragment@24/__overlay__/va-macro@a730000:qcom,va-swr-gpios:0";
		lpass_audio_hw_vote = "/fragment@24/__overlay__/rx-macro@a600000/rx_swr_master:clocks:0\0/fragment@24/__overlay__/va-macro@a730000:clocks:0\0/fragment@24/__overlay__/va-macro@a730000/va_swr_master:clocks:0";
		rx_swr_gpios = "/fragment@24/__overlay__/rx-macro@a600000:qcom,rx-swr-gpios:0";
		bolero_cdc = "/fragment@24:target:0\0/fragment@25/__overlay__/sound:asoc-codec:4\0/fragment@25/__overlay__/sound:qcom,msm_audio_ssr_devs:8";
		thermal_zones = "/fragment@0:target:0\0/fragment@5:target:0";
		pm6125_trip0 = "/fragment@0/__overlay__/pm6125-tz/cooling-maps/trip0_cpu0:trip:0\0/fragment@0/__overlay__/pm6125-tz/cooling-maps/trip0_cpu4:trip:0";
		CPU0 = "/fragment@0/__overlay__/pm6125-tz/cooling-maps/trip0_cpu0:cooling-device:0";
		CPU4 = "/fragment@0/__overlay__/pm6125-tz/cooling-maps/trip0_cpu4:cooling-device:0";
		pm6125_trip1 = "/fragment@0/__overlay__/pm6125-tz/cooling-maps/trip1_cpu1:trip:0\0/fragment@0/__overlay__/pm6125-tz/cooling-maps/trip1_cpu2:trip:0\0/fragment@0/__overlay__/pm6125-tz/cooling-maps/trip1_cpu3:trip:0\0/fragment@0/__overlay__/pm6125-tz/cooling-maps/trip1_cpu4:trip:0\0/fragment@0/__overlay__/pm6125-tz/cooling-maps/trip1_cpu5:trip:0\0/fragment@0/__overlay__/pm6125-tz/cooling-maps/trip1_cpu6:trip:0\0/fragment@0/__overlay__/pm6125-tz/cooling-maps/trip1_cpu7:trip:0";
		cpu1_pause = "/fragment@0/__overlay__/pm6125-tz/cooling-maps/trip1_cpu1:cooling-device:0";
		cpu2_pause = "/fragment@0/__overlay__/pm6125-tz/cooling-maps/trip1_cpu2:cooling-device:0";
		cpu3_pause = "/fragment@0/__overlay__/pm6125-tz/cooling-maps/trip1_cpu3:cooling-device:0";
		cpu4_pause = "/fragment@0/__overlay__/pm6125-tz/cooling-maps/trip1_cpu4:cooling-device:0";
		cpu5_pause = "/fragment@0/__overlay__/pm6125-tz/cooling-maps/trip1_cpu5:cooling-device:0";
		cpu6_pause = "/fragment@0/__overlay__/pm6125-tz/cooling-maps/trip1_cpu6:cooling-device:0";
		cpu7_pause = "/fragment@0/__overlay__/pm6125-tz/cooling-maps/trip1_cpu7:cooling-device:0";
		soc = "/fragment@1:target:0\0/fragment@7:target:0\0/fragment@15:target:0\0/fragment@27:target:0";
		tlmm = "/fragment@1/__overlay__/fingerprint_xiaomi:xiaomi,gpio_irq:0\0/fragment@1/__overlay__/fingerprint_xiaomi:fp-gpio-pwr:0\0/fragment@2:target:0\0/fragment@7/__overlay__/ant_check:interrupt-parent:0\0/fragment@7/__overlay__/ant_check:ant_check_gpio:0\0/fragment@7/__overlay__/ant_check_div:interrupt-parent:0\0/fragment@7/__overlay__/ant_check_div:ant_check_div_gpio:0\0/fragment@10/__overlay__:cd-gpios:0\0/fragment@12/__overlay__:reset-gpios:0\0/fragment@14/__overlay__/synaptics_tcm@20:interrupt-parent:0\0/fragment@14/__overlay__/synaptics_tcm@20:synaptics,irq-gpio:0\0/fragment@14/__overlay__/synaptics_tcm@20:synaptics,reset-gpio:0\0/fragment@14/__overlay__/novatek@62:interrupt-parent:0\0/fragment@14/__overlay__/novatek@62:novatek,reset-gpio:0\0/fragment@14/__overlay__/novatek@62:novatek,irq-gpio:0";
		pm6125_l9 = "/fragment@1/__overlay__/fingerprint_xiaomi:vfp-supply:0";
		pm6125_vadc = "/fragment@3:target:0\0/fragment@4/__overlay__/rf_pa1_therm:io-channels:0";
		camera_therm_default = "/fragment@3/__overlay__:pinctrl-0:0";
		emmc_therm_default = "/fragment@3/__overlay__:pinctrl-0:4";
		pm6125_adc_tm = "/fragment@4:target:0\0/fragment@5/__overlay__/rf-pa1-therm-usr:thermal-sensors:0";
		pm6125_gpios = "/fragment@6:target:0\0/fragment@7/__overlay__/gpio_keys/vol_up:gpios:0\0/fragment@7/__overlay__/vdda_usb_ss_dp_core:gpio:0";
		ant_check_default = "/fragment@7/__overlay__/ant_check:pinctrl-0:0";
		ant_check_div_default = "/fragment@7/__overlay__/ant_check_div:pinctrl-0:0";
		usb_qmp_dp_phy = "/fragment@8:target:0";
		sdhc_1 = "/fragment@9:target:0";
		L24A = "/fragment@9/__overlay__:vdd-supply:0\0/fragment@12/__overlay__:vcc-supply:0";
		L11A = "/fragment@9/__overlay__:vdd-io-supply:0\0/fragment@12/__overlay__:vccq2-supply:0";
		sdc1_on = "/fragment@9/__overlay__:pinctrl-0:0";
		sdc1_off = "/fragment@9/__overlay__:pinctrl-1:0";
		sdhc_2 = "/fragment@10:target:0";
		L22A = "/fragment@10/__overlay__:vdd-supply:0";
		L5A = "/fragment@10/__overlay__:vdd-io-supply:0";
		L7A = "/fragment@10/__overlay__:vdd-io-bias-supply:0";
		sdc2_on = "/fragment@10/__overlay__:pinctrl-0:0";
		sdc2_off = "/fragment@10/__overlay__:pinctrl-1:0";
		ufsphy_mem = "/fragment@11:target:0";
		L4A = "/fragment@11/__overlay__:vdda-phy-supply:0";
		L18A = "/fragment@11/__overlay__:vdda-pll-supply:0\0/fragment@12/__overlay__:qcom,vddp-ref-clk-supply:0";
		ufshc_mem = "/fragment@12:target:0";
		gcc_ufs_phy_gdsc = "/fragment@12/__overlay__:vdd-hba-supply:0";
		gcc = "/fragment@12/__overlay__:resets:0";
		pm6125_pwm = "/fragment@13:target:0";
		qupv3_se2_i2c = "/fragment@14:target:0";
		ts_int_active = "/fragment@14/__overlay__/synaptics_tcm@20:pinctrl-0:0\0/fragment@14/__overlay__/novatek@62:pinctrl-0:0";
		ts_reset_active = "/fragment@14/__overlay__/synaptics_tcm@20:pinctrl-0:4\0/fragment@14/__overlay__/novatek@62:pinctrl-0:4";
		ts_int_suspend = "/fragment@14/__overlay__/synaptics_tcm@20:pinctrl-1:0\0/fragment@14/__overlay__/novatek@62:pinctrl-1:0";
		ts_reset_suspend = "/fragment@14/__overlay__/synaptics_tcm@20:pinctrl-1:4\0/fragment@14/__overlay__/novatek@62:pinctrl-1:4";
		ts_release = "/fragment@14/__overlay__/synaptics_tcm@20:pinctrl-2:0\0/fragment@14/__overlay__/novatek@62:pinctrl-2:0";
		pm8008_regulators = "/fragment@16:target:0";
		L1P = "/fragment@17:target:0";
		L2P = "/fragment@18:target:0";
		L3P = "/fragment@19:target:0";
		L4P = "/fragment@20:target:0";
		L5P = "/fragment@21:target:0";
		L6P = "/fragment@22:target:0";
		L7P = "/fragment@23:target:0";
	};

	__local_fixups__ {

		fragment@1 {

			__overlay__ {

				fingerprint_xiaomi {
					pinctrl-0 = <0x00>;
					pinctrl-1 = <0x00>;
					pinctrl-2 = <0x00>;
					pinctrl-3 = <0x00>;
					pinctrl-4 = <0x00>;
					pinctrl-5 = <0x00>;
				};
			};
		};

		fragment@3 {

			__overlay__ {
				pinctrl-0 = <0x08>;
			};
		};

		fragment@7 {

			__overlay__ {

				gpio_keys {
					pinctrl-0 = <0x00>;
				};

				vdda_usb_ss_dp_core {
					pinctrl-0 = <0x00>;
				};
			};
		};

		fragment@8 {

			__overlay__ {
				vdd-supply = <0x00>;
			};
		};

		fragment@24 {

			__overlay__ {

				bolero-clk-rsc-mngr {
					clocks = <0x00 0x08 0x10 0x18 0x20 0x28>;
				};

				tx-macro@a620000 {
					clocks = <0x00 0x08>;
				};

				rx-macro@a600000 {
					clocks = <0x00 0x08>;
				};

				wcd937x-codec {
					qcom,tx-slave = <0x00>;
					qcom,rx-slave = <0x00>;
					qcom,wcd-rst-gpio-node = <0x00>;
				};
			};
		};

		fragment@25 {

			__overlay__ {

				sound {
					asoc-codec = <0x08 0x0c>;
				};
			};
		};

		fragment@26 {

			__overlay__ {

				wsa881x-i2c-codec@e {
					qcom,wsa-analog-reset-gpio = <0x00>;
					clocks = <0x00>;
				};
			};
		};
	};

	fragment@24 {
		target = <0xffffffff>;

		__overlay__ {
			qcom,bolero-version = <0x05>;
			qcom,num-macros = <0x03>;

			bolero-clk-rsc-mngr {
				clocks = <0x11 0x00 0x12 0x00 0x13 0x00 0x14 0x00 0x15 0x00 0x16 0x00>;
				clock-names = "tx_core_clk\0tx_npl_clk\0rx_core_clk\0rx_npl_clk\0va_core_clk\0va_npl_clk";
				qcom,va_mclk_mode_muxsel = "\nz\0";
				qcom,rx_mclk_mode_muxsel = <0xa5640d8>;
				qcom,fs-gen-sequence = <0x3000 0x01 0x01 0x3004 0x03 0x03 0x3004 0x03 0x01 0x3080 0x02 0x02>;
				compatible = "qcom,bolero-clk-rsc-mngr";
			};

			tx-macro@a620000 {
				phandle = <0x1e>;
				qcom,is-used-swr-gpio = <0x00>;
				qcom,tx-dmic-sample-rate = <0x249f00>;
				clocks = <0x11 0x00 0x12 0x00>;
				clock-names = "tx_core_clk\0tx_npl_clk";
				reg = <0xa620000 0x00>;
				compatible = "qcom,tx-macro";
			};

			rx-macro@a600000 {
				phandle = <0x1f>;
				qcom,default-clk-id = <0x00>;
				qcom,rx-bcl-pmic-params = [00 04 3e];
				qcom,rx_mclk_mode_muxsel = <0xa5640d8>;
				qcom,rx-swr-gpios = <0xffffffff>;
				clocks = <0x13 0x00 0x14 0x00>;
				clock-names = "rx_core_clk\0rx_npl_clk";
				reg = <0xa600000 0x00>;
				compatible = "qcom,rx-macro";

				rx_swr_master {
					phandle = <0x20>;
					qcom,swr-clock-stop-mode0 = <0x01>;
					qcom,disable-div2-clk-switch = <0x01>;
					qcom,swr-num-dev = <0x01>;
					qcom,swr-port-mapping = <0x01 0x0e 0x01 0x01 0x0f 0x02 0x02 0x12 0x01 0x03 0x10 0x01 0x03 0x11 0x02 0x04 0x13 0x01 0x05 0x14 0x01 0x05 0x15 0x02>;
					qcom,swr-num-ports = <0x05>;
					interrupt-names = "swr_master_irq";
					interrupts = <0x00 0x129 0x04>;
					swrm-io-base = <0xa610000 0x00>;
					qcom,mipi-sdw-block-packing-mode = <0x01>;
					qcom,swrm-hctl-reg = <0xa6a9098>;
					qcom,swr_master_id = <0x02>;
					qcom,swr-master-version = <0x1060000>;
					clocks = <0xffffffff 0x00>;
					clock-names = "lpass_audio_hw_vote";
					#size-cells = <0x00>;
					#address-cells = <0x02>;
					compatible = "qcom,swr-mstr";

					wcd937x-rx-slave {
						phandle = <0x18>;
						reg = <0x0a 0x1170224>;
						compatible = "qcom,wcd937x-slave";
					};
				};
			};

			va-macro@a730000 {
				phandle = <0x21>;
				qcom,va-swr-gpios = <0xffffffff>;
				qcom,is-used-swr-gpio = <0x01>;
				qcom,default-clk-id = <0x00>;
				qcom,va-island-mode-muxsel = "\nz\0";
				qcom,va-clk-mux-select = <0x01>;
				qcom,va-dmic-sample-rate = <0x927c0>;
				clocks = <0xffffffff 0x00>;
				clock-names = "lpass_audio_hw_vote";
				reg = <0xa730000 0x00>;
				compatible = "qcom,va-macro";

				va_swr_master {
					phandle = <0x22>;
					qcom,is-always-on = <0x01>;
					qcom,swr-mstr-irq-wakeup-capable = <0x01>;
					qcom,swr-clock-stop-mode0 = <0x01>;
					qcom,swr-num-dev = <0x01>;
					qcom,swr-port-mapping = <0x01 0x2e 0x01 0x01 0x2f 0x02 0x01 0x30 0x04 0x01 0x31 0x08 0x02 0x32 0x01 0x02 0x33 0x02 0x02 0x34 0x04 0x02 0x35 0x08 0x03 0x36 0x01 0x03 0x37 0x02 0x03 0x38 0x04 0x03 0x39 0x08>;
					qcom,swr-num-ports = <0x03>;
					qcom,swr-wakeup-required = <0x01>;
					interrupt-names = "swr_master_irq\0swr_wake_irq";
					interrupts = <0x00 0x128 0x04 0x00 0x4f 0x04>;
					swrm-io-base = <0xa740000 0x00>;
					qcom,mipi-sdw-block-packing-mode = <0x01>;
					qcom,swrm-hctl-reg = <0xa7ec100>;
					qcom,swr_master_id = <0x03>;
					qcom,swr-master-version = <0x1060000>;
					clocks = <0xffffffff 0x00>;
					clock-names = "lpass_audio_hw_vote";
					#size-cells = <0x00>;
					#address-cells = <0x02>;
					compatible = "qcom,swr-mstr";

					wcd937x-tx-slave {
						phandle = <0x19>;
						reg = <0x0a 0x1170223>;
						compatible = "qcom,wcd937x-slave";
					};
				};
			};

			wcd937x-codec {
				phandle = <0x1a>;
				qcom,cdc-on-demand-supplies = "cdc-vdd-buck";
				qcom,cdc-static-supplies = "cdc-vdd-rxtx\0cdc-vddpx";
				qcom,cdc-micbias3-mv = <0x708>;
				qcom,cdc-micbias2-mv = <0x708>;
				qcom,cdc-micbias1-mv = <0x708>;
				qcom,cdc-vdd-buck-current = <0x9eb10>;
				qcom,cdc-vdd-buck-voltage = <0x1b7740 0x1b7740>;
				cdc-vdd-buck-supply = <0xffffffff>;
				qcom,cdc-vddpx-current = <0x4e20>;
				qcom,cdc-vddpx-voltage = <0x1b7740 0x1b7740>;
				cdc-vddpx-supply = <0xffffffff>;
				qcom,cdc-vdd-rxtx-current = <0x2710>;
				qcom,cdc-vdd-rxtx-voltage = <0x1b7740 0x1b7740>;
				cdc-vdd-rxtx-supply = <0xffffffff>;
				qcom,tx-slave = <0x19>;
				qcom,rx-slave = <0x18>;
				qcom,wcd-rst-gpio-node = <0x17>;
				qcom,swr-tx-port-params = <0x01 0x00 0x00 0x01 0x01 0x00 0x01 0x00 0x00 0x01 0x01 0x00 0x01 0x00 0x01 0x00 0x00 0x01 0x02 0x00 0x01 0x00 0x02 0x00 0x01 0x00 0x01 0x00 0x01 0x00 0x01 0x00>;
				qcom,tx_swr_ch_map = <0x00 0x1e 0x01 0x493e00 0x2e 0x01 0x1f 0x01 0x493e00 0x32 0x01 0x20 0x02 0x493e00 0x33 0x02 0x22 0x01 0x00 0x31 0x02 0x23 0x02 0x00 0x32 0x02 0x1d 0x04 0x493e00 0x33 0x03 0x24 0x01 0x00 0x34 0x03 0x25 0x02 0x00 0x35 0x03 0x26 0x04 0x00 0x36 0x03 0x27 0x08 0x00 0x37>;
				qcom,rx_swr_ch_map = <0x00 0x0e 0x01 0x00 0x0e 0x00 0x0f 0x02 0x00 0x0f 0x01 0x12 0x01 0x00 0x12 0x02 0x10 0x01 0x00 0x10 0x02 0x11 0x02 0x00 0x11 0x03 0x13 0x01 0x00 0x13 0x04 0x14 0x01 0x00 0x14 0x04 0x15 0x02 0x00 0x15>;
				qcom,split-codec = <0x01>;
				compatible = "qcom,wcd937x-codec";
			};
		};
	};

	fragment@25 {
		target = <0xffffffff>;

		__overlay__ {

			sound {
				phandle = <0x23>;
				qcom,msm_audio_ssr_devs = <0xffffffff 0xffffffff 0xffffffff>;
				qcom,wsa-aux-dev-prefix = "SpkrMono";
				qcom,wsa-max-devs = <0x01>;
				asoc-codec-names = "msm-stub-codec.1\0bolero-codec\0wcd937x_codec\0wsa-codec0";
				asoc-codec = <0xffffffff 0xffffffff 0x1a 0x1b>;
				nvmem-cell-names = "adsp_variant";
				nvmem-cells = <0xffffffff>;
				qcom,cdc-dmic23-gpios = <0xffffffff>;
				qcom,cdc-dmic01-gpios = <0xffffffff>;
				qcom,msm-mbhc-gnd-swh = <0x01>;
				qcom,msm-mbhc-hphl-swh = <0x01>;
				qcom,msm-mbhc-usbc-audio-supported = <0x00>;
				qcom,audio-routing = "AMIC1\0Analog Mic1\0AMIC1\0MIC BIAS1\0AMIC2\0Analog Mic2\0AMIC2\0MIC BIAS2\0AMIC3\0Analog Mic3\0AMIC3\0MIC BIAS3\0TX DMIC0\0Digital Mic0\0TX DMIC0\0MIC BIAS1\0TX DMIC1\0Digital Mic1\0TX DMIC1\0MIC BIAS1\0TX DMIC2\0Digital Mic2\0TX DMIC2\0MIC BIAS3\0TX DMIC3\0Digital Mic3\0TX DMIC3\0MIC BIAS3\0IN1_HPHL\0HPHL_OUT\0IN2_HPHR\0HPHR_OUT\0IN3_AUX\0AUX_OUT\0RX_TX DEC0_INP\0TX DEC0 MUX\0RX_TX DEC1_INP\0TX DEC1 MUX\0RX_TX DEC2_INP\0TX DEC2 MUX\0RX_TX DEC3_INP\0TX DEC3 MUX\0SpkrMono WSA_IN\0AUX\0TX SWR_INPUT\0WCD_TX_OUTPUT\0VA SWR_INPUT\0VA_SWR_CLK\0VA SWR_INPUT\0WCD_TX_OUTPUT\0TX_AIF1 CAP\0VA_SWR_CLK\0TX_AIF2 CAP\0VA_SWR_CLK\0TX_AIF3 CAP\0VA_SWR_CLK\0VA DMIC0\0Digital Mic0\0VA DMIC1\0Digital Mic1\0VA DMIC2\0Digital Mic2\0VA DMIC3\0Digital Mic3\0VA DMIC0\0VA MIC BIAS1\0VA DMIC1\0VA MIC BIAS1\0VA DMIC2\0VA MIC BIAS3\0VA DMIC3\0VA MIC BIAS3";
				qcom,rxtx-bolero-codec = <0x01>;
				qcom,va-bolero-codec = <0x01>;
				qcom,wcn-btfm = <0x01>;
				qcom,msm-mi2s-master = <0x01 0x01 0x01 0x01>;
				qcom,model = "bengal-idp-snd-card";
			};

			pri_mi2s_pinctrl {
				phandle = <0x24>;
				#gpio-cells = <0x00>;
				qcom,lpi-gpios;
				pinctrl-1 = <0xffffffff 0xffffffff 0xffffffff 0xffffffff>;
				pinctrl-0 = <0xffffffff 0xffffffff 0xffffffff 0xffffffff>;
				pinctrl-names = "aud_active\0aud_sleep";
				compatible = "qcom,msm-cdc-pinctrl";
			};

			sec_mi2s_pinctrl {
				phandle = <0x25>;
				#gpio-cells = <0x00>;
				qcom,lpi-gpios;
				pinctrl-1 = <0xffffffff 0xffffffff 0xffffffff 0xffffffff>;
				pinctrl-0 = <0xffffffff 0xffffffff 0xffffffff 0xffffffff>;
				pinctrl-names = "aud_active\0aud_sleep";
				compatible = "qcom,msm-cdc-pinctrl";
			};
		};
	};

	fragment@26 {
		target = <0xffffffff>;

		__overlay__ {

			wsa881x-i2c-codec@e {
				phandle = <0x1b>;
				qcom,wsa-prefix = "SpkrMono";
				qcom,wsa-analog-reset-gpio = <0x1d>;
				qcom,wsa-analog-clk-gpio = <0xffffffff>;
				clocks = <0x1c 0x00>;
				clock-names = "wsa_mclk";
				reg = <0x0e>;
				compatible = "qcom,wsa881x-i2c-codec";
			};

			wsa881x-i2c-codec@44 {
				phandle = <0x26>;
				reg = <0x44>;
				compatible = "qcom,wsa881x-i2c-codec";
			};
		};
	};

	fragment@27 {
		target = <0xffffffff>;

		__overlay__ {

			msm_cdc_pinctrl@92 {
				phandle = <0x17>;
				#gpio-cells = <0x00>;
				pinctrl-1 = <0xffffffff>;
				pinctrl-0 = <0xffffffff>;
				pinctrl-names = "aud_active\0aud_sleep";
				compatible = "qcom,msm-cdc-pinctrl";
			};

			msm_cdc_pinctrl@106 {
				phandle = <0x1d>;
				#gpio-cells = <0x00>;
				pinctrl-1 = <0xffffffff>;
				pinctrl-0 = <0xffffffff>;
				pinctrl-names = "aud_active\0aud_sleep";
				compatible = "qcom,msm-cdc-pinctrl";
			};

			wsa_ana_clk {
				phandle = <0x1c>;
				#clock-cells = <0x01>;
				qcom,codec-lpass-clk-id = <0x301>;
				qcom,codec-lpass-ext-clk-freq = <0x927c00>;
				qcom,codec-ext-clk-src = <0x03>;
				compatible = "qcom,audio-ref-clk";
			};

			rx_core_clk {
				phandle = <0x13>;
				#clock-cells = <0x01>;
				qcom,codec-lpass-clk-id = <0x30e>;
				qcom,codec-lpass-ext-clk-freq = <0x1588800>;
				qcom,codec-ext-clk-src = <0x05>;
				compatible = "qcom,audio-ref-clk";
			};

			rx_npl_clk {
				phandle = <0x14>;
				#clock-cells = <0x01>;
				qcom,codec-lpass-clk-id = <0x30f>;
				qcom,codec-lpass-ext-clk-freq = <0x1588800>;
				qcom,codec-ext-clk-src = <0x06>;
				compatible = "qcom,audio-ref-clk";
			};

			tx_core_clk {
				phandle = <0x11>;
				#clock-cells = <0x01>;
				qcom,codec-lpass-clk-id = <0x30c>;
				qcom,codec-lpass-ext-clk-freq = <0x124f800>;
				qcom,codec-ext-clk-src = <0x07>;
				compatible = "qcom,audio-ref-clk";
			};

			tx_npl_clk {
				phandle = <0x12>;
				#clock-cells = <0x01>;
				qcom,codec-lpass-clk-id = <0x30d>;
				qcom,codec-lpass-ext-clk-freq = <0x124f800>;
				qcom,codec-ext-clk-src = <0x08>;
				compatible = "qcom,audio-ref-clk";
			};

			va_core_clk {
				phandle = <0x15>;
				#clock-cells = <0x01>;
				qcom,codec-lpass-clk-id = <0x307>;
				qcom,codec-lpass-ext-clk-freq = <0x124f800>;
				qcom,codec-ext-clk-src = <0x02>;
				compatible = "qcom,audio-ref-clk";
			};

			va_npl_clk {
				phandle = <0x16>;
				#clock-cells = <0x01>;
				qcom,codec-lpass-clk-id = <0x308>;
				qcom,codec-lpass-ext-clk-freq = <0x124f800>;
				qcom,codec-ext-clk-src = <0x0a>;
				compatible = "qcom,audio-ref-clk";
			};
		};
	};

	fragment@28 {
		target = <0xffffffff>;

		__overlay__ {
			adsp-fw-bit-values = <0x01>;
			adsp-fw-names = "adsp2";
			nvmem-cell-names = "adsp_variant";
			nvmem-cells = <0xffffffff>;
		};
	};
};
