/dts-v1/;

/ {
	model = "Qualcomm Technologies, Inc. Khaje IDP";
	compatible = "qcom,khaje-idp\0qcom,khaje\0qcom,idp";
	qcom,msm-id = <0x232 0x10000>;
	qcom,board-id = <0x10022 0x00>;
	qcom,pmic-id = <0x2d 0x2e 0x00 0x00>;

	fragment@0 {
		target = <0xffffffff>;

		__overlay__ {

			pm6125-tz {

				cooling-maps {

					trip0_cpu0 {
						trip = <0xffffffff>;
						cooling-device = <0xffffffff 0x07 0x07>;
					};

					trip0_cpu4 {
						trip = <0xffffffff>;
						cooling-device = <0xffffffff 0x06 0xffffffff>;
					};

					trip1_cpu1 {
						trip = <0xffffffff>;
						cooling-device = <0xffffffff 0x01 0x01>;
					};

					trip1_cpu2 {
						trip = <0xffffffff>;
						cooling-device = <0xffffffff 0x01 0x01>;
					};

					trip1_cpu3 {
						trip = <0xffffffff>;
						cooling-device = <0xffffffff 0x01 0x01>;
					};

					trip1_cpu4 {
						trip = <0xffffffff>;
						cooling-device = <0xffffffff 0x01 0x01>;
					};

					trip1_cpu5 {
						trip = <0xffffffff>;
						cooling-device = <0xffffffff 0x01 0x01>;
					};

					trip1_cpu6 {
						trip = <0xffffffff>;
						cooling-device = <0xffffffff 0x01 0x01>;
					};

					trip1_cpu7 {
						trip = <0xffffffff>;
						cooling-device = <0xffffffff 0x01 0x01>;
					};
				};
			};
		};
	};

	fragment@1 {
		target = <0xffffffff>;

		__overlay__ {

			fingerprint_xiaomi {
				compatible = "xiaomi,xiaomi-fp";
				xiaomi,gpio_irq = <0xffffffff 0x53 0x00>;
				vfp-supply = <0xffffffff>;
				netlink-event = <0x1d>;
				fp-gpio-pwr = <0xffffffff 0x41 0x00>;
				pinctrl-names = "reset_high\0reset_low\0eint_default\0eint_pulldown\0pwr_high\0pwr_low";
				pinctrl-0 = <0x01>;
				pinctrl-1 = <0x02>;
				pinctrl-2 = <0x03>;
				pinctrl-3 = <0x04>;
				pinctrl-4 = <0x05>;
				pinctrl-5 = <0x06>;
				status = "okay";
			};
		};
	};

	fragment@2 {
		target = <0xffffffff>;

		__overlay__ {

			fingerprints_reset_high {
				phandle = <0x01>;

				mux {
					pins = "gpio104";
					function = "gpio";
				};

				config {
					pins = "gpio104";
					drive-strength = <0x02>;
					bias-disable;
					output-high;
				};
			};

			fingerprints_reset_low {
				phandle = <0x02>;

				mux {
					pins = "gpio104";
					function = "gpio";
				};

				config {
					pins = "gpio104";
					drive-strength = <0x02>;
					bias-disable;
					output-low;
				};
			};

			fingerprints_eint_default {
				phandle = <0x03>;

				mux {
					pins = "gpio83";
					function = "gpio";
				};

				config {
					pins = "gpio83";
					drive-strength = <0x02>;
					bias-disable;
				};
			};

			fingerprints_eint_pulldown {
				phandle = <0x04>;

				mux {
					pins = "gpio83";
					function = "gpio";
				};

				config {
					pins = "gpio83";
					drive-strength = <0x02>;
					bias-pull-down;
				};
			};

			fingerprints_pwr_high {
				phandle = <0x05>;

				mux {
					pins = "gpio65";
					function = "gpio";
				};

				config {
					pins = "gpio65";
					drive-strength = <0x02>;
					bias-disable;
					output-high;
				};
			};

			fingerprints_pwr_low {
				phandle = <0x06>;

				mux {
					pins = "gpio65";
					function = "gpio";
				};

				config {
					pins = "gpio65";
					drive-strength = <0x02>;
					bias-disable;
					output-high;
				};
			};
		};
	};

	fragment@3 {
		target = <0xffffffff>;

		__overlay__ {
			pinctrl-0 = <0xffffffff 0xffffffff 0x07>;

			rf_pa1_therm {
				reg = <0x55>;
				label = "rf_pa1_therm";
				qcom,ratiometric;
				qcom,hw-settle-time = <0xc8>;
				qcom,pre-scaling = <0x01 0x01>;
			};
		};
	};

	fragment@4 {
		target = <0xffffffff>;

		__overlay__ {
			status = "ok";

			rf_pa1_therm {
				reg = <0x03>;
				io-channels = <0xffffffff 0x55>;
				qcom,ratiometric;
				qcom,hw-settle-time-us = <0xc8>;
			};
		};
	};

	fragment@5 {
		target = <0xffffffff>;

		__overlay__ {

			rf-pa1-therm-usr {
				polling-delay-passive = <0x00>;
				polling-delay = <0x00>;
				thermal-governor = "user_space";
				thermal-sensors = <0xffffffff 0x03>;
				wake-capable-sensor;

				trips {

					active-config0 {
						temperature = <0x1e848>;
						hysteresis = <0x3e8>;
						type = "passive";
					};
				};
			};
		};
	};

	fragment@6 {
		target = <0xffffffff>;

		__overlay__ {

			oled_vci {

				oled_vci_default {
					pins = "gpio9";
					function = "normal";
					input-disable;
					power-source = <0x00>;
					bias-disable;
					output-high;
					qcom,drive-strength = <0x02>;
					phandle = <0x27>;
				};

				oled_vci_suspend {
					pins = "gpio9";
					function = "normal";
					input-disable;
					power-source = <0x00>;
					bias-disable;
					output-low;
					qcom,drive-strength = <0x02>;
					phandle = <0x28>;
				};
			};

			cam_avdd1 {

				cam_sensor_avdd1_default {
					pins = "gpio2";
					function = "normal";
					bias-disable;
					power-source = <0x00>;
					qcom,drive-strength = <0x02>;
					phandle = <0x29>;
				};

				cam_sensor_avdd1_suspend {
					pins = "gpio2";
					function = "normal";
					output-low;
					bias-disable;
					power-source = <0x00>;
					qcom,drive-strength = <0x02>;
					phandle = <0x2a>;
				};
			};

			flash {

				flash_default {
					pins = "gpio8";
					function = "normal";
					output-high;
					bias-pull-up;
					power-source = <0x01>;
					qcom,drive-strength = <0x02>;
					phandle = <0x2b>;
				};

				flash_suspend {
					pins = "gpio8";
					function = "normal";
					output-low;
					bias-disable;
					power-source = <0x01>;
					qcom,drive-strength = <0x02>;
					phandle = <0x2c>;
				};
			};

			rf_pa1_therm {

				rf_pa1_therm_default {
					pins = "gpio7";
					bias-high-impedance;
					phandle = <0x07>;
				};
			};

			key_vol_up {

				key_vol_up_default {
					pins = "gpio5";
					function = "normal";
					input-enable;
					bias-pull-up;
					power-source = <0x00>;
					phandle = <0x08>;
				};
			};

			eldo9_pin {

				gpio@c000 {
					pins = "gpio1";
					function = "normal";
					qcom,drive-strength = <0x02>;
					power-source = <0x00>;
					bias-disable;
					output-high;
					phandle = <0x09>;
				};
			};
		};
	};

	fragment@7 {
		target = <0xffffffff>;

		__overlay__ {

			gpio_keys {
				compatible = "gpio-keys";
				label = "gpio-keys";
				pinctrl-names = "default";
				pinctrl-0 = <0x08>;

				vol_up {
					label = "volume_up";
					gpios = <0xffffffff 0x05 0x01>;
					linux,input-type = <0x01>;
					linux,code = <0x73>;
					linux,can-disable;
					debounce-interval = <0x0f>;
					gpio-key,wakeup;
				};
			};

			ant_check {
				compatible = "ant_check";
				interrupt-parent = <0xffffffff>;
				ant_check_gpio = <0xffffffff 0x6b 0x00>;
				pinctrl-names = "default";
				pinctrl-0 = <0xffffffff>;
			};

			ant_check_div {
				compatible = "ant_check_div";
				interrupt-parent = <0xffffffff>;
				ant_check_div_gpio = <0xffffffff 0x19 0x00>;
				pinctrl-names = "default";
				pinctrl-0 = <0xffffffff>;
			};

			vdda_usb_ss_dp_core {
				compatible = "regulator-fixed";
				regulator-name = "vdd_supply";
				regulator-min-microvolt = <0xd6d80>;
				regulator-max-microvolt = <0xd6d80>;
				enable-active-high;
				gpio = <0xffffffff 0x01 0x00>;
				pinctrl-names = "default";
				pinctrl-0 = <0x09>;
				phandle = <0x0a>;
			};
		};
	};

	fragment@8 {
		target = <0xffffffff>;

		__overlay__ {
			vdd-supply = <0x0a>;
		};
	};

	fragment@9 {
		target = <0xffffffff>;

		__overlay__ {
			vdd-supply = <0xffffffff>;
			qcom,vdd-voltage-level = <0x2d2a80 0x2d2a80>;
			qcom,vdd-current-level = <0x00 0x8b290>;
			vdd-io-supply = <0xffffffff>;
			qcom,vdd-io-always-on;
			qcom,vdd-io-lpm-sup;
			qcom,vdd-io-voltage-level = <0x1b7740 0x1b7740>;
			qcom,vdd-io-current-level = <0x00 0x4f588>;
			pinctrl-names = "default\0sleep";
			pinctrl-0 = <0xffffffff>;
			pinctrl-1 = <0xffffffff>;
			status = "ok";
		};
	};

	fragment@10 {
		target = <0xffffffff>;

		__overlay__ {
			vdd-supply = <0xffffffff>;
			qcom,vdd-voltage-level = <0x2d2a80 0x2d2a80>;
			qcom,vdd-current-level = <0x00 0xc3500>;
			vdd-io-supply = <0xffffffff>;
			qcom,vdd-io-voltage-level = <0x1b7740 0x2d2a80>;
			qcom,vdd-io-current-level = <0x00 0x55f0>;
			vdd-io-bias-supply = <0xffffffff>;
			qcom,vdd-io-bias-voltage-level = <0x132a40 0x132a40>;
			qcom,vdd-io-bias-current-level = <0x00 0x1770>;
			pinctrl-names = "default\0sleep";
			pinctrl-0 = <0xffffffff>;
			pinctrl-1 = <0xffffffff>;
			cd-gpios = <0xffffffff 0x58 0x01>;
			status = "ok";
		};
	};

	fragment@11 {
		target = <0xffffffff>;

		__overlay__ {
			compatible = "qcom,ufs-phy-qmp-v4-khaje";
			vdda-phy-supply = <0xffffffff>;
			vdda-pll-supply = <0xffffffff>;
			vdda-phy-max-microamp = <0x14ec4>;
			vdda-pll-max-microamp = <0x477c>;
			status = "ok";
		};
	};

	fragment@12 {
		target = <0xffffffff>;

		__overlay__ {
			vdd-hba-supply = <0xffffffff>;
			vdd-hba-fixed-regulator;
			vcc-supply = <0xffffffff>;
			vcc-max-microamp = "\0\f5";
			vccq2-supply = <0xffffffff>;
			vccq2-max-microamp = "\0\f5";
			qcom,vddp-ref-clk-supply = <0xffffffff>;
			qcom,vddp-ref-clk-max-microamp = <0x64>;
			reset-gpios = <0xffffffff 0x71 0x01>;
			resets = <0xffffffff 0x04>;
			reset-names = "rst";
			status = "ok";
		};
	};

	fragment@13 {
		target = <0xffffffff>;

		__overlay__ {
			status = "ok";
		};
	};

	fragment@14 {
		target = <0xffffffff>;

		__overlay__ {
			status = "okay";
			qcom,i2c-touch-active = "synaptics,tcm-i2c";

			synaptics_tcm@20 {
				compatible = "synaptics,tcm-i2c";
				reg = <0x20>;
				interrupt-parent = <0xffffffff>;
				interrupts = <0x50 0x2008>;
				pinctrl-names = "pmx_ts_active\0pmx_ts_suspend\0pmx_ts_release";
				pinctrl-0 = <0xffffffff 0xffffffff>;
				pinctrl-1 = <0xffffffff 0xffffffff>;
				pinctrl-2 = <0xffffffff>;
				synaptics,irq-gpio = <0xffffffff 0x50 0x2008>;
				synaptics,irq-on-state = <0x00>;
				synaptics,reset-gpio = <0xffffffff 0x56 0x00>;
				synaptics,reset-on-state = <0x00>;
				synaptics,reset-active-ms = <0x14>;
				synaptics,reset-delay-ms = <0xc8>;
				synaptics,power-delay-ms = <0xc8>;
				synaptics,ubl-i2c-addr = <0x20>;
				synaptics,extend_report;
				synaptics,firmware-name = "synaptics_firmware_k.img";
			};

			novatek@62 {
				reg = <0x62>;
				status = "ok";
				interrupt-parent = <0xffffffff>;
				interrupts = <0x50 0x2008>;
				pinctrl-names = "pmx_ts_active\0pmx_ts_suspend\0pmx_ts_release";
				pinctrl-0 = <0xffffffff 0xffffffff>;
				pinctrl-1 = <0xffffffff 0xffffffff>;
				pinctrl-2 = <0xffffffff>;
				novatek,reset-gpio = <0xffffffff 0x56 0x00>;
				novatek,irq-gpio = <0xffffffff 0x50 0x2008>;
			};
		};
	};

	fragment@15 {
		target = <0xffffffff>;

		__overlay__ {
			#address-cells = <0x02>;
			#size-cells = <0x00>;
			interrupt-controller;
			#interrupt-cells = <0x04>;

			qcom,pm7250b@2 {
				compatible = "qcom,spmi-pmic";
				reg = <0x02 0x00>;
				#address-cells = <0x01>;
				#size-cells = <0x00>;

				qcom,qpnp-smb5 {
					compatible = "qcom,pm7250b-smb5";
					depends-on-supply = <0x0b>;
					#address-cells = <0x01>;
					#size-cells = <0x01>;
					#cooling-cells = <0x02>;
					qcom,thermal-mitigation = <0x5aca30 0x5265c0 0x4c4b40 0x44aa20 0x3d0900 0x387520 0x3567e0 0x2dc6c0 0x2ab980 0x2625a0 0x1e8480 0x16e360 0xf4240 0xc3500 0x7a120 0x55730 0xc3500 0xc3500>;
					qcom,hvdcp2-max-icl-ua = <0x1e8480>;
					qcom,hvdcp2-12v-max-icl-ua = <0x16e360>;
					status = "ok";
					#io-channel-cells = <0x01>;
					io-channels = <0x0b 0x08 0x0b 0x07 0x0b 0x09 0x0b 0x06 0x0b 0x4f 0x0b 0x99 0x0b 0x83 0x0b 0x4d 0x0c 0x4b 0x0c 0xa2 0x0c 0x46 0x0c 0x45 0x0c 0x42 0x0c 0x47 0x0c 0x5d 0x0c 0x4e 0x0c 0x44 0x0c 0x5b 0x0c 0x48 0x0c 0x2d 0x0c 0x53 0x0c 0x49 0x0c 0x52 0x0c 0x54 0x0c 0x56 0x0c 0xc1 0x0d 0x98 0x0d 0x9d 0x0e 0xb5 0x0e 0xb4 0x0e 0xb9 0x0e 0xbb 0x0f 0x98 0x0f 0x9d 0x0c 0xa0 0x0c 0xa1 0x0c 0x9f 0x0c 0x50 0x0f 0xc4 0x10 0xc5>;
					io-channel-names = "usb_in_voltage\0usb_in_current\0chg_temp\0die_temp\0conn_temp\0sbux_res\0vph_voltage\0skin_temp\0resistance_id\0fastcharge_mode\0voltage_now\0temp\0capacity\0voltage_ocv\0voltage_avg\0debug_battery\0real_capacity\0cc_soc\0current_now\0voltage_max\0charge_full\0charge_counter\0cycle_count\0charge_full_design\0time_to_full_now\0ffc_chg_termination_current\0sc_bus_current\0sc_manufacturer\0auth_batt_id\0auth_authen_result\0auth_manufacturer\0auth_chip_ok\0bq_bus_current\0bq_manufacturer\0soc_decimal\0soc_decimal_rate\0shutdown_delay\0batt_full_current\0bq_set_acdrv\0recharg_mode";
					qcom,battery-data = <0x11>;
					qcom,sec-charger-config = <0x00>;
					qcom,auto-recharge-soc = <0x5f>;
					qcom,auto-recharge-vbat-mv = <0x64>;
					qcom,step-charging-enable;
					qcom,sw-jeita-enable;
					mi,use_third_cp;
					mi,support-ffc;
					qcom,distinguish-qc-class-ab;
					qcom,charger-temp-max = <0x320>;
					qcom,smb-temp-max = <0x320>;
					qcom,suspend-input-on-debug-batt;
					qcom,fcc-stepping-enable;
					qcom,fcc-step-delay-ms = <0x64>;
					qcom,fcc-step-size-ua = <0x186a0>;
					qcom,smb-internal-pull-kohm = <0x00>;
					qcom,en-skin-therm-mitigation;
					qcom,hvdcp3-standalone-config;
					qcom,chg-term-current-ma = <0xffffff06>;
					qcom,fcc-max-ua = <0x5b8d80>;
					qcom,fv-max-uv = <0x44aa20>;
					qcom,disable-suspend-on-collapse;
					dpdm-supply = <0xffffffff>;
					phandle = <0x10>;

					qcom,chgr@1000 {
						reg = <0x1000>;
						interrupts = <0x02 0x10 0x00 0x01 0x02 0x10 0x01 0x01 0x02 0x10 0x02 0x01 0x02 0x10 0x03 0x01 0x02 0x10 0x04 0x01 0x02 0x10 0x05 0x01 0x02 0x10 0x06 0x01 0x02 0x10 0x07 0x01>;
						interrupt-names = "chgr-error\0chg-state-change\0step-chg-state-change\0step-chg-soc-update-fail\0step-chg-soc-update-req\0fg-fvcal-qualified\0vph-alarm\0vph-drop-prechg";
					};

					qcom,dcdc@1100 {
						reg = <0x1100>;
						interrupts = <0x02 0x11 0x00 0x01 0x02 0x11 0x01 0x01 0x02 0x11 0x02 0x01 0x02 0x11 0x03 0x03 0x02 0x11 0x04 0x03 0x02 0x11 0x05 0x03 0x02 0x11 0x06 0x01 0x02 0x11 0x07 0x03>;
						interrupt-names = "otg-fail\0otg-oc-disable-sw\0otg-oc-hiccup\0bsm-active\0high-duty-cycle\0input-current-limiting\0concurrent-mode-disable\0switcher-power-ok";
					};

					qcom,batif@1200 {
						reg = <0x1200>;
						interrupts = <0x02 0x12 0x00 0x01 0x02 0x12 0x02 0x03 0x02 0x12 0x03 0x03 0x02 0x12 0x04 0x03 0x02 0x12 0x05 0x03 0x02 0x12 0x06 0x03 0x02 0x12 0x07 0x03>;
						interrupt-names = "bat-temp\0bat-ov\0bat-low\0bat-therm-or-id-missing\0bat-terminal-missing\0buck-oc\0vph-ov";
					};

					qcom,usb@1300 {
						reg = <0x1300>;
						interrupts = <0x02 0x13 0x00 0x03 0x02 0x13 0x01 0x03 0x02 0x13 0x02 0x03 0x02 0x13 0x03 0x03 0x02 0x13 0x04 0x03 0x02 0x13 0x05 0x03 0x02 0x13 0x06 0x01 0x02 0x13 0x07 0x01>;
						interrupt-names = "usbin-collapse\0usbin-vashdn\0usbin-uv\0usbin-ov\0usbin-plugin\0usbin-revi-change\0usbin-src-change\0usbin-icl-change";
					};

					qcom,dc@1400 {
						reg = <0x1400>;
						interrupts = <0x02 0x14 0x01 0x03 0x02 0x14 0x02 0x03 0x02 0x14 0x03 0x03 0x02 0x14 0x04 0x03 0x02 0x14 0x05 0x03 0x02 0x14 0x06 0x01 0x02 0x14 0x07 0x01>;
						interrupt-names = "dcin-vashdn\0dcin-uv\0dcin-ov\0dcin-plugin\0dcin-revi\0dcin-pon\0dcin-en";
					};

					qcom,typec@1500 {
						reg = <0x1500>;
						interrupts = <0x02 0x15 0x00 0x01 0x02 0x15 0x01 0x01 0x02 0x15 0x02 0x01 0x02 0x15 0x03 0x01 0x02 0x15 0x04 0x01 0x02 0x15 0x05 0x01 0x02 0x15 0x06 0x01 0x02 0x15 0x07 0x01>;
						interrupt-names = "typec-or-rid-detect-change\0typec-vpd-detect\0typec-cc-state-change\0typec-vconn-oc\0typec-vbus-change\0typec-attach-detach\0typec-legacy-cable-detect\0typec-try-snk-src-detect";
					};

					qcom,misc@1600 {
						reg = <0x1600>;
						interrupts = <0x02 0x16 0x00 0x01 0x02 0x16 0x01 0x01 0x02 0x16 0x02 0x01 0x02 0x16 0x03 0x01 0x02 0x16 0x04 0x03 0x02 0x16 0x05 0x01 0x02 0x16 0x06 0x01 0x02 0x16 0x07 0x01>;
						interrupt-names = "wdog-snarl\0wdog-bark\0aicl-fail\0aicl-done\0smb-en\0imp-trigger\0temp-change\0temp-change-smb";
					};

					qcom,chg-sdam@b000 {
						reg = <0xb000>;
					};

					qcom,smb5-vbus {
						regulator-name = "smb5-vbus";
						phandle = <0x12>;
					};

					qcom,smb5-vconn {
						regulator-name = "smb5-vconn";
						phandle = <0x13>;
					};
				};

				qcom,usb-pdphy@1700 {
					compatible = "qcom,qpnp-pdphy";
					reg = <0x1700>;
					interrupts = <0x02 0x17 0x00 0x01 0x02 0x17 0x01 0x01 0x02 0x17 0x02 0x01 0x02 0x17 0x03 0x01 0x02 0x17 0x04 0x01 0x02 0x17 0x05 0x01 0x02 0x17 0x06 0x01 0x02 0x17 0x07 0x01>;
					interrupt-names = "sig-tx\0sig-rx\0msg-tx\0msg-rx\0msg-tx-failed\0msg-tx-discarded\0msg-rx-discarded\0fr-swap";
					#io-channel-cells = <0x01>;
					qcom,default-sink-caps = <0x1388 0xbb8 0x2328 0xbb8 0x2ee0 0x8ca>;
					vdd-pdphy-supply = <0xffffffff>;
					vbus-supply = <0x12>;
					vconn-supply = <0x13>;
					mi,pd_curr_limit = <0x01>;
					mi,pd_max_curr_limit = "\0=\t";
					mi,limit_pd_unverified_pps_vbus = <0x01>;
					mi,pd_unverified_pps_max_vbus_limit = <0x90f560>;
					io-channels = <0x10 0x04 0x10 0x03 0x10 0x0d 0x10 0x02 0x10 0x1f 0x10 0x1d 0x10 0x1e 0x10 0x00 0x10 0x20 0x10 0x0c 0x10 0x0b 0x10 0x0a 0x10 0x01 0x10 0x07>;
					io-channel-names = "pd_active\0typec_cc_orientation\0connector_type\0typec_power_role\0pd_usb_suspend_supported\0typec_src_rp\0pd_in_hard_reset\0pr_current_max\0pr_swap\0pd_voltage_min\0pd_voltage_max\0real_type\0typec_mode\0pe_start";
					phandle = <0x26>;
				};

				qcom,temp-alarm@2400 {
					compatible = "qcom,spmi-temp-alarm";
					reg = <0x2400>;
					interrupts = <0x02 0x24 0x00 0x03>;
					io-channels = <0x0b 0x06>;
					io-channel-names = "thermal";
					#thermal-sensor-cells = <0x00>;
					qcom,temperature-threshold-set = <0x01>;
					phandle = <0x15>;
				};

				qpnp,qg {
					compatible = "qcom,pm7250b-qg";
					depends-on-supply = <0xffffffff>;
					#address-cells = <0x01>;
					#size-cells = <0x01>;
					qcom,vbatt-cutoff-mv = <0xd48>;
					qcom,vbatt-low-mv = <0xdac>;
					qcom,vbatt-low-cold-mv = <0xed8>;
					qcom,vbatt-empty-mv = <0xbb8>;
					qcom,vbatt-empty-cold-mv = <0xbb8>;
					qcom,s3-entry-fifo-length = <0x02>;
					qcom,soc_decimal_rate = <0x00 0x20 0x0a 0x1e 0x14 0x1c 0x1e 0x1c 0x28 0x1c 0x32 0x1c 0x3c 0x1c 0x46 0x1c 0x50 0x1c 0x5a 0x1a 0x5f 0x0a 0x63 0x05>;
					status = "ok";
					#io-channel-cells = <0x01>;
					io-channels = <0x0b 0x2a 0x0b 0x4b 0x10 0x37 0x10 0x3f 0x10 0x40 0x10 0x39 0x0d 0x76 0x0d 0x94 0x0f 0x76 0x0f 0x94 0x10 0x0a>;
					io-channel-names = "batt-therm\0batt-id\0input_current_limited\0recharge_soc\0force_recharge\0charge_done\0charging_enabled\0sc_battery_voltage\0bq_charging_enabled\0bq_battery_voltage\0real_type";
					qcom,battery-data = <0x11>;
					qcom,qg-iterm-ma = <0x12c>;
					qcom,hold-soc-while-full;
					qcom,linearize-soc;
					qcom,cl-feedback-on;
					qcom,tcss-enable;
					qcom,fvss-enable;
					qcom,fvss-vbatt-mv = <0xe10>;
					qcom,bass-enable;
					qcom,s3-entry-ibat-ua = <0x61a8>;
					qcom,s3-exit-ibat-ua = <0xafc8>;
					qcom,qg-ext-sns;
					qcom,shutdown-delay-enable;
					phandle = <0x0c>;

					qcom,qgauge@4800 {
						status = "okay";
						reg = <0x4800>;
						interrupts = <0x02 0x48 0x00 0x03 0x02 0x48 0x01 0x03 0x02 0x48 0x02 0x01 0x02 0x48 0x03 0x01 0x02 0x48 0x04 0x01>;
						interrupt-names = "qg-batt-missing\0qg-vbat-low\0qg-vbat-empty\0qg-fifo-done\0qg-good-ocv";
					};

					qcom,qg-sdam@b100 {
						status = "okay";
						reg = <0xb100>;
					};
				};

				clock-controller@5b00 {
					compatible = "qcom,spmi-clkdiv";
					reg = <0x5b00>;
					#clock-cells = <0x01>;
					qcom,num-clkdivs = <0x01>;
					clock-output-names = "pm7250b_div_clk1";
					clocks = <0xffffffff 0x00>;
					clock-names = "xo";
					assigned-clocks = <0x14 0x01>;
					assigned-clock-rates = <0x124f800>;
					phandle = <0x14>;
				};

				pinctrl@c000 {
					compatible = "qcom,pm7250b-gpio";
					reg = <0xc000>;
					gpio-controller;
					#gpio-cells = <0x02>;
					interrupt-controller;
					#interrupt-cells = <0x02>;
					phandle = <0x2d>;

					disp_lcd_bias_en {

						disp_lcd_bias_en_default {
							pins = "gpio5";
							function = "func1";
							input-disable;
							output-enable;
							bias-disable;
							power-source = <0x00>;
							qcom,drive-strength = <0x02>;
							phandle = <0x2e>;
						};
					};

					pm7250b_smb_int_default {
						pins = "gpio6";
						function = "gpio";
						input-enable;
						bias-pull-up;
						qcom,pull-up-strength = <0x00>;
						power-source = <0x00>;
						phandle = <0x23>;
					};
				};

				vadc@3100 {
					compatible = "qcom,spmi-adc5";
					reg = <0x3100>;
					reg-names = "adc5-usr-base";
					#address-cells = <0x01>;
					#size-cells = <0x00>;
					interrupts = <0x02 0x31 0x00 0x01>;
					interrupt-names = "eoc-int-en-set";
					qcom,adc-vdd-reference = <0x753>;
					#io-channel-cells = <0x01>;
					io-channel-ranges;
					phandle = <0x0b>;

					ref_gnd@0 {
						reg = <0x00>;
						label = "ref_gnd";
						qcom,pre-scaling = <0x01 0x01>;
					};

					vref_1p25@1 {
						reg = <0x01>;
						label = "vref_1p25";
						qcom,pre-scaling = <0x01 0x01>;
					};

					die_temp@2 {
						reg = <0x06>;
						label = "die_temp";
						qcom,pre-scaling = <0x01 0x01>;
					};

					vph_pwr@83 {
						reg = <0x83>;
						label = "vph_pwr";
						qcom,pre-scaling = <0x01 0x03>;
					};

					vbat_sns@84 {
						reg = <0x84>;
						label = "vbat_sns";
						qcom,pre-scaling = <0x01 0x03>;
					};

					usb_in_i_uv@7 {
						reg = <0x07>;
						label = "usb_in_i_uv";
						qcom,pre-scaling = <0x01 0x01>;
					};

					usb_in_v_div_16@8 {
						reg = <0x08>;
						label = "usb_in_v_div_16";
						qcom,pre-scaling = <0x01 0x10>;
					};

					chg_temp@9 {
						reg = <0x09>;
						label = "chg_temp";
						qcom,pre-scaling = <0x01 0x01>;
					};

					bat_therm@4a {
						reg = <0x4a>;
						label = "bat_therm";
						qcom,ratiometric;
						qcom,hw-settle-time = <0xc8>;
						qcom,pre-scaling = <0x01 0x01>;
					};

					bat_therm_30k@2a {
						reg = <0x2a>;
						label = "bat_therm_30k";
						qcom,ratiometric;
						qcom,hw-settle-time = <0xc8>;
						qcom,pre-scaling = <0x01 0x01>;
					};

					bat_therm_400k@6a {
						reg = <0x6a>;
						label = "bat_therm_400k";
						qcom,ratiometric;
						qcom,hw-settle-time = <0xc8>;
						qcom,pre-scaling = <0x01 0x01>;
					};

					bat_id@4b {
						reg = <0x4b>;
						label = "bat_id";
						qcom,ratiometric;
						qcom,hw-settle-time = <0xc8>;
						qcom,pre-scaling = <0x01 0x01>;
					};

					smb1390_therm@e {
						reg = <0x0e>;
						label = "smb1390_therm";
						qcom,hw-settle-time = <0xc8>;
						qcom,pre-scaling = <0x01 0x01>;
					};

					chg_sbux@99 {
						reg = <0x99>;
						label = "chg_sbux";
						qcom,pre-scaling = <0x01 0x03>;
					};

					mid_chg_div6@1e {
						reg = <0x1e>;
						label = "chg_mid";
						qcom,pre-scaling = <0x01 0x06>;
					};

					charger_skin_therm@4d {
						reg = <0x4d>;
						label = "charger_skin_therm";
						qcom,ratiometric;
						qcom,hw-settle-time = <0xc8>;
						qcom,pre-scaling = <0x01 0x01>;
					};

					conn_therm@4f {
						reg = <0x4f>;
						label = "conn_therm";
						qcom,ratiometric;
						qcom,hw-settle-time = <0xc8>;
						qcom,pre-scaling = <0x01 0x01>;
					};
				};

				adc_tm@3500 {
					compatible = "qcom,spmi-adc-tm5";
					reg = <0x3500>;
					interrupts = <0x02 0x35 0x00 0x01>;
					interrupt-names = "pm-adc-tm5";
					#address-cells = <0x01>;
					#size-cells = <0x00>;
					#thermal-sensor-cells = <0x01>;
					status = "ok";
					phandle = <0x17>;

					charger_skin_therm@4d {
						reg = <0x00>;
						io-channels = <0x0b 0x4d>;
						qcom,ratiometric;
						qcom,hw-settle-time-us = <0xc8>;
					};

					conn_therm@4f {
						reg = <0x01>;
						io-channels = <0x0b 0x4f>;
						qcom,ratiometric;
						qcom,hw-settle-time-us = <0xc8>;
					};
				};

				bcl@1d00 {
					compatible = "qcom,bcl-v5";
					reg = <0x1d00>;
					interrupts = <0x02 0x1d 0x00 0x00 0x02 0x1d 0x01 0x00 0x02 0x1d 0x02 0x00>;
					interrupt-names = "bcl-lvl0\0bcl-lvl1\0bcl-lvl2";
					#thermal-sensor-cells = <0x01>;
					phandle = <0x16>;
				};

				bcl-soc {
					compatible = "qcom,msm-bcl-soc";
					#thermal-sensor-cells = <0x00>;
					phandle = <0x2f>;
				};
			};

			qcom,pm7250b@3 {
				compatible = "qcom,spmi-pmic";
				reg = <0x03 0x00>;
				#address-cells = <0x01>;
				#size-cells = <0x00>;

				qcom,vibrator@5300 {
					compatible = "qcom,qpnp-vibrator-ldo";
					reg = <0x5300>;
					qcom,vib-ldo-volt-uv = <0x2dc6c0>;
					qcom,disable-overdrive;
					phandle = <0x30>;
				};
			};
		};
	};

	fragment@16 {
		target = <0xffffffff>;

		__overlay__ {

			pm7250b-tz {
				polling-delay-passive = <0x64>;
				polling-delay = <0x00>;
				thermal-sensors = <0x15>;
				phandle = <0x31>;

				trips {

					trip0 {
						temperature = <0x17318>;
						hysteresis = <0x00>;
						type = "passive";
						phandle = <0x18>;
					};

					trip1 {
						temperature = <0x1c138>;
						hysteresis = <0x00>;
						type = "passive";
						phandle = <0x19>;
					};

					trip2 {
						temperature = <0x23668>;
						hysteresis = <0x00>;
						type = "passive";
					};
				};
			};

			pm7250b-ibat-lvl0 {
				polling-delay-passive = <0x00>;
				polling-delay = <0x00>;
				thermal-sensors = <0x16 0x00>;

				trips {

					ibat-lvl0 {
						temperature = <0x157c>;
						hysteresis = <0xc8>;
						type = "passive";
						phandle = <0x32>;
					};
				};
			};

			pm7250b-ibat-lvl1 {
				polling-delay-passive = <0x00>;
				polling-delay = <0x00>;
				thermal-sensors = <0x16 0x01>;

				trips {

					ibat-lvl1 {
						temperature = <0x1770>;
						hysteresis = <0xc8>;
						type = "passive";
						phandle = <0x33>;
					};
				};
			};

			pm7250b-bcl-lvl0 {
				polling-delay-passive = <0x64>;
				polling-delay = <0x00>;
				thermal-sensors = <0x16 0x05>;

				trips {

					b-bcl-lvl0 {
						temperature = <0x01>;
						hysteresis = <0x01>;
						type = "passive";
						phandle = <0x1b>;
					};
				};
			};

			pm7250b-bcl-lvl1 {
				polling-delay-passive = <0x64>;
				polling-delay = <0x00>;
				thermal-sensors = <0x16 0x06>;

				trips {

					b-bcl-lvl1 {
						temperature = <0x01>;
						hysteresis = <0x01>;
						type = "passive";
						phandle = <0x1c>;
					};
				};
			};

			pm7250b-bcl-lvl2 {
				polling-delay-passive = <0x64>;
				polling-delay = <0x00>;
				thermal-sensors = <0x16 0x07>;

				trips {

					b-bcl-lvl2 {
						temperature = <0x01>;
						hysteresis = <0x01>;
						type = "passive";
						phandle = <0x1d>;
					};
				};
			};

			socd {
				polling-delay-passive = <0x64>;
				polling-delay = <0x00>;

				trips {

					thermal-engine-trip {
						temperature = <0x64>;
						hysteresis = <0x00>;
						type = "passive";
					};

					thermal-hal-trip {
						temperature = <0x64>;
						hysteresis = <0x00>;
						type = "passive";
					};

					soc-trip {
						temperature = <0x5a>;
						hysteresis = <0x00>;
						type = "passive";
						phandle = <0x1a>;
					};
				};
			};
		};
	};

	fragment@17 {
		target = <0xffffffff>;

		__overlay__ {

			charger-therm-usr {
				polling-delay-passive = <0x00>;
				polling-delay = <0x00>;
				thermal-governor = "user_space";
				thermal-sensors = <0x17 0x00>;
				wake-capable-sensor;

				trips {

					active-config0 {
						temperature = <0x1e848>;
						hysteresis = <0x3e8>;
						type = "passive";
					};
				};
			};

			conn-therm-usr {
				polling-delay-passive = <0x00>;
				polling-delay = <0x00>;
				thermal-governor = "user_space";
				thermal-sensors = <0x17 0x01>;
				wake-capable-sensor;

				trips {

					active-config0 {
						temperature = <0x1e848>;
						hysteresis = <0x3e8>;
						type = "passive";
					};
				};
			};
		};
	};

	fragment@18 {
		target = <0xffffffff>;

		__overlay__ {

			pm7250b-tz {

				cooling-maps {

					trip0_bat {
						trip = <0x18>;
						cooling-device = <0x10 0x09 0x09>;
					};

					trip1_bat {
						trip = <0x19>;
						cooling-device = <0x10 0x0a 0x0a>;
					};
				};
			};

			socd {

				cooling-maps {

					soc_cpu4 {
						trip = <0x1a>;
						cooling-device = <0xffffffff 0x01 0x01>;
					};

					soc_cpu5 {
						trip = <0x1a>;
						cooling-device = <0xffffffff 0x01 0x01>;
					};

					soc_cpu6 {
						trip = <0x1a>;
						cooling-device = <0xffffffff 0x01 0x01>;
					};

					soc_cpu7 {
						trip = <0x1a>;
						cooling-device = <0xffffffff 0x01 0x01>;
					};
				};
			};

			pm7250b-bcl-lvl0 {

				cooling-maps {

					lbat0_cpufreq4 {
						trip = <0x1b>;
						cooling-device = <0xffffffff 0x02 0x02>;
					};

					lbat0_cpu6 {
						trip = <0x1b>;
						cooling-device = <0xffffffff 0x01 0x01>;
					};

					lbat0_cpu7 {
						trip = <0x1b>;
						cooling-device = <0xffffffff 0x01 0x01>;
					};

					lbat0_gpu {
						trip = <0x1b>;
						cooling-device = <0xffffffff 0x02 0x02>;
					};

					lbat0_cdsp {
						trip = <0x1b>;
						cooling-device = <0xffffffff 0x02 0x02>;
					};
				};
			};

			pm7250b-bcl-lvl1 {

				cooling-maps {

					lbat1_cpu4 {
						trip = <0x1c>;
						cooling-device = <0xffffffff 0x01 0x01>;
					};

					lbat1_cpu5 {
						trip = <0x1c>;
						cooling-device = <0xffffffff 0x01 0x01>;
					};

					lbat1_gpu {
						trip = <0x1c>;
						cooling-device = <0xffffffff 0x04 0x04>;
					};

					lbat1_cdsp {
						trip = <0x1c>;
						cooling-device = <0xffffffff 0x04 0x04>;
					};
				};
			};

			pm7250b-bcl-lvl2 {

				cooling-maps {

					lbat2_gpu {
						trip = <0x1d>;
						cooling-device = <0xffffffff 0x04 0xffffffff>;
					};

					lbat2_cdsp {
						trip = <0x1d>;
						cooling-device = <0xffffffff 0x04 0x04>;
					};
				};
			};
		};
	};

	fragment@19 {
		target = <0xffffffff>;

		__overlay__ {

			onewire_gpio {
				compatible = "xiaomi,onewire_gpio";
				label = "xm_onewire";
				xiaomi,version = <0x01>;
				onewire-gpio = <0xffffffff 0x42 0x00>;
				xiaomi,gpio_number = <0x42>;
				pinctrl-names = "default\0sleep";
				pinctrl-0 = <0x1e>;
				pinctrl-1 = <0x1f>;
				status = "ok";
				phandle = <0x34>;
			};

			maxim_ds28e30 {
				#io-channel-cells = <0x01>;
				compatible = "maxim,ds28e30";
				label = "max_ds28e30";
				maxim,version = <0x01>;
				status = "ok";
				phandle = <0x20>;
			};

			acl_slg {
				compatible = "acl,slg";
				status = "okay";
				def-supply = <0x20>;
				phandle = <0x21>;
			};

			st_stick {
				compatible = "st,stick";
				status = "okay";
				def-supply = <0x20 0x21>;
				phandle = <0x22>;
			};

			auth_battery {
				compatible = "lc,auth-battery";
				status = "okay";
				#io-channel-cells = <0x01>;
				def-supply = <0x20 0x21 0x22>;
				phandle = <0x0e>;
			};
		};
	};

	fragment@20 {
		target = <0xffffffff>;

		__overlay__ {

			onewire_gpio_active {
				phandle = <0x1e>;

				mux {
					pins = "gpio66";
					function = "gpio";
				};

				config {
					pins = "gpio66";
					drive-strength = <0x10>;
					bias-pull-up;
				};
			};

			onewire_gpio_sleep {
				phandle = <0x1f>;

				mux {
					pins = "gpio66";
					function = "gpio";
				};

				config {
					pins = "gpio66";
					drive-strength = <0x10>;
					bias-pull-up;
				};
			};
		};
	};

	fragment@21 {
		target = <0xffffffff>;

		__overlay__ {

			xm_smart_chg {
				compatible = "xiaomi,xm_smart_chg";
				status = "ok";
				label = "smart_charging";
				xiaomi,pd-thermal-mitigation = <0x5aca30 0x5265c0 0x4c4b40 0x44aa20 0x3d0900 0x387520 0x3567e0 0x2dc6c0 0x2ab980 0x2625a0 0x1e8480 0x16e360 0xf4240 0xc3500 0x7a120 0x55730 0xc3500 0xc3500>;
				xiaomi,pd-thermal-mitigation-fast = <0x5b8d80 0x5aca30 0x5aca30 0x5265c0 0x4c4b40 0x44aa20 0x3d0900 0x387520 0x2ab980 0x2625a0 0x1e8480 0x16e360 0xf4240 0xc3500 0x7a120 0x55730 0xc3500 0xc3500>;
				io-channels = <0x0c 0x42 0x10 0x04 0x0c 0x43>;
				io-channel-names = "capacity\0pd_active\0capacity_raw";
				phandle = <0x35>;
			};
		};
	};

	fragment@22 {
		target = <0xffffffff>;

		__overlay__ {

			qcom,battery-data {
				qcom,batt-id-range-pct = <0x0f>;
				phandle = <0x11>;

				qcom,qbg-battery-profile-guanyu-5000mAh {
					qcom,max-voltage-uv = <0x44aa20>;
					qcom,fg-cc-cv-threshold-uv = <0x44aa20>;
					qcom,fastchg-current-ma = <0x1770>;
					qcom,batt-id-kohm = <0x64>;
					qcom,battery-beta = <0xd34>;
					qcom,battery-therm-kohm = <0x0a>;
					qcom,battery-type = "qbg-battery-profile-guanyu-5000mAh-new";
					qcom,qg-batt-profile-ver = <0x64>;
					qcom,jeita-fcc-ranges = <0xffffff9c 0x00 0x61a80 0x00 0x32 0xcf850 0x32 0x64 0x231860 0x64 0x96 0x387520 0x96 0x15e 0x5b8d80 0x15e 0x1e0 0x5b8d80 0x1e0 0x230 0x231860 0x230 0x5dc 0x00>;
					qcom,jeita-fv-ranges = <0xffffff9c 0x00 0x440de0 0x00 0x32 0x445c00 0x32 0x64 0x445c00 0x64 0x96 0x445c00 0x96 0x15e 0x43e6d0 0x15e 0x1e0 0x43e6d0 0x1e0 0x230 0x3e8fa0 0x230 0x5dc 0x3e8fa0>;
					qcom,step-chg-ranges = <0x36ee80 0x40d990 0x5b8d80 0x40d991 0x445c00 0x5265c0 0x445c01 0x44aa20 0x3bd080>;
					qcom,vbat-avg-based-step-chg;
					qcom,taper-fcc;
					qcom,jeita-soft-thresholds = <0x2554 0xe8d>;
					qcom,jeita-hard-thresholds = <0x43d5 0xb9b>;
					qcom,jeita-soft-hys-thresholds = <0x225f 0xfdc>;
					qcom,jeita-soft-fcc-ua = <0x5265c0 0x2625a0>;
					qcom,jeita-soft-fv-uv = <0x445c00 0x3e8fa0>;

					qcom,fcc1-temp-lut {
						qcom,lut-col-legend = <0x00 0x0a 0x19 0x28 0x32>;
						qcom,lut-data = <0x13cd 0x1401 0x146c 0x1491 0x149a>;
					};

					qcom,fcc2-temp-lut {
						qcom,lut-col-legend = <0xfffffff6 0x00 0x0a 0x19 0x28 0x32>;
						qcom,lut-data = <0x13f2 0x141c 0x141c 0x1480 0x147c 0x1473>;
					};

					qcom,pc-temp-v1-lut {
						qcom,lut-col-legend = <0x00 0x0a 0x19 0x28 0x32>;
						qcom,lut-row-legend = <0x2710 0x2648 0x2580 0x24b8 0x23f0 0x2328 0x2260 0x2198 0x20d0 0x2008 0x1f40 0x1e78 0x1db0 0x1ce8 0x1c20 0x1b58 0x1a90 0x19c8 0x1900 0x1838 0x1770 0x16a8 0x15e0 0x1518 0x1450 0x1388 0x12c0 0x11f8 0x1130 0x1068 0xfa0 0xed8 0xe10 0xd48 0xc80 0xbb8 0xaf0 0xa28 0x960 0x898 0x7d0 0x708 0x640 0x578 0x4b0 0x3e8 0x384 0x320 0x2bc 0x258 0x1f4 0x190 0x12c 0xc8 0x64 0x00>;
						qcom,lut-data = <0xaf01 0xaf5c 0xaf99 0xafb8 0xafc0 0xadb1 0xadce 0xaded 0xae01 0xae12 0xacb4 0xacc2 0xacc4 0xacbb 0xacc3 0xabcb 0xabea 0xabd5 0xabc2 0xabc3 0xaae4 0xab0c 0xaafb 0xaae5 0xaae4 0xaa03 0xaa28 0xaa19 0xaa05 0xaa06 0xa915 0xa940 0xa930 0xa919 0xa91c 0xa819 0xa84b 0xa840 0xa828 0xa82c 0xa719 0xa74e 0xa744 0xa72e 0xa735 0xa61a 0xa650 0xa641 0xa62e 0xa638 0xa51a 0xa550 0xa53e 0xa52e 0xa53a 0xa41f 0xa451 0xa439 0xa42e 0xa438 0xa327 0xa356 0xa33b 0xa331 0xa338 0xa235 0xa25e 0xa243 0xa237 0xa241 0xa14c 0xa171 0xa152 0xa143 0xa151 0xa06a 0xa08c 0xa067 0xa058 0xa066 0x9f90 0x9fae 0x9f83 0x9f75 0x9f7f 0x9ebd 0x9ed9 0x9eab 0x9e9c 0x9ea2 0x9df4 0x9e0d 0x9ddf 0x9dcc 0x9dd0 0x9d38 0x9d4d 0x9d1a 0x9d03 0x9d05 0x9c82 0x9c96 0x9c68 0x9c4c 0x9c4b 0x9bca 0x9bd8 0x9bb3 0x9b9b 0x9b9a 0x9b15 0x9b15 0x9ac4 0x9abf 0x9aca 0x9a4b 0x9a45 0x999f 0x99a2 0x99c4 0x993f 0x9943 0x98ba 0x98b7 0x98dd 0x983a 0x982d 0x9810 0x981f 0x983c 0x979b 0x9788 0x9788 0x97a3 0x97b4 0x972a 0x972c 0x9722 0x9730 0x9734 0x96d1 0x96dd 0x96cd 0x96ca 0x96bf 0x968a 0x968b 0x967b 0x9667 0x9654 0x964d 0x963d 0x962b 0x9607 0x95f5 0x9610 0x95f0 0x95df 0x95af 0x959e 0x95d7 0x95a3 0x9594 0x9564 0x9550 0x959f 0x9560 0x954f 0x9520 0x9508 0x9569 0x9528 0x9514 0x94e0 0x94c5 0x9538 0x94f7 0x94e1 0x94a4 0x948a 0x950f 0x94ce 0x94b2 0x9469 0x9448 0x94ec 0x94ab 0x9489 0x9435 0x93fe 0x94bd 0x947e 0x9458 0x93f8 0x93ac 0x947c 0x9438 0x9405 0x93a1 0x9354 0x942a 0x93e0 0x9396 0x9332 0x92f3 0x93bb 0x9378 0x931f 0x92b9 0x9282 0x932d 0x92f8 0x929a 0x9232 0x91f9 0x928c 0x9258 0x91f8 0x9195 0x915a 0x91df 0x91a5 0x9155 0x90f9 0x90be 0x9138 0x9102 0x90e8 0x9099 0x9065 0x90fe 0x90c6 0x90cc 0x9083 0x904e 0x90bf 0x90a2 0x90b6 0x9073 0x903f 0x907f 0x9073 0x90a0 0x9059 0x9027 0x9024 0x9039 0x9065 0x8ff6 0x8fb8 0x8ef4 0x8fa5 0x8f6c 0x8ebd 0x8e73 0x7fa0 0x8e09 0x8da3 0x8cda 0x8c8c 0x7c55 0x7e1a 0x8b33 0x8a65 0x8a12 0x79f7 0x797d 0x87ba 0x86f9 0x869e 0x7754 0x7698 0x81ea 0x8167 0x810d 0x7530 0x7530 0x7530 0x7530 0x7530>;
					};

					qcom,pc-temp-v2-lut {
						qcom,lut-col-legend = <0xfffffff6 0x00 0x0a 0x19 0x28 0x32>;
						qcom,lut-row-legend = <0x2710 0x2648 0x2580 0x24b8 0x23f0 0x2328 0x2260 0x2198 0x20d0 0x2008 0x1f40 0x1e78 0x1db0 0x1ce8 0x1c20 0x1b58 0x1a90 0x19c8 0x1900 0x1838 0x1770 0x16a8 0x15e0 0x1518 0x1450 0x1388 0x12c0 0x11f8 0x1130 0x1068 0xfa0 0xed8 0xe10 0xd48 0xc80 0xbb8 0xaf0 0xa28 0x960 0x898 0x7d0 0x708 0x640 0x578 0x4b0 0x3e8 0x384 0x320 0x2bc 0x258 0x1f4 0x190 0x12c 0xc8 0x64 0x00>;
						qcom,lut-data = <0xafcd 0xafbe 0xafaa 0xaf6e 0xaf5a 0xaf46 0xadd1 0xadee 0xadee 0xadda 0xadb6 0xada2 0xac2e 0xac6f 0xac7f 0xac83 0xac51 0xac3b 0xaaff 0xab59 0xab72 0xab78 0xab3c 0xab23 0xaa20 0xaa8e 0xaaa9 0xaaa3 0xaa5d 0xaa42 0xa949 0xa9c4 0xa9dd 0xa9c6 0xa97b 0xa95f 0xa85f 0xa8e0 0xa8f9 0xa8d8 0xa88d 0xa871 0xa773 0xa7f4 0xa80d 0xa7e5 0xa79b 0xa77f 0xa681 0xa702 0xa719 0xa6ea 0xa6a1 0xa685 0xa587 0xa608 0xa61b 0xa5e9 0xa5a1 0xa586 0xa48e 0xa50f 0xa51d 0xa4e9 0xa4a2 0xa487 0xa395 0xa416 0xa420 0xa3e6 0xa3a3 0xa389 0xa29f 0xa31e 0xa326 0xa2e8 0xa2a7 0xa28f 0xa1ba 0xa22c 0xa231 0xa1ee 0xa1b0 0xa19c 0xa0e2 0xa13e 0xa142 0xa0f9 0xa0bf 0xa0ae 0xa005 0xa05a 0xa059 0xa00d 0x9fd7 0x9fc6 0x9f20 0x9f86 0x9f74 0x9f28 0x9ef5 0x9ee5 0x9e31 0x9eb7 0x9e98 0x9e4d 0x9e1d 0x9e0d 0x9d2e 0x9de5 0x9dcc 0x9d7d 0x9d4f 0x9d3e 0x9c18 0x9d10 0x9d03 0x9cad 0x9c86 0x9c77 0x9b12 0x9c26 0x9c1d 0x9bde 0x9bc9 0x9bbf 0x9a21 0x9b0b 0x9b15 0x9b0c 0x9b0b 0x9b0b 0x993f 0x99f2 0x9a19 0x9a1f 0x9a27 0x9a2e 0x9865 0x9914 0x992e 0x9914 0x9914 0x991b 0x9796 0x9852 0x9859 0x9836 0x9835 0x9837 0x96e6 0x97a8 0x97ac 0x978f 0x9794 0x9797 0x9650 0x9712 0x971c 0x9702 0x970d 0x9710 0x95d1 0x9689 0x9699 0x9684 0x9693 0x9697 0x956d 0x960a 0x9621 0x9616 0x9625 0x962a 0x9519 0x9596 0x95b3 0x95af 0x95c0 0x95c5 0x94ce 0x952b 0x954e 0x954e 0x9565 0x9567 0x948a 0x94c5 0x94f0 0x94f6 0x9512 0x9511 0x944b 0x946d 0x949a 0x94a7 0x94c9 0x94c8 0x940d 0x942c 0x944a 0x945e 0x9484 0x9483 0x93d1 0x93f8 0x9401 0x9419 0x9437 0x9433 0x9390 0x93c6 0x93c1 0x93d8 0x93e6 0x93d7 0x934a 0x9397 0x9385 0x9390 0x938c 0x9373 0x92ff 0x9365 0x9345 0x933d 0x9321 0x92fc 0x92ac 0x9326 0x92ff 0x92e5 0x92b7 0x9286 0x9251 0x92dc 0x92af 0x928c 0x925e 0x9229 0x91ec 0x927c 0x9249 0x922c 0x9208 0x91d2 0x917a 0x91f8 0x91d1 0x91be 0x919f 0x9165 0x9100 0x9166 0x9142 0x913d 0x9125 0x90e9 0x9081 0x90c7 0x909d 0x90a6 0x9099 0x905f 0x9015 0x9033 0x9012 0x9018 0x9010 0x8fdf 0x8fac 0x8fc1 0x8fc5 0x8feb 0x8ff6 0x8fc2 0x8f79 0x8f8e 0x8f9e 0x8fd1 0x8fe2 0x8fb0 0x8f42 0x8f5f 0x8f6b 0x8fa7 0x8fc5 0x8f96 0x8f34 0x8f2b 0x8f26 0x8f58 0x8f8b 0x8f58 0x8eda 0x8eed 0x8e68 0x8e80 0x8ec2 0x8e90 0x8e38 0x8e84 0x8ce0 0x8cb1 0x8d10 0x8cd2 0x8dc1 0x8daa 0x8a8f 0x8a1b 0x8ac1 0x8a94 0x8a4f 0x8db4 0x8781 0x864e 0x87af 0x8794 0x7a6a 0x8bff 0x84a3 0x8218 0x8305 0x832b 0x7638 0x77c9 0x7ef6 0x8025 0x7bf3 0x7ba8 0x7244 0x728c 0x6dd8 0x718c 0x6bdd 0x6b8b>;
					};

					qcom,pc-temp-z1-lut {
						qcom,lut-col-legend = <0x00 0x0a 0x19 0x28 0x32>;
						qcom,lut-row-legend = <0x2710 0x2648 0x2580 0x24b8 0x23f0 0x2328 0x2260 0x2198 0x20d0 0x2008 0x1f40 0x1e78 0x1db0 0x1ce8 0x1c20 0x1b58 0x1a90 0x19c8 0x1900 0x1838 0x1770 0x16a8 0x15e0 0x1518 0x1450 0x1388 0x12c0 0x11f8 0x1130 0x1068 0xfa0 0xed8 0xe10 0xd48 0xc80 0xbb8 0xaf0 0xa28 0x960 0x898 0x7d0 0x708 0x640 0x578 0x4b0 0x3e8 0x384 0x320 0x2bc 0x258 0x1f4 0x190 0x12c 0xc8 0x64 0x00>;
						qcom,lut-data = <0x2cb1 0x2ae9 0x2999 0x28f4 0x28a9 0x2cde 0x2b24 0x29d4 0x2926 0x28ef 0x2cdf 0x2b22 0x29d7 0x2928 0x28f0 0x2ce0 0x2b2c 0x29d2 0x2920 0x28eb 0x2ce9 0x2b33 0x29d3 0x291e 0x28eb 0x2cfc 0x2b37 0x29d3 0x291e 0x28eb 0x2d00 0x2b3a 0x29d0 0x291e 0x28eb 0x2ced 0x2b38 0x29cc 0x291e 0x28ec 0x2cd9 0x2b32 0x29c7 0x291d 0x28ec 0x2cd1 0x2b2d 0x29c3 0x291a 0x28ed 0x2ccb 0x2b26 0x29c3 0x2919 0x28ed 0x2cc6 0x2b21 0x29c3 0x2919 0x28ed 0x2cc2 0x2b1e 0x29c4 0x291a 0x28ee 0x2cc0 0x2b1c 0x29c4 0x291a 0x28ee 0x2cca 0x2b1c 0x29c4 0x291b 0x28f1 0x2cdd 0x2b1e 0x29c6 0x291d 0x28f3 0x2cde 0x2b1f 0x29cb 0x291f 0x28f5 0x2cd2 0x2b1d 0x29d0 0x2922 0x28f7 0x2ccb 0x2b1b 0x29d6 0x2924 0x28f9 0x2ccc 0x2b1d 0x29d9 0x2927 0x28fc 0x2cd0 0x2b26 0x29d9 0x292a 0x28ff 0x2cd4 0x2b2d 0x29d9 0x292d 0x2903 0x2cd9 0x2b33 0x29d9 0x292f 0x2904 0x2cdb 0x2b37 0x29dc 0x2930 0x2904 0x2cd7 0x2b37 0x29df 0x2931 0x2905 0x2cd1 0x2b36 0x29e4 0x2934 0x2906 0x2cd5 0x2b36 0x29e8 0x2939 0x2909 0x2ce5 0x2b3c 0x29eb 0x293c 0x290c 0x2cec 0x2b40 0x29ef 0x293f 0x2910 0x2ce7 0x2b40 0x29f2 0x2942 0x2913 0x2ce1 0x2b3e 0x29f5 0x2945 0x2916 0x2ce2 0x2b3f 0x29f9 0x2948 0x2919 0x2ce7 0x2b47 0x2a01 0x294d 0x291b 0x2ce8 0x2b4b 0x2a07 0x2952 0x291d 0x2cdf 0x2b4a 0x2a08 0x2953 0x2920 0x2cd6 0x2b48 0x2a07 0x2953 0x2923 0x2cdf 0x2b48 0x2a07 0x2953 0x2926 0x2cf7 0x2b49 0x2a0b 0x2958 0x2927 0x2cff 0x2b4b 0x2a11 0x295d 0x2928 0x2cf7 0x2b4b 0x2a19 0x2960 0x292a 0x2cf1 0x2b4c 0x2a23 0x2962 0x292c 0x2cf9 0x2b51 0x2a26 0x2965 0x292e 0x2d05 0x2b5b 0x2a27 0x296a 0x2930 0x2d06 0x2b6b 0x2a2b 0x296c 0x2933 0x2d06 0x2b70 0x2a30 0x296d 0x2935 0x2d15 0x2b65 0x2a33 0x2971 0x2938 0x2d28 0x2b69 0x2a37 0x2972 0x2939 0x2d04 0x2b59 0x2a35 0x2974 0x2939 0x2d04 0x2b5e 0x2a35 0x2977 0x293a 0x2cfd 0x2b5f 0x2a3e 0x297a 0x293d 0x2cfc 0x2b62 0x2a3e 0x297d 0x2941 0x2d08 0x2b5b 0x2a49 0x2981 0x2947 0x2d0e 0x2b57 0x2a57 0x298d 0x294e 0x2d0e 0x2b60 0x2a69 0x299a 0x2959 0x2d0e 0x2b60 0x2a69 0x299a 0x2959 0x2d0e 0x2b60 0x2a69 0x299a 0x2959>;
					};

					qcom,pc-temp-z2-lut {
						qcom,lut-col-legend = <0x00 0x0a 0x19 0x28 0x32>;
						qcom,lut-row-legend = <0x2710 0x2648 0x2580 0x24b8 0x23f0 0x2328 0x2260 0x2198 0x20d0 0x2008 0x1f40 0x1e78 0x1db0 0x1ce8 0x1c20 0x1b58 0x1a90 0x19c8 0x1900 0x1838 0x1770 0x16a8 0x15e0 0x1518 0x1450 0x1388 0x12c0 0x11f8 0x1130 0x1068 0xfa0 0xed8 0xe10 0xd48 0xc80 0xbb8 0xaf0 0xa28 0x960 0x898 0x7d0 0x708 0x640 0x578 0x4b0 0x3e8 0x384 0x320 0x2bc 0x258 0x1f4 0x190 0x12c 0xc8 0x64 0x00>;
						qcom,lut-data = <0x2654 0x29b4 0x2a70 0x2a32 0x2a31 0x2932 0x2a2e 0x2aa7 0x2b73 0x2a5a 0x2945 0x2a34 0x2acf 0x2be0 0x2ad6 0x2956 0x29f0 0x2a81 0x2b4a 0x2c09 0x2944 0x29b4 0x2a44 0x2b09 0x2bc7 0x2911 0x297f 0x2a08 0x2af5 0x2b95 0x28e6 0x2953 0x29c3 0x2af4 0x2ba3 0x28c1 0x292e 0x29a1 0x2af4 0x2bb8 0x28a4 0x2912 0x29b0 0x2af9 0x2bb3 0x2893 0x2912 0x29ca 0x2b0a 0x2b96 0x2886 0x2933 0x29db 0x2b18 0x2b8e 0x2887 0x2953 0x29e7 0x2b20 0x2bdd 0x28a3 0x2965 0x29f8 0x2b2b 0x2c26 0x28bf 0x2974 0x2a19 0x2b52 0x2bda 0x28cf 0x298a 0x2a3b 0x2b82 0x2b44 0x28dd 0x29a5 0x2a51 0x2b6c 0x2b2d 0x28ec 0x29c0 0x2a64 0x2af8 0x2b64 0x28fc 0x29d9 0x2a84 0x2ac7 0x2bb4 0x290e 0x29f0 0x2abc 0x2b12 0x2c59 0x2928 0x2a05 0x2ae8 0x2b78 0x2cf2 0x293f 0x2a19 0x2af7 0x2bb8 0x2d0a 0x2941 0x2a1e 0x2b06 0x2bf2 0x2d12 0x293d 0x2a12 0x2b3f 0x2c58 0x2d20 0x293b 0x2a08 0x2bb8 0x2d19 0x2d38 0x293e 0x2a0a 0x2bdd 0x2d78 0x2d5a 0x2943 0x2a10 0x2b7b 0x2cf8 0x2db7 0x2942 0x2a10 0x2b0c 0x2c5d 0x2e19 0x293f 0x29ff 0x2ad4 0x2c6f 0x2e16 0x293e 0x29f2 0x2aad 0x2cbe 0x2dd7 0x2946 0x2a08 0x2acd 0x2ccd 0x2d76 0x2950 0x2a2c 0x2b99 0x2c63 0x2c98 0x2950 0x2a35 0x2c0a 0x2bed 0x2bcd 0x294f 0x2a36 0x2b9e 0x2b9d 0x2b71 0x294f 0x2a37 0x2b1d 0x2b62 0x2b35 0x2957 0x2a2c 0x2b12 0x2b88 0x2b4a 0x2960 0x2a1e 0x2b12 0x2c49 0x2bf1 0x2960 0x2a1e 0x2b16 0x2cf6 0x2cd0 0x2960 0x2a26 0x2b4b 0x2d89 0x2e50 0x2960 0x2a2f 0x2b87 0x2de1 0x2f7d 0x2963 0x2a35 0x2bb1 0x2dd9 0x2f71 0x2967 0x2a3d 0x2bd1 0x2dbe 0x2f23 0x296b 0x2a47 0x2bc4 0x2da0 0x2e9c 0x2970 0x2a54 0x2b84 0x2d76 0x2d92 0x299e 0x2a62 0x2b76 0x2cb2 0x2d43 0x29a3 0x2ac2 0x2b7e 0x2bc0 0x2d27 0x2938 0x2b67 0x2bc6 0x2c0a 0x2ce1 0x26a1 0x2b4f 0x2bac 0x2bfb 0x2d08 0x2657 0x2b19 0x2b71 0x2c12 0x2d05 0x2607 0x2ae5 0x2b48 0x2c45 0x2dd6 0x2749 0x2a95 0x2b39 0x2d01 0x2db0 0x2d92 0x2a3c 0x2bfd 0x2ba9 0x2b5c 0xffff 0x29d4 0x2b90 0x2a63 0x2a5a 0xffff 0xffff 0x29fb 0x29f1 0x2a61 0x25eb 0x29e0 0x2967 0x2974 0x2a2f 0x25eb 0x29e0 0x2967 0x2974 0x2a2f 0x25eb 0x29e0 0x2967 0x2974 0x2a2f>;
					};

					qcom,pc-temp-z3-lut {
						qcom,lut-col-legend = <0x00 0x0a 0x19 0x28 0x32>;
						qcom,lut-row-legend = <0x2710 0x2648 0x2580 0x24b8 0x23f0 0x2328 0x2260 0x2198 0x20d0 0x2008 0x1f40 0x1e78 0x1db0 0x1ce8 0x1c20 0x1b58 0x1a90 0x19c8 0x1900 0x1838 0x1770 0x16a8 0x15e0 0x1518 0x1450 0x1388 0x12c0 0x11f8 0x1130 0x1068 0xfa0 0xed8 0xe10 0xd48 0xc80 0xbb8 0xaf0 0xa28 0x960 0x898 0x7d0 0x708 0x640 0x578 0x4b0 0x3e8 0x384 0x320 0x2bc 0x258 0x1f4 0x190 0x12c 0xc8 0x64 0x00>;
						qcom,lut-data = <0x4b3f 0x4b9a 0x4b91 0x4b79 0x4b76 0x4c76 0x4c40 0x4bd6 0x4b9e 0x4b7f 0x4cb9 0x4c64 0x4bf8 0x4b9a 0x4b7f 0x4cde 0x4c6c 0x4c1a 0x4bce 0x4bab 0x4ceb 0x4c73 0x4c1f 0x4bd1 0x4baf 0x4cf3 0x4c7a 0x4c1f 0x4bd1 0x4bb0 0x4cfa 0x4c7e 0x4c1c 0x4bce 0x4baf 0x4d02 0x4c7d 0x4c17 0x4bc8 0x4bac 0x4d06 0x4c7a 0x4c0b 0x4bc2 0x4ba7 0x4d03 0x4c74 0x4bfd 0x4bbb 0x4b9d 0x4cfa 0x4c5e 0x4bf6 0x4bb4 0x4b99 0x4cf0 0x4c4c 0x4bf2 0x4bad 0x4b99 0x4ce2 0x4c45 0x4bed 0x4ba6 0x4b98 0x4cd3 0x4c40 0x4be3 0x4ba2 0x4b91 0x4cc7 0x4c37 0x4bd8 0x4b9e 0x4b83 0x4cbc 0x4c2c 0x4bd1 0x4b97 0x4b7e 0x4cb2 0x4c23 0x4bcb 0x4b89 0x4b7c 0x4cab 0x4c1c 0x4bc4 0x4b81 0x4b7b 0x4ca3 0x4c18 0x4bb9 0x4b7e 0x4b79 0x4c99 0x4c16 0x4bb3 0x4b7c 0x4b76 0x4c91 0x4c15 0x4bb0 0x4b7a 0x4b73 0x4c91 0x4c15 0x4baf 0x4b79 0x4b6f 0x4c97 0x4c1b 0x4bb6 0x4b7b 0x4b6f 0x4c9f 0x4c23 0x4bcc 0x4b88 0x4b71 0x4cb1 0x4c2a 0x4bd3 0x4b8f 0x4b73 0x4cc3 0x4c31 0x4bca 0x4b80 0x4b69 0x4cc3 0x4c31 0x4bbd 0x4b6e 0x4b5a 0x4cbc 0x4c21 0x4bb2 0x4b6d 0x4b67 0x4cb4 0x4c15 0x4ba8 0x4b70 0x4b96 0x4cad 0x4c15 0x4ba7 0x4b76 0x4ba7 0x4ca6 0x4c15 0x4bae 0x4b93 0x4b9f 0x4ca1 0x4c17 0x4bb7 0x4ba7 0x4b93 0x4c9e 0x4c26 0x4bc9 0x4ba2 0x4b8a 0x4c9c 0x4c2f 0x4bda 0x4b98 0x4b82 0x4c9c 0x4c2d 0x4bd8 0x4b92 0x4b7b 0x4c9c 0x4c29 0x4bcf 0x4b8d 0x4b74 0x4c9a 0x4c24 0x4bc6 0x4b89 0x4b72 0x4c96 0x4c1e 0x4bbe 0x4b87 0x4b76 0x4c91 0x4c18 0x4bb9 0x4b86 0x4b7a 0x4c8a 0x4c15 0x4bb8 0x4b87 0x4b7a 0x4c82 0x4c12 0x4bb8 0x4b8a 0x4b79 0x4c7a 0x4c09 0x4bb7 0x4b89 0x4b76 0x4c6f 0x4bfc 0x4bb5 0x4b85 0x4b6e 0x4c5e 0x4bf6 0x4bb3 0x4b7e 0x4b71 0x4bff 0x4be8 0x4baf 0x4b78 0x4b78 0x4b8d 0x4bcf 0x4b9f 0x4b76 0x4b68 0x4b49 0x4bce 0x4b9d 0x4b73 0x4b66 0x4b4a 0x4b87 0x4b96 0x4b6e 0x4b62 0x4b4d 0x4b71 0x4b83 0x4b69 0x4b57 0x4b74 0x4b71 0x4b7b 0x4b66 0x4b57 0x4c44 0x4be4 0x4b6c 0x4b6d 0x4b71 0x4b41 0x4bf1 0x4b69 0x4b81 0x4b7d 0x4b3c 0x4b3f 0x4b7c 0x4b86 0x4b7f 0x52d4 0x51a7 0x4bc7 0x4b88 0x4b80 0x52d4 0x51a7 0x4bc7 0x4b88 0x4b80 0x52d4 0x51a7 0x4bc7 0x4b88 0x4b80>;
					};

					qcom,pc-temp-z4-lut {
						qcom,lut-col-legend = <0x00 0x0a 0x19 0x28 0x32>;
						qcom,lut-row-legend = <0x2710 0x2648 0x2580 0x24b8 0x23f0 0x2328 0x2260 0x2198 0x20d0 0x2008 0x1f40 0x1e78 0x1db0 0x1ce8 0x1c20 0x1b58 0x1a90 0x19c8 0x1900 0x1838 0x1770 0x16a8 0x15e0 0x1518 0x1450 0x1388 0x12c0 0x11f8 0x1130 0x1068 0xfa0 0xed8 0xe10 0xd48 0xc80 0xbb8 0xaf0 0xa28 0x960 0x898 0x7d0 0x708 0x640 0x578 0x4b0 0x3e8 0x384 0x320 0x2bc 0x258 0x1f4 0x190 0x12c 0xc8 0x64 0x00>;
						qcom,lut-data = <0x3c81 0x3b61 0x3a94 0x3a18 0x39f3 0x3e9f 0x3bd3 0x3a0e 0x399b 0x398b 0x3da4 0x3c05 0x3a41 0x3985 0x3973 0x3c72 0x3b42 0x3a76 0x39e0 0x39ae 0x3bcc 0x3ac2 0x3a37 0x39c8 0x399d 0x3b4d 0x3a79 0x3a0b 0x39af 0x398b 0x3aee 0x3a43 0x39ee 0x399d 0x397f 0x3aa4 0x3a18 0x39d8 0x3990 0x3975 0x3a6b 0x39f7 0x39c8 0x398a 0x3973 0x3a40 0x39e0 0x39bb 0x3987 0x3973 0x3a1e 0x39ce 0x39ae 0x3983 0x3971 0x39fe 0x39c1 0x39a3 0x397f 0x3967 0x39dc 0x39b5 0x3999 0x397b 0x395e 0x39c7 0x39ab 0x3993 0x3973 0x395f 0x39bf 0x39a4 0x398c 0x396b 0x3962 0x39ba 0x399f 0x3983 0x3969 0x3961 0x39b5 0x399a 0x3979 0x3969 0x3958 0x39b0 0x3992 0x3972 0x3968 0x394f 0x39ab 0x398a 0x396d 0x3960 0x3946 0x39a7 0x3981 0x3968 0x3955 0x393f 0x39a3 0x3978 0x3960 0x394e 0x393c 0x399e 0x3975 0x3958 0x3948 0x3939 0x3997 0x3978 0x3966 0x394f 0x393f 0x3994 0x397f 0x399a 0x3983 0x3970 0x39bd 0x39a5 0x39c3 0x39b1 0x399e 0x39f3 0x39eb 0x39e2 0x39ca 0x39b5 0x39fd 0x39fe 0x39f3 0x39d9 0x39c3 0x3a00 0x39fa 0x39f2 0x39d6 0x39b1 0x3a00 0x39f3 0x39ee 0x39c9 0x3972 0x39f6 0x39e7 0x39e6 0x39b4 0x3955 0x39e7 0x39d5 0x39d1 0x3985 0x3951 0x39d9 0x39c0 0x39b8 0x3962 0x394f 0x39cc 0x39a5 0x3995 0x3959 0x394b 0x39c0 0x3993 0x3978 0x3954 0x3947 0x39b5 0x398c 0x3970 0x3951 0x3946 0x39ac 0x3987 0x396c 0x394f 0x3945 0x39a5 0x3983 0x396b 0x394f 0x3946 0x399f 0x397e 0x396a 0x3951 0x394c 0x3999 0x397c 0x396a 0x3954 0x3953 0x3993 0x397d 0x3974 0x395b 0x3953 0x398d 0x397e 0x3985 0x3962 0x3953 0x3986 0x397c 0x3985 0x3963 0x3953 0x3980 0x3975 0x397a 0x3960 0x3953 0x397b 0x396e 0x3977 0x3963 0x3951 0x39a5 0x3960 0x3973 0x3969 0x3949 0x39f5 0x3955 0x395c 0x394e 0x3944 0x3a3a 0x3956 0x3955 0x3945 0x3939 0x3a3b 0x399c 0x3948 0x3935 0x392b 0x3a39 0x39ad 0x394a 0x392a 0x3926 0x3a19 0x39ac 0x3955 0x393a 0x3932 0x399e 0x394d 0x3985 0x3944 0x3924 0x4312 0x3998 0x3999 0x3933 0x391b 0x43be 0x4231 0x398c 0x3930 0x391c 0x3a45 0x3a7f 0x3946 0x3935 0x3922 0x3a45 0x3a7f 0x3946 0x3935 0x3922 0x3a45 0x3a7f 0x3946 0x3935 0x3922>;
					};

					qcom,pc-temp-z5-lut {
						qcom,lut-col-legend = <0x00 0x0a 0x19 0x28 0x32>;
						qcom,lut-row-legend = <0x2710 0x2648 0x2580 0x24b8 0x23f0 0x2328 0x2260 0x2198 0x20d0 0x2008 0x1f40 0x1e78 0x1db0 0x1ce8 0x1c20 0x1b58 0x1a90 0x19c8 0x1900 0x1838 0x1770 0x16a8 0x15e0 0x1518 0x1450 0x1388 0x12c0 0x11f8 0x1130 0x1068 0xfa0 0xed8 0xe10 0xd48 0xc80 0xbb8 0xaf0 0xa28 0x960 0x898 0x7d0 0x708 0x640 0x578 0x4b0 0x3e8 0x384 0x320 0x2bc 0x258 0x1f4 0x190 0x12c 0xc8 0x64 0x00>;
						qcom,lut-data = <0x2c87 0x31cd 0x34a1 0x37a5 0x3a57 0x37a5 0x4124 0x4867 0x4942 0x41cb 0x3c1c 0x41fd 0x4d49 0x54b4 0x4af2 0x3ffd 0x450b 0x4ac2 0x5036 0x5294 0x42bb 0x4817 0x4d35 0x51bf 0x554c 0x44f4 0x4b53 0x4ddf 0x539a 0x5747 0x47b2 0x4e2b 0x4db0 0x55c7 0x5a1f 0x4b66 0x5053 0x4d8e 0x5784 0x5c70 0x4ec2 0x5200 0x4d99 0x56e4 0x5b30 0x50c1 0x5279 0x4db7 0x545e 0x556e 0x5266 0x5292 0x4eac 0x522f 0x5332 0x557f 0x52bb 0x51b5 0x502c 0x57a5 0x5c14 0x54f8 0x52fa 0x4f1b 0x5bc5 0x6072 0x57f9 0x526f 0x501d 0x570c 0x60c9 0x583f 0x51eb 0x51bd 0x4db1 0x60f9 0x57a4 0x5370 0x509e 0x4c38 0x61ab 0x5761 0x56b0 0x4b39 0x4f18 0x63ae 0x597c 0x5793 0x48e6 0x52d8 0x651f 0x5d61 0x57a3 0x4b1b 0x57b0 0x6566 0x61cb 0x57c2 0x4ee2 0x5ce8 0x659c 0x67d0 0x5b7b 0x5319 0x6160 0x6868 0x7035 0x6478 0x5913 0x6555 0x75c6 0x7f29 0x820d 0x64c1 0x667d 0x891d 0x8e51 0xc368 0x7ec1 0x66b5 0xb3d9 0x9915 0xd827 0x8c01 0x66c3 0xde22 0xa1b8 0xaca3 0x70bc 0x5675 0xda94 0x9fde 0x7c3f 0x4d28 0x3fb7 0xbaf9 0x8194 0x65d6 0x4418 0x4483 0xa13c 0x67fe 0x5663 0x3fbe 0x5c7f 0x902e 0x6283 0x526f 0x4062 0x663e 0x8575 0x5f6b 0x5138 0x507c 0x66b6 0x84c3 0x62c0 0x511e 0x608b 0x6730 0x84f9 0x774c 0x64b3 0x66ad 0x68d0 0x85dc 0x8a16 0x8007 0x6b82 0x6b9b 0x8f78 0x960d 0x8bf1 0x7488 0x6e96 0x98c5 0x9e1c 0x93be 0x8232 0x7204 0x9928 0x9e2d 0x9534 0x8739 0x76af 0x98cf 0x9aef 0x9063 0x8561 0x804f 0x97e9 0x96b8 0x88df 0x81c4 0x87fd 0x92ec 0x913a 0x7d33 0x78e3 0x8049 0x8bda 0x898e 0x6f54 0x6a6f 0x6bd4 0x8509 0x7ae3 0x6892 0x6171 0x5dc7 0x7cbd 0x69cb 0x64f0 0x5bf2 0x53fd 0x7285 0x6730 0x5f55 0x515b 0x544e 0x5330 0x68c0 0x5be2 0x48ec 0x57a4 0x355b 0x6926 0x5e63 0x508b 0x4cb4 0x2edb 0x645b 0x5b30 0x505c 0x507c 0x2e51 0x3c45 0x587d 0x5446 0x532b 0x2e18 0x34bf 0x4b88 0x5aba 0x5167 0x308e 0x342b 0x439b 0x4afb 0x4534 0xabe7 0xa69f 0x37a8 0x41e4 0x65bc 0x33c2 0x60fd 0x3373 0x50a0 0x88bc 0x27e1 0x292f 0x363b 0x5669 0x8f45 0x4ab4 0x3351 0x61af 0x5577 0x854c 0x4ab4 0x3351 0x61af 0x5577 0x854c 0x4ab4 0x3351 0x61af 0x5577 0x854c>;
					};

					qcom,pc-temp-z6-lut {
						qcom,lut-col-legend = <0x00 0x0a 0x19 0x28 0x32>;
						qcom,lut-row-legend = <0x2710 0x2648 0x2580 0x24b8 0x23f0 0x2328 0x2260 0x2198 0x20d0 0x2008 0x1f40 0x1e78 0x1db0 0x1ce8 0x1c20 0x1b58 0x1a90 0x19c8 0x1900 0x1838 0x1770 0x16a8 0x15e0 0x1518 0x1450 0x1388 0x12c0 0x11f8 0x1130 0x1068 0xfa0 0xed8 0xe10 0xd48 0xc80 0xbb8 0xaf0 0xa28 0x960 0x898 0x7d0 0x708 0x640 0x578 0x4b0 0x3e8 0x384 0x320 0x2bc 0x258 0x1f4 0x190 0x12c 0xc8 0x64 0x00>;
						qcom,lut-data = <0x3b5c 0x39f6 0x3901 0x3886 0x3868 0x3ca8 0x3a6e 0x38f3 0x3870 0x384b 0x3c3c 0x3a8c 0x3913 0x3864 0x3841 0x3bb2 0x3a31 0x3938 0x38a3 0x3871 0x3b5d 0x39f3 0x391d 0x389a 0x386d 0x3b17 0x39cf 0x3908 0x3890 0x3867 0x3ae1 0x39b2 0x38f9 0x3887 0x3861 0x3ab7 0x399a 0x38ea 0x387e 0x385b 0x3a94 0x3985 0x38dc 0x3877 0x3856 0x3a74 0x3970 0x38ce 0x3872 0x3852 0x3a59 0x395b 0x38c5 0x386d 0x384e 0x3a3e 0x394b 0x38bd 0x3867 0x384a 0x3a22 0x3941 0x38b6 0x3861 0x3846 0x3a0e 0x3938 0x38ad 0x385c 0x3842 0x3a02 0x3930 0x38a5 0x3857 0x383d 0x39fa 0x3927 0x389d 0x3851 0x3838 0x39f3 0x391f 0x3896 0x384b 0x3834 0x39ec 0x3918 0x388f 0x3845 0x3830 0x39e6 0x3913 0x3888 0x3840 0x382b 0x39e0 0x390e 0x3882 0x383b 0x3827 0x39db 0x390a 0x387e 0x3838 0x3824 0x39db 0x3909 0x387b 0x3835 0x3821 0x39dc 0x390e 0x3885 0x383a 0x3823 0x39df 0x3917 0x38a8 0x385a 0x383c 0x39fd 0x392e 0x38bc 0x386d 0x384e 0x3a20 0x3951 0x38c4 0x386f 0x3851 0x3a24 0x3959 0x38c7 0x386f 0x3853 0x3a23 0x3952 0x38c5 0x386e 0x3852 0x3a21 0x3949 0x38be 0x386a 0x3851 0x3a1a 0x3943 0x38b9 0x3866 0x384e 0x3a11 0x393d 0x38b5 0x3862 0x3849 0x3a0a 0x3939 0x38b1 0x385e 0x3843 0x3a04 0x3935 0x38ae 0x3858 0x383d 0x3a00 0x3932 0x38aa 0x3852 0x3837 0x39fd 0x3930 0x38a6 0x384d 0x3833 0x39fb 0x392e 0x38a1 0x3849 0x382f 0x39f9 0x392b 0x389d 0x3847 0x382d 0x39f7 0x3926 0x389a 0x3848 0x3832 0x39f6 0x3925 0x3898 0x3849 0x3837 0x39f6 0x3926 0x389d 0x384c 0x3837 0x39f6 0x3928 0x38a6 0x3851 0x3837 0x39f5 0x3926 0x38a7 0x3852 0x3836 0x39f4 0x3921 0x38a2 0x384e 0x3832 0x39f2 0x391f 0x38a2 0x384e 0x3833 0x39e2 0x3919 0x38a1 0x384d 0x3835 0x39cf 0x390a 0x3891 0x3842 0x382a 0x39cd 0x390b 0x388d 0x383d 0x3825 0x39ce 0x3905 0x3885 0x3833 0x381c 0x39d1 0x3903 0x387d 0x382b 0x3814 0x39da 0x3905 0x387e 0x3831 0x381a 0x3a0d 0x391a 0x388e 0x383c 0x3824 0x3d8b 0x3943 0x389a 0x3842 0x3828 0x3de7 0x3ca2 0x38a4 0x3845 0x382b 0x3ddc 0x3d04 0x38b7 0x384b 0x3832 0x3ddc 0x3d04 0x38b7 0x384b 0x3832 0x3ddc 0x3d04 0x38b7 0x384b 0x3832>;
					};

					qcom,pc-temp-y1-lut {
						qcom,lut-col-legend = <0xfffffff6 0x00 0x0a 0x19 0x28 0x32>;
						qcom,lut-row-legend = <0x2710 0x2648 0x2580 0x24b8 0x23f0 0x2328 0x2260 0x2198 0x20d0 0x2008 0x1f40 0x1e78 0x1db0 0x1ce8 0x1c20 0x1b58 0x1a90 0x19c8 0x1900 0x1838 0x1770 0x16a8 0x15e0 0x1518 0x1450 0x1388 0x12c0 0x11f8 0x1130 0x1068 0xfa0 0xed8 0xe10 0xd48 0xc80 0xbb8 0xaf0 0xa28 0x960 0x898 0x7d0 0x708 0x640 0x578 0x4b0 0x3e8 0x384 0x320 0x2bc 0x258 0x1f4 0x190 0x12c 0xc8 0x64 0x00>;
						qcom,lut-data = <0x15e5 0x142a 0x133a 0x127c 0x120c 0x11ec 0x15c9 0x1429 0x133d 0x127c 0x120d 0x11eb 0x15b5 0x1429 0x1341 0x127d 0x120d 0x11eb 0x15a8 0x1429 0x1344 0x127d 0x120d 0x11eb 0x15a1 0x1429 0x1346 0x127c 0x120d 0x11ea 0x15a0 0x142a 0x1347 0x127c 0x120d 0x11ea 0x15a8 0x142b 0x1346 0x127c 0x120b 0x11eb 0x15b2 0x142d 0x1345 0x127b 0x1209 0x11eb 0x15b6 0x142d 0x1345 0x127b 0x1208 0x11eb 0x15b7 0x142c 0x1345 0x127b 0x1207 0x11ea 0x15b8 0x142c 0x1344 0x127a 0x1207 0x11ea 0x15b8 0x142d 0x1344 0x127a 0x1207 0x11ea 0x15b8 0x142e 0x1342 0x127a 0x1207 0x11ea 0x15b8 0x142e 0x1342 0x127a 0x1207 0x11eb 0x15b9 0x142f 0x1341 0x1279 0x1207 0x11ec 0x15b9 0x142f 0x1340 0x1279 0x1208 0x11ed 0x15bb 0x142f 0x1340 0x1279 0x1209 0x11ef 0x15be 0x142f 0x1340 0x1279 0x120a 0x11ef 0x15c1 0x1430 0x1340 0x1277 0x120a 0x11ee 0x15c4 0x1432 0x1340 0x1276 0x120a 0x11ed 0x15c6 0x1435 0x1340 0x1278 0x120a 0x11ed 0x15c8 0x1439 0x1340 0x127c 0x120a 0x11ef 0x15c9 0x143e 0x1341 0x127e 0x120b 0x11f0 0x15c6 0x1443 0x1343 0x127e 0x120d 0x11f1 0x15c1 0x1447 0x1344 0x127f 0x120e 0x11f2 0x15be 0x1447 0x1344 0x1283 0x1210 0x11f2 0x15bd 0x1447 0x1342 0x1287 0x1211 0x11f2 0x15bb 0x1447 0x1342 0x1287 0x1212 0x11f3 0x15b1 0x1448 0x1349 0x1286 0x1212 0x11f5 0x15a6 0x1449 0x1350 0x1286 0x1213 0x11f7 0x15a2 0x1447 0x134c 0x1286 0x1215 0x11f8 0x15a0 0x1441 0x1343 0x1287 0x1218 0x11f9 0x15a0 0x143c 0x1341 0x1288 0x121a 0x11fa 0x15af 0x1438 0x1343 0x128a 0x121b 0x11fc 0x15bf 0x1434 0x1344 0x128d 0x121d 0x11fd 0x15c0 0x1431 0x1345 0x1293 0x121d 0x11ff 0x15be 0x142f 0x1345 0x1296 0x121f 0x1201 0x15bb 0x142e 0x1347 0x1294 0x1221 0x1202 0x15b6 0x142f 0x134f 0x1292 0x1223 0x1203 0x15b2 0x142f 0x1354 0x1291 0x1224 0x1203 0x15b2 0x142c 0x1354 0x1290 0x1225 0x1202 0x15b3 0x142b 0x1354 0x1297 0x1226 0x1203 0x15a4 0x142e 0x1349 0x129c 0x1226 0x1207 0x1596 0x142b 0x134a 0x129e 0x1229 0x1208 0x15af 0x1432 0x1355 0x129a 0x1228 0x1208 0x15c3 0x1433 0x1361 0x129b 0x122c 0x120a 0x15be 0x1439 0x1350 0x12a4 0x122e 0x120b 0x15c9 0x1441 0x1350 0x12a2 0x122d 0x120a 0x15e0 0x145f 0x135d 0x12a4 0x122e 0x120c 0x1631 0x1467 0x1360 0x12ac 0x1230 0x120c 0x1684 0x1486 0x136e 0x12b4 0x1232 0x120d 0x16f6 0x14c7 0x1377 0x12c1 0x1238 0x1213 0x17d7 0x154c 0x1395 0x12c3 0x123f 0x121a 0x17d8 0x15e1 0x13e0 0x12e1 0x124e 0x1225 0x17d8 0x15e1 0x13e0 0x12e1 0x124e 0x1225 0x17d8 0x15e1 0x13e0 0x12e1 0x124e 0x1225>;
					};

					qcom,pc-temp-y2-lut {
						qcom,lut-col-legend = <0xfffffff6 0x00 0x0a 0x19 0x28 0x32>;
						qcom,lut-row-legend = <0x2710 0x2648 0x2580 0x24b8 0x23f0 0x2328 0x2260 0x2198 0x20d0 0x2008 0x1f40 0x1e78 0x1db0 0x1ce8 0x1c20 0x1b58 0x1a90 0x19c8 0x1900 0x1838 0x1770 0x16a8 0x15e0 0x1518 0x1450 0x1388 0x12c0 0x11f8 0x1130 0x1068 0xfa0 0xed8 0xe10 0xd48 0xc80 0xbb8 0xaf0 0xa28 0x960 0x898 0x7d0 0x708 0x640 0x578 0x4b0 0x3e8 0x384 0x320 0x2bc 0x258 0x1f4 0x190 0x12c 0xc8 0x64 0x00>;
						qcom,lut-data = <0x28b5 0x2b94 0x2cb3 0x2ebc 0x2f5a 0x2ef0 0x28f9 0x2b96 0x2cad 0x2e66 0x2f2c 0x2f6a 0x294d 0x2b94 0x2ca1 0x2e13 0x2ef4 0x2f9b 0x29a2 0x2b91 0x2c8f 0x2dc6 0x2eb4 0x2f97 0x29e8 0x2b8b 0x2c79 0x2d84 0x2e6c 0x2f6f 0x2a0d 0x2b84 0x2c5f 0x2d53 0x2e1c 0x2f30 0x2a1c 0x2b7a 0x2c3c 0x2d2d 0x2daa 0x2e99 0x2a26 0x2b70 0x2c1b 0x2d0f 0x2d5d 0x2e05 0x2a32 0x2b65 0x2c0b 0x2cf7 0x2d78 0x2dc3 0x2a3e 0x2b5a 0x2c00 0x2ce4 0x2db0 0x2d97 0x2a4e 0x2b58 0x2bfd 0x2cde 0x2db5 0x2d92 0x2a65 0x2b69 0x2c04 0x2cdb 0x2d8a 0x2da6 0x2a82 0x2b80 0x2c11 0x2cdb 0x2d71 0x2dbd 0x2aa8 0x2b95 0x2c2a 0x2d0c 0x2d82 0x2dd2 0x2ad4 0x2bac 0x2c55 0x2d5f 0x2da2 0x2deb 0x2af5 0x2bc7 0x2c85 0x2da3 0x2dc0 0x2e1e 0x2b0c 0x2beb 0x2cbf 0x2de6 0x2de4 0x2e75 0x2b1e 0x2c0a 0x2cee 0x2e2d 0x2e15 0x2eb7 0x2b2d 0x2c23 0x2d0d 0x2e7b 0x2e60 0x2edb 0x2b38 0x2c34 0x2d22 0x2ec0 0x2ec0 0x2f09 0x2b3c 0x2c38 0x2d22 0x2efc 0x2f67 0x2f98 0x2b3e 0x2c39 0x2d16 0x2f28 0x3015 0x3051 0x2b3e 0x2c3c 0x2d10 0x2f02 0x301c 0x306b 0x29a5 0x2c5d 0x2d1b 0x2e4f 0x2fc3 0x3044 0x2702 0x2c81 0x2d2d 0x2dff 0x2f76 0x301d 0x2651 0x2c85 0x2d40 0x2e3a 0x2f3e 0x2ffc 0x2629 0x2c86 0x2d57 0x2e7b 0x2f1b 0x2fe4 0x2611 0x2c87 0x2d70 0x2e87 0x2f72 0x3024 0x25ff 0x2c88 0x2d93 0x2e8c 0x3043 0x30f2 0x25f2 0x2c89 0x2dab 0x2ea2 0x3074 0x31a2 0x25ea 0x2c8b 0x2dae 0x2efe 0x302a 0x3246 0x25e4 0x2c8e 0x2daf 0x2f47 0x2ff8 0x329d 0x25df 0x2c86 0x2daf 0x2f63 0x30b9 0x329b 0x25da 0x2c45 0x2da8 0x2f73 0x31cb 0x3293 0x25d6 0x2bf5 0x2d9d 0x2f74 0x31d9 0x326b 0x25d2 0x2bb9 0x2d89 0x2f74 0x3185 0x31e9 0x25ce 0x2b6b 0x2d68 0x2f72 0x310e 0x319d 0x25cb 0x2a62 0x2d3b 0x2f5d 0x301b 0x318f 0x25c8 0x27c9 0x2cf7 0x2f37 0x2f67 0x3181 0x25c7 0x2659 0x2ca4 0x2ec6 0x2fac 0x310f 0x25c5 0x2612 0x2c39 0x2e5d 0x300a 0x3052 0x25c3 0x25ee 0x2bbd 0x2e68 0x2fdb 0x3016 0x25c0 0x25dc 0x2b35 0x2e7f 0x2f20 0x2f89 0x25bf 0x25cf 0x2844 0x2e3b 0x2fe2 0x2f55 0x25c3 0x25c7 0x27b8 0x2d74 0x2ec7 0x2fca 0x2624 0x25be 0x2662 0x2d07 0x2e70 0x2e6f 0x25c7 0x25c6 0x25fc 0x2ce8 0x2e30 0x2dec 0x25bf 0x2638 0x25d2 0x2ca6 0x2de8 0x2dd3 0x25b9 0x25db 0x25c0 0x2c3c 0x2d82 0x2d4c 0x25ba 0x25c2 0x25e1 0x2b7d 0x2d60 0x2d8d 0x25b4 0x25b8 0x25e4 0x2a4c 0x2ce3 0x2d04 0x25b3 0x25b4 0x25cc 0x28be 0x2c8f 0x2cde 0x25b3 0x25b4 0x25b9 0x272f 0x2c5b 0x2cfc 0x25b3 0x25b4 0x25b7 0x266b 0x2bd0 0x2c94 0x25b3 0x25b4 0x25b7 0x266b 0x2bd0 0x2c94 0x25b3 0x25b4 0x25b7 0x266b 0x2bd0 0x2c94>;
					};

					qcom,pc-temp-y3-lut {
						qcom,lut-col-legend = <0xfffffff6 0x00 0x0a 0x19 0x28 0x32>;
						qcom,lut-row-legend = <0x2710 0x2648 0x2580 0x24b8 0x23f0 0x2328 0x2260 0x2198 0x20d0 0x2008 0x1f40 0x1e78 0x1db0 0x1ce8 0x1c20 0x1b58 0x1a90 0x19c8 0x1900 0x1838 0x1770 0x16a8 0x15e0 0x1518 0x1450 0x1388 0x12c0 0x11f8 0x1130 0x1068 0xfa0 0xed8 0xe10 0xd48 0xc80 0xbb8 0xaf0 0xa28 0x960 0x898 0x7d0 0x708 0x640 0x578 0x4b0 0x3e8 0x384 0x320 0x2bc 0x258 0x1f4 0x190 0x12c 0xc8 0x64 0x00>;
						qcom,lut-data = <0x3477 0x341c 0x3402 0x33df 0x33df 0x33de 0x3478 0x3421 0x3403 0x33e3 0x33db 0x33d9 0x347c 0x3425 0x3405 0x33e6 0x33d9 0x33d7 0x3480 0x342a 0x3406 0x33e8 0x33d8 0x33d5 0x3483 0x342d 0x3407 0x33e9 0x33d7 0x33d4 0x3484 0x3430 0x3409 0x33e9 0x33d7 0x33d4 0x3484 0x3432 0x340a 0x33e8 0x33d8 0x33d6 0x3484 0x3433 0x340b 0x33e7 0x33d9 0x33d7 0x3483 0x3433 0x340b 0x33e8 0x33dc 0x33d8 0x3482 0x3433 0x340a 0x33eb 0x33e0 0x33d9 0x3480 0x3432 0x340a 0x33ed 0x33e1 0x33d9 0x347d 0x3432 0x340a 0x33ee 0x33e2 0x33da 0x347c 0x3431 0x340a 0x33ee 0x33e3 0x33da 0x347b 0x342f 0x340b 0x33ee 0x33e3 0x33dd 0x347a 0x342e 0x340b 0x33ee 0x33e3 0x33e0 0x3479 0x342e 0x340b 0x33ef 0x33e4 0x33e0 0x3474 0x342f 0x3408 0x33f0 0x33e7 0x33e0 0x346c 0x3430 0x3406 0x33f0 0x33e8 0x33e0 0x3465 0x342e 0x3407 0x33ef 0x33e7 0x33df 0x345e 0x342b 0x3409 0x33ee 0x33e7 0x33de 0x3458 0x3427 0x3408 0x33ef 0x33e7 0x33e0 0x3452 0x3423 0x3406 0x33f0 0x33e7 0x33e4 0x344c 0x341f 0x3403 0x33ef 0x33e6 0x33e3 0x343f 0x341a 0x33fe 0x33ea 0x33dd 0x33da 0x3432 0x3416 0x33fb 0x33e6 0x33d9 0x33d5 0x3430 0x3414 0x33fb 0x33e3 0x33d9 0x33d5 0x3432 0x3412 0x33fb 0x33e1 0x33d9 0x33d5 0x3435 0x3411 0x33fa 0x33e2 0x33d8 0x33d5 0x3438 0x3410 0x33f9 0x33e4 0x33d8 0x33d7 0x343d 0x340e 0x33f8 0x33e5 0x33d8 0x33d7 0x3445 0x3409 0x33f9 0x33e6 0x33d9 0x33d6 0x3453 0x3401 0x33f9 0x33e6 0x33d9 0x33d5 0x3463 0x3400 0x33f9 0x33e6 0x33da 0x33d6 0x3475 0x3405 0x33f9 0x33e7 0x33db 0x33d8 0x348a 0x340b 0x33f9 0x33e7 0x33db 0x33d8 0x34a5 0x3411 0x33f9 0x33e6 0x33db 0x33d7 0x34c6 0x3416 0x33fa 0x33e6 0x33da 0x33d6 0x34ee 0x341a 0x33fb 0x33e5 0x33d8 0x33d6 0x3522 0x341d 0x33fc 0x33e5 0x33d7 0x33d5 0x3562 0x3423 0x33fe 0x33e3 0x33d7 0x33d5 0x35af 0x3431 0x33ff 0x33e2 0x33d8 0x33d7 0x3616 0x3447 0x3401 0x33e4 0x33d9 0x33d5 0x36a6 0x346f 0x3402 0x33e4 0x33da 0x33d5 0x379f 0x34a2 0x33fe 0x33e1 0x33da 0x33d7 0x3951 0x3505 0x33ff 0x33e0 0x33d6 0x33d5 0x3b7b 0x3690 0x341e 0x33ea 0x33dd 0x33d7 0x3547 0x3990 0x3443 0x33ef 0x33de 0x33da 0x35ad 0x3b38 0x3499 0x33f3 0x33e1 0x33df 0x3775 0x3568 0x35c2 0x33fa 0x33e5 0x33df 0x41d2 0x36b6 0x3a0e 0x33fe 0x33e5 0x33dd 0x7714 0x4630 0x3497 0x3403 0x33e2 0x33dc 0xe122 0x67da 0x35cd 0x3422 0x33e3 0x33df 0xffff 0xa1f5 0x3cd8 0x3528 0x33e7 0x33e1 0xffff 0xf56b 0x4a25 0x3459 0x33ee 0x33e5 0xffff 0xf56b 0x4a25 0x3459 0x33ee 0x33e5 0xffff 0xf56b 0x4a25 0x3459 0x33ee 0x33e5>;
					};

					qcom,pc-temp-y4-lut {
						qcom,lut-col-legend = <0xfffffff6 0x00 0x0a 0x19 0x28 0x32>;
						qcom,lut-row-legend = <0x2710 0x2648 0x2580 0x24b8 0x23f0 0x2328 0x2260 0x2198 0x20d0 0x2008 0x1f40 0x1e78 0x1db0 0x1ce8 0x1c20 0x1b58 0x1a90 0x19c8 0x1900 0x1838 0x1770 0x16a8 0x15e0 0x1518 0x1450 0x1388 0x12c0 0x11f8 0x1130 0x1068 0xfa0 0xed8 0xe10 0xd48 0xc80 0xbb8 0xaf0 0xa28 0x960 0x898 0x7d0 0x708 0x640 0x578 0x4b0 0x3e8 0x384 0x320 0x2bc 0x258 0x1f4 0x190 0x12c 0xc8 0x64 0x00>;
						qcom,lut-data = <0x411b 0x40ba 0x4097 0x4080 0x4052 0x4047 0x4137 0x40c7 0x409e 0x4070 0x404e 0x4044 0x4162 0x40dc 0x40a4 0x4065 0x404a 0x4041 0x4190 0x40f4 0x40a9 0x405d 0x4046 0x403e 0x41b5 0x4106 0x40ac 0x4059 0x4043 0x403c 0x41c6 0x410c 0x40ad 0x4058 0x4043 0x403a 0x41cb 0x410b 0x40ab 0x405d 0x4044 0x4039 0x41cd 0x4109 0x40a8 0x4062 0x4045 0x4038 0x41cf 0x4106 0x40a8 0x4065 0x4044 0x4039 0x41d0 0x4104 0x40a9 0x4066 0x4041 0x403c 0x41d1 0x4103 0x40a9 0x4069 0x4041 0x403e 0x41d9 0x410a 0x40ad 0x406f 0x4045 0x4042 0x41e5 0x4115 0x40b3 0x4077 0x404b 0x4044 0x41f0 0x4124 0x40bb 0x4080 0x4052 0x4044 0x41fb 0x4139 0x40c6 0x408a 0x4059 0x4045 0x41fd 0x414f 0x40d5 0x4094 0x405d 0x4047 0x41ea 0x4167 0x40eb 0x409f 0x4060 0x404d 0x41cd 0x4174 0x4103 0x40ae 0x4065 0x4055 0x41ab 0x416a 0x411f 0x40c8 0x4070 0x405f 0x4181 0x4154 0x4137 0x40d9 0x407e 0x406a 0x415d 0x4134 0x4131 0x40db 0x4091 0x4075 0x413a 0x4101 0x4107 0x40db 0x40a4 0x407f 0x4128 0x40d9 0x40da 0x40cb 0x409c 0x407a 0x4130 0x40bf 0x40a9 0x4086 0x406d 0x405b 0x413e 0x40ad 0x4083 0x4062 0x4051 0x4047 0x413c 0x40a8 0x407a 0x405d 0x404a 0x4042 0x4129 0x40a5 0x4075 0x405b 0x4047 0x403f 0x411f 0x40a2 0x4074 0x405d 0x4049 0x4040 0x411f 0x409d 0x4077 0x4063 0x404f 0x4043 0x4120 0x409a 0x407a 0x406a 0x4056 0x4047 0x4120 0x409b 0x407f 0x4071 0x4060 0x4050 0x4120 0x409c 0x4083 0x4078 0x4069 0x405a 0x4120 0x409e 0x4085 0x4081 0x4073 0x4062 0x4124 0x409f 0x4087 0x408a 0x407a 0x4069 0x412b 0x40a1 0x4088 0x408f 0x4079 0x4068 0x4131 0x40aa 0x408c 0x4092 0x4073 0x4062 0x4138 0x40b9 0x4093 0x4092 0x406a 0x405a 0x413e 0x40cf 0x409b 0x4083 0x4059 0x404d 0x4147 0x40ef 0x40a6 0x4073 0x404d 0x4042 0x414d 0x40fc 0x40ab 0x406f 0x404d 0x4040 0x414b 0x40fd 0x40a9 0x406d 0x404d 0x403f 0x4149 0x40fd 0x40a5 0x406d 0x404c 0x4040 0x414b 0x40fa 0x409d 0x406c 0x404c 0x4041 0x414b 0x40f7 0x40b0 0x4062 0x4046 0x403d 0x4140 0x40e3 0x40a3 0x4056 0x403b 0x4031 0x4016 0x40f1 0x40ac 0x4062 0x4045 0x4040 0x5292 0x40ed 0x40bf 0x406f 0x404e 0x4044 0x5546 0x402f 0x40dd 0x4080 0x4053 0x4043 0x63b3 0x55c9 0x410a 0x409a 0x4060 0x405b 0x4529 0x43ef 0x4125 0x4097 0x4053 0x4057 0x521a 0x45a7 0x5124 0x409a 0x4045 0x403e 0x5e22 0x501c 0x42ac 0x40d8 0x4048 0x4041 0x4107 0x67dc 0x4456 0x41fc 0x4055 0x404c 0x4202 0xaa02 0x4c8e 0x4c76 0x407a 0x4075 0x4202 0xaa02 0x4c8e 0x4c76 0x407a 0x4075 0x4202 0xaa02 0x4c8e 0x4c76 0x407a 0x4075>;
					};

					qcom,pc-temp-y5-lut {
						qcom,lut-col-legend = <0xfffffff6 0x00 0x0a 0x19 0x28 0x32>;
						qcom,lut-row-legend = <0x2710 0x2648 0x2580 0x24b8 0x23f0 0x2328 0x2260 0x2198 0x20d0 0x2008 0x1f40 0x1e78 0x1db0 0x1ce8 0x1c20 0x1b58 0x1a90 0x19c8 0x1900 0x1838 0x1770 0x16a8 0x15e0 0x1518 0x1450 0x1388 0x12c0 0x11f8 0x1130 0x1068 0xfa0 0xed8 0xe10 0xd48 0xc80 0xbb8 0xaf0 0xa28 0x960 0x898 0x7d0 0x708 0x640 0x578 0x4b0 0x3e8 0x384 0x320 0x2bc 0x258 0x1f4 0x190 0x12c 0xc8 0x64 0x00>;
						qcom,lut-data = <0x36f1 0x451c 0x51bb 0x50dc 0x55f5 0x5a68 0x3a78 0x467d 0x5250 0x5314 0x524f 0x55e2 0x3e5b 0x4925 0x526f 0x5408 0x4cd8 0x504a 0x4217 0x4c21 0x5231 0x53ed 0x4717 0x4aef 0x452c 0x4e7b 0x51b2 0x52fc 0x4294 0x471e 0x471b 0x4f45 0x510a 0x50fc 0x40bc 0x461c 0x4856 0x4f36 0x5037 0x476c 0x4020 0x4728 0x4911 0x4f11 0x4efe 0x3f3e 0x3fdc 0x4825 0x48e1 0x4df8 0x4c4c 0x3f98 0x4393 0x476b 0x4811 0x4ad2 0x478e 0x40b3 0x4b01 0x456d 0x47bb 0x47f6 0x442e 0x40a0 0x4c35 0x4379 0x4817 0x4545 0x421f 0x3ea1 0x494e 0x4135 0x48d8 0x4374 0x4081 0x3c70 0x45e6 0x4029 0x4b08 0x42f2 0x3f29 0x3a40 0x4203 0x4412 0x4f6e 0x42a9 0x3e09 0x389e 0x3ef8 0x4910 0x52ad 0x4346 0x3cf9 0x3879 0x3f86 0x487a 0x5525 0x4832 0x3bd5 0x3874 0x41c0 0x4497 0x5684 0x4e2e 0x3b4a 0x3879 0x4236 0x40bb 0x5696 0x5446 0x3ef1 0x38d0 0x3f20 0x3c7a 0x569e 0x59ce 0x4663 0x3987 0x3cb2 0x39ed 0x5690 0x5be7 0x4e77 0x40ef 0x3eb9 0x3e75 0x55fb 0x5d07 0x5890 0x4d74 0x4325 0x46eb 0x54d7 0x5d47 0x5c94 0x535f 0x472e 0x4955 0x4ae9 0x59a1 0x598e 0x56fd 0x4b7f 0x49fc 0x3b91 0x551b 0x5626 0x57c8 0x4d23 0x4a29 0x36e5 0x53ce 0x5651 0x4efa 0x4ce0 0x4920 0x3584 0x5325 0x5787 0x461d 0x4c4c 0x47f1 0x347d 0x52d1 0x57c7 0x4740 0x4a2e 0x4834 0x3353 0x52b2 0x556a 0x4ad3 0x4605 0x4922 0x327f 0x5287 0x5357 0x4c75 0x43d4 0x48d9 0x32ab 0x4c5c 0x552c 0x4cff 0x42b1 0x4323 0x33b9 0x408b 0x58f4 0x4d92 0x423c 0x3ece 0x3499 0x3e5d 0x5a01 0x4e7c 0x4455 0x40be 0x3518 0x4294 0x5a1e 0x4f97 0x4831 0x44e1 0x3581 0x4797 0x5a27 0x50ff 0x4b3f 0x48c6 0x35e2 0x4cd7 0x58c6 0x52b2 0x4e20 0x4d0d 0x363b 0x5143 0x5697 0x533a 0x4eea 0x4ea2 0x368d 0x4ef2 0x55e3 0x52ee 0x4c8c 0x4dfd 0x36e1 0x4363 0x55aa 0x5249 0x4953 0x4d55 0x3724 0x3c2d 0x5536 0x4c95 0x4679 0x4dad 0x3751 0x3a16 0x5302 0x4653 0x449e 0x4e43 0x376a 0x3981 0x4fc0 0x4719 0x467e 0x4657 0x3506 0x39e7 0x4b70 0x4627 0x462b 0x4211 0x33ca 0x35f3 0x3c02 0x4516 0x48ba 0x47f2 0x32bf 0x355a 0x3878 0x444c 0x452f 0x4ed5 0xffff 0x34e6 0x39ae 0x49e5 0x4b1f 0x4263 0x38ba 0x3801 0x37ed 0x488e 0x43e2 0x440b 0x2502 0xffff 0x36f3 0x4715 0x43b0 0x528b 0x26d7 0xe9bb 0x359d 0x490f 0x519c 0x5183 0x2702 0x2ea5 0x43d2 0x4c91 0x58c5 0x508d 0x241a 0x2716 0x279f 0x4a88 0x54ea 0x53e3 0x2654 0x2463 0x364b 0x4489 0x548c 0x6323 0x5b57 0x2394 0x2b13 0x34c1 0x628a 0x6b13 0x49ee 0x22f1 0x253f 0x2a80 0x629c 0x6798 0x49ee 0x22f1 0x253f 0x2a80 0x629c 0x6798 0x49ee 0x22f1 0x253f 0x2a80 0x629c 0x6798>;
					};

					qcom,pc-temp-y6-lut {
						qcom,lut-col-legend = <0xfffffff6 0x00 0x0a 0x19 0x28 0x32>;
						qcom,lut-row-legend = <0x2710 0x2648 0x2580 0x24b8 0x23f0 0x2328 0x2260 0x2198 0x20d0 0x2008 0x1f40 0x1e78 0x1db0 0x1ce8 0x1c20 0x1b58 0x1a90 0x19c8 0x1900 0x1838 0x1770 0x16a8 0x15e0 0x1518 0x1450 0x1388 0x12c0 0x11f8 0x1130 0x1068 0xfa0 0xed8 0xe10 0xd48 0xc80 0xbb8 0xaf0 0xa28 0x960 0x898 0x7d0 0x708 0x640 0x578 0x4b0 0x3e8 0x384 0x320 0x2bc 0x258 0x1f4 0x190 0x12c 0xc8 0x64 0x00>;
						qcom,lut-data = <0x15a4 0x145b 0x13dd 0x137a 0x1358 0x1351 0x15ab 0x1466 0x13de 0x1379 0x1357 0x1350 0x15b0 0x146d 0x13df 0x1377 0x1356 0x134f 0x15b2 0x1471 0x13df 0x1376 0x1355 0x134e 0x15b3 0x1472 0x13de 0x1375 0x1354 0x134e 0x15b3 0x1472 0x13dd 0x1375 0x1354 0x134e 0x15b0 0x146f 0x13db 0x1374 0x1354 0x134e 0x15a9 0x1469 0x13d7 0x1374 0x1355 0x134f 0x15a3 0x1464 0x13d4 0x1374 0x1355 0x134f 0x159c 0x1460 0x13d0 0x1374 0x1355 0x1350 0x1598 0x145d 0x13ce 0x1375 0x1356 0x1350 0x1596 0x1459 0x13cc 0x1375 0x1357 0x1351 0x1595 0x1456 0x13cb 0x1377 0x1358 0x1352 0x1596 0x1456 0x13cc 0x1378 0x1359 0x1353 0x1599 0x1458 0x13cd 0x1379 0x135b 0x1354 0x159b 0x145b 0x13d0 0x137c 0x135c 0x1355 0x1599 0x1464 0x13d3 0x137f 0x135e 0x1356 0x1596 0x146d 0x13d8 0x1383 0x1361 0x1358 0x158e 0x146e 0x13e1 0x1389 0x1363 0x135a 0x157b 0x146e 0x13eb 0x138f 0x1366 0x135d 0x156b 0x146d 0x13ea 0x1393 0x136a 0x1360 0x155f 0x1459 0x13de 0x1396 0x1371 0x1366 0x1554 0x143f 0x13d1 0x1396 0x1374 0x1368 0x154a 0x1435 0x13c2 0x1386 0x1368 0x135f 0x1540 0x142e 0x13b7 0x1374 0x135a 0x1354 0x153c 0x142c 0x13b4 0x1372 0x1358 0x1352 0x153f 0x142b 0x13b3 0x1371 0x1357 0x1352 0x1543 0x142b 0x13b3 0x1371 0x1357 0x1352 0x154a 0x142b 0x13b4 0x1372 0x1358 0x1353 0x1557 0x142c 0x13b6 0x1373 0x1359 0x1354 0x1566 0x142d 0x13b7 0x1375 0x135a 0x1355 0x1578 0x142e 0x13b9 0x1378 0x135c 0x1356 0x158c 0x1430 0x13bb 0x137b 0x135e 0x1357 0x15a1 0x1435 0x13bc 0x137d 0x1361 0x135a 0x15b8 0x1442 0x13be 0x137e 0x1362 0x135b 0x15d2 0x144f 0x13c0 0x137e 0x1361 0x1359 0x15f1 0x145d 0x13c3 0x137e 0x135e 0x1356 0x1613 0x146e 0x13c7 0x137c 0x135c 0x1354 0x163b 0x1480 0x13cb 0x1377 0x1359 0x1353 0x1667 0x1493 0x13cf 0x1375 0x1358 0x1353 0x1697 0x14a7 0x13d5 0x1376 0x1359 0x1354 0x16cb 0x14bb 0x13dd 0x1377 0x135a 0x1355 0x170a 0x14d5 0x13e9 0x1378 0x1359 0x1354 0x175c 0x14f9 0x13f4 0x1378 0x1359 0x1353 0x17d1 0x152b 0x13f5 0x1375 0x1356 0x1351 0x1867 0x1562 0x1413 0x137c 0x135a 0x1354 0x18e4 0x159d 0x142b 0x1380 0x135c 0x1356 0x1975 0x15ea 0x144f 0x1388 0x1361 0x135c 0x1a44 0x1656 0x1488 0x1391 0x136e 0x1369 0x1bf5 0x16ff 0x14ce 0x1390 0x1365 0x1360 0x21ad 0x1823 0x1545 0x138d 0x135f 0x135a 0x2dcd 0x1970 0x16a5 0x1397 0x1363 0x135d 0x5694 0x1ed0 0x190a 0x13a9 0x1367 0x1361 0x5b44 0x3267 0x2507 0x13da 0x1379 0x1375 0x5b44 0x3267 0x2507 0x13da 0x1379 0x1375 0x5b44 0x3267 0x2507 0x13da 0x1379 0x1375>;
					};
				};

				qcom,6691316_LC_M335_NVT_5000mAH_PM7250B {
					qcom,max-voltage-uv = <0x44aa20>;
					qcom,fg-cc-cv-threshold-uv = <0x44aa20>;
					qcom,fastchg-current-ma = <0x1770>;
					qcom,batt-id-kohm = <0x64>;
					qcom,battery-beta = <0xd34>;
					qcom,battery-therm-kohm = <0x0a>;
					qcom,battery-type = "qbg-battery-profile-nvt-5000mAh";
					qcom,qg-batt-profile-ver = <0x64>;
					qcom,jeita-fcc-ranges = <0xffffff9c 0x00 0x61a80 0x00 0x32 0xcf850 0x32 0x64 0x231860 0x64 0x96 0x387520 0x96 0x15e 0x5b8d80 0x15e 0x1e0 0x5b8d80 0x1e0 0x230 0x231860>;
					qcom,jeita-fv-ranges = <0xffffff9c 0x00 0x440de0 0x00 0x32 0x445c00 0x32 0x64 0x445c00 0x64 0x96 0x445c00 0x96 0x15e 0x43e6d0 0x15e 0x1e0 0x43e6d0 0x1e0 0x230 0x3e8fa0>;
					qcom,step-chg-ranges = <0x36ee80 0x40d990 0x5b8d80 0x40d991 0x445c00 0x5265c0 0x445c01 0x44aa20 0x3bd080>;
					qcom,vbat-avg-based-step-chg;
					qcom,taper-fcc;
					qcom,jeita-soft-thresholds = <0x2554 0xe8d>;
					qcom,jeita-hard-thresholds = <0x43d5 0xb9b>;
					qcom,jeita-soft-hys-thresholds = <0x225f 0xfdc>;
					qcom,jeita-soft-fcc-ua = <0x5265c0 0x2625a0>;
					qcom,jeita-soft-fv-uv = <0x445c00 0x3e8fa0>;

					qcom,fcc1-temp-lut {
						qcom,lut-col-legend = <0x00 0x0a 0x19 0x28 0x32>;
						qcom,lut-data = <0x1356 0x13dc 0x1415 0x1432 0x143c>;
					};

					qcom,fcc2-temp-lut {
						qcom,lut-col-legend = <0xfffffff6 0x00 0x0a 0x19 0x28 0x32>;
						qcom,lut-data = <0x13b8 0x13b8 0x140e 0x142a 0x141b 0x1412>;
					};

					qcom,pc-temp-v1-lut {
						qcom,lut-col-legend = <0x00 0x0a 0x19 0x28 0x32>;
						qcom,lut-row-legend = <0x2710 0x2648 0x2580 0x24b8 0x23f0 0x2328 0x2260 0x2198 0x20d0 0x2008 0x1f40 0x1e78 0x1db0 0x1ce8 0x1c20 0x1b58 0x1a90 0x19c8 0x1900 0x1838 0x1770 0x16a8 0x15e0 0x1518 0x1450 0x1388 0x12c0 0x11f8 0x1130 0x1068 0xfa0 0xed8 0xe10 0xd48 0xc80 0xbb8 0xaf0 0xa28 0x960 0x898 0x7d0 0x708 0x640 0x578 0x4b0 0x3e8 0x384 0x320 0x2bc 0x258 0x1f4 0x190 0x12c 0xc8 0x64 0x00>;
						qcom,lut-data = <0xaece 0xaf67 0xafa6 0xafc5 0xafc9 0xadb2 0xade1 0xae0c 0xae1d 0xae22 0xacb0 0xace7 0xaceb 0xace9 0xacf2 0xabd3 0xac14 0xac0c 0xabfd 0xac03 0xab06 0xab38 0xab33 0xab23 0xab26 0xaa2b 0xaa61 0xaa57 0xaa47 0xaa48 0xa944 0xa980 0xa978 0xa96e 0xa96e 0xa856 0xa890 0xa88c 0xa886 0xa889 0xa760 0xa797 0xa794 0xa790 0xa799 0xa665 0xa69d 0xa69a 0xa696 0xa6a2 0xa56d 0xa59f 0xa59d 0xa59b 0xa5a8 0xa478 0xa4a4 0xa4a0 0xa4a0 0xa4ad 0xa386 0xa3ac 0xa3a5 0xa3a6 0xa3b5 0xa29d 0xa2b9 0xa2ad 0xa2ae 0xa2bf 0xa1bb 0xa1cf 0xa1bf 0xa1bd 0xa1cf 0xa0de 0xa0eb 0xa0d7 0xa0d4 0xa0e4 0xa007 0xa00f 0x9ff7 0x9ff1 0x9fff 0x9f37 0x9f3b 0x9f1f 0x9f17 0x9f23 0x9e70 0x9e6f 0x9e4f 0x9e44 0x9e4f 0x9db0 0x9db1 0x9d8b 0x9d7b 0x9d84 0x9cf5 0x9cfa 0x9cd5 0x9cc3 0x9cca 0x9c45 0x9c34 0x9c0f 0x9bff 0x9c07 0x9b8c 0x9b5c 0x9b1e 0x9b17 0x9b24 0x9a9c 0x9a7f 0x9a2b 0x9a25 0x9a35 0x9983 0x9997 0x9961 0x9957 0x9966 0x98b3 0x98b6 0x98b0 0x989e 0x98ab 0x9829 0x981f 0x981d 0x9803 0x980c 0x97bb 0x97ba 0x97a3 0x9783 0x9787 0x975d 0x975b 0x9736 0x9713 0x9713 0x970c 0x96f5 0x96ce 0x96a9 0x96a5 0x96c1 0x9694 0x966e 0x9649 0x9640 0x9676 0x963f 0x961a 0x95ef 0x95e4 0x9630 0x95f5 0x95d0 0x959d 0x9591 0x95ee 0x95b2 0x958c 0x9552 0x9543 0x95b1 0x9578 0x954e 0x9510 0x94fc 0x957a 0x9543 0x9515 0x94d3 0x94b9 0x954e 0x9512 0x94dd 0x9491 0x946c 0x9523 0x94e5 0x94aa 0x944c 0x9416 0x94ec 0x94aa 0x946b 0x93fe 0x93ba 0x94a8 0x9453 0x9413 0x93a2 0x935b 0x9454 0x93e8 0x93a8 0x9339 0x92f2 0x93da 0x9370 0x932f 0x92bf 0x9276 0x9349 0x92e1 0x92a1 0x9230 0x91e5 0x92a6 0x9233 0x91f6 0x918c 0x9146 0x9209 0x918a 0x9155 0x90f7 0x90b7 0x9172 0x9112 0x90ef 0x909f 0x9063 0x9135 0x90ed 0x90d3 0x9088 0x904d 0x9109 0x90d5 0x90be 0x9079 0x903d 0x90e0 0x90bc 0x90a5 0x9061 0x9023 0x90b7 0x907a 0x9056 0x8fde 0x8f8a 0x907d 0x8f62 0x8f32 0x8e81 0x8e25 0x8f9e 0x8d7f 0x8d64 0x8c99 0x8c3d 0x8dbb 0x8afd 0x8b08 0x8a22 0x89c4 0x8aaf 0x876a 0x87cd 0x86b7 0x8660 0x8047 0x8176 0x82c3 0x814e 0x80f7 0x7530 0x7530 0x7530 0x7530 0x7530>;
					};

					qcom,pc-temp-v2-lut {
						qcom,lut-col-legend = <0xfffffff6 0x00 0x0a 0x19 0x28 0x32>;
						qcom,lut-row-legend = <0x2710 0x2648 0x2580 0x24b8 0x23f0 0x2328 0x2260 0x2198 0x20d0 0x2008 0x1f40 0x1e78 0x1db0 0x1ce8 0x1c20 0x1b58 0x1a90 0x19c8 0x1900 0x1838 0x1770 0x16a8 0x15e0 0x1518 0x1450 0x1388 0x12c0 0x11f8 0x1130 0x1068 0xfa0 0xed8 0xe10 0xd48 0xc80 0xbb8 0xaf0 0xa28 0x960 0x898 0x7d0 0x708 0x640 0x578 0x4b0 0x3e8 0x384 0x320 0x2bc 0x258 0x1f4 0x190 0x12c 0xc8 0x64 0x00>;
						qcom,lut-data = <0xafcd 0xafbe 0xafaa 0xaf7d 0xaf64 0xaf50 0xadd1 0xadee 0xadee 0xadf3 0xadd3 0xadc1 0xac2e 0xac6f 0xac7f 0xaca5 0xac7e 0xac6e 0xaaff 0xab59 0xab72 0xaba2 0xab72 0xab61 0xaa20 0xaa8e 0xaaa9 0xaad6 0xaa9f 0xaa8d 0xa949 0xa9c4 0xa9dd 0xaa07 0xa9ca 0xa9b7 0xa85f 0xa8e0 0xa8f9 0xa925 0xa8e5 0xa8d2 0xa773 0xa7f4 0xa80d 0xa83c 0xa7fa 0xa7e9 0xa681 0xa702 0xa719 0xa749 0xa707 0xa6f7 0xa587 0xa608 0xa61b 0xa64c 0xa60b 0xa5fc 0xa48e 0xa50f 0xa51d 0xa54f 0xa510 0xa502 0xa395 0xa416 0xa420 0xa452 0xa414 0xa408 0xa29f 0xa31e 0xa326 0xa356 0xa31b 0xa310 0xa1ba 0xa22c 0xa231 0xa25f 0xa227 0xa21d 0xa0e2 0xa13e 0xa142 0xa16c 0xa137 0xa12e 0xa005 0xa05a 0xa059 0xa081 0xa04f 0xa046 0x9f20 0x9f86 0x9f74 0x9f9d 0x9f6e 0x9f64 0x9e31 0x9eb7 0x9e98 0x9ec0 0x9e94 0x9e8b 0x9d2e 0x9de5 0x9dcc 0x9def 0x9dc4 0x9dbd 0x9c18 0x9d10 0x9d03 0x9d20 0x9cf8 0x9cf5 0x9b12 0x9c26 0x9c1d 0x9c4b 0x9c30 0x9c2f 0x9a21 0x9b0b 0x9b15 0x9b72 0x9b6b 0x9b6d 0x993f 0x99f2 0x9a19 0x9a8d 0x9a97 0x9a9c 0x9865 0x9914 0x992e 0x9986 0x9991 0x999a 0x9796 0x9852 0x9859 0x9893 0x9897 0x989f 0x96e6 0x97a8 0x97ac 0x97e6 0x97ea 0x97f2 0x9650 0x9712 0x971c 0x975a 0x9762 0x976b 0x95d1 0x9689 0x9699 0x96da 0x96e6 0x96ef 0x956d 0x960a 0x9621 0x9663 0x9674 0x967c 0x9519 0x9596 0x95b3 0x95f7 0x960b 0x9612 0x94ce 0x952b 0x954e 0x9596 0x95ac 0x95b1 0x948a 0x94c5 0x94f0 0x953d 0x9554 0x9556 0x944b 0x946d 0x949a 0x94e9 0x9503 0x9503 0x940d 0x942c 0x944a 0x9499 0x94b9 0x94ba 0x93d1 0x93f8 0x9401 0x9449 0x946a 0x9469 0x9390 0x93c6 0x93c1 0x93fb 0x940a 0x93fb 0x934a 0x9397 0x9385 0x93ab 0x93a2 0x937b 0x92ff 0x9365 0x9345 0x934f 0x9337 0x9305 0x92ac 0x9326 0x92ff 0x92ea 0x92c8 0x9295 0x9251 0x92dc 0x92af 0x9287 0x925e 0x922a 0x91ec 0x927c 0x9249 0x922b 0x9204 0x91cd 0x917a 0x91f8 0x91d1 0x91c0 0x919e 0x9168 0x9100 0x9166 0x9142 0x913a 0x911c 0x90e5 0x9081 0x90c7 0x909d 0x909d 0x9084 0x904a 0x9015 0x9033 0x9012 0x9028 0x9015 0x8fe1 0x8fac 0x8fc1 0x8fc5 0x9006 0x8ff9 0x8fc5 0x8f79 0x8f8e 0x8f9e 0x8fef 0x8fe5 0x8fb1 0x8f42 0x8f5f 0x8f6b 0x8fcd 0x8fcd 0x8f97 0x8f34 0x8f2b 0x8f26 0x8f7b 0x8f97 0x8f5a 0x8ed3 0x8eed 0x8e68 0x8e77 0x8eb3 0x8e6d 0x9035 0x8e84 0x8ce0 0x8ca0 0x8d00 0x8cb1 0x8eed 0x8daa 0x8a8f 0x8a3c 0x8acc 0x8a7e 0x9123 0x8db4 0x8781 0x870b 0x87d5 0x878c 0x7a6a 0x8bff 0x84a3 0x8247 0x83a5 0x8377 0x7638 0x77c9 0x7ef6 0x7be9 0x7d77 0x7d66 0x7244 0x728c 0x6dd8 0x71d6 0x6d9a 0x6da1>;
					};

					qcom,pc-temp-z1-lut {
						qcom,lut-col-legend = <0x00 0x0a 0x19 0x28 0x32>;
						qcom,lut-row-legend = <0x2710 0x2648 0x2580 0x24b8 0x23f0 0x2328 0x2260 0x2198 0x20d0 0x2008 0x1f40 0x1e78 0x1db0 0x1ce8 0x1c20 0x1b58 0x1a90 0x19c8 0x1900 0x1838 0x1770 0x16a8 0x15e0 0x1518 0x1450 0x1388 0x12c0 0x11f8 0x1130 0x1068 0xfa0 0xed8 0xe10 0xd48 0xc80 0xbb8 0xaf0 0xa28 0x960 0x898 0x7d0 0x708 0x640 0x578 0x4b0 0x3e8 0x384 0x320 0x2bc 0x258 0x1f4 0x190 0x12c 0xc8 0x64 0x00>;
						qcom,lut-data = <0x2dd3 0x2bd1 0x2a3e 0x2982 0x2968 0x2de1 0x2c0a 0x2a58 0x29a5 0x2988 0x2dea 0x2bfa 0x2a57 0x299e 0x2985 0x2ded 0x2be4 0x2a4d 0x2999 0x2984 0x2def 0x2be0 0x2a44 0x2997 0x2983 0x2def 0x2be0 0x2a3d 0x2997 0x2984 0x2de6 0x2bdf 0x2a38 0x2998 0x2986 0x2dd8 0x2bd3 0x2a35 0x2999 0x2989 0x2dc0 0x2bc3 0x2a34 0x299b 0x298c 0x2d9e 0x2bbd 0x2a33 0x299d 0x2990 0x2d8e 0x2bb9 0x2a36 0x29a0 0x2994 0x2d87 0x2bb7 0x2a39 0x29a4 0x2999 0x2d83 0x2bb9 0x2a3e 0x29a8 0x299d 0x2d84 0x2bbb 0x2a43 0x29ad 0x29a2 0x2d85 0x2bc0 0x2a49 0x29b2 0x29a6 0x2d85 0x2bc7 0x2a50 0x29b7 0x29ac 0x2d84 0x2bcd 0x2a58 0x29bc 0x29b2 0x2d85 0x2bd2 0x2a5d 0x29c1 0x29b7 0x2d8a 0x2bd8 0x2a62 0x29c7 0x29bc 0x2d94 0x2bdd 0x2a69 0x29cc 0x29c1 0x2d9d 0x2be5 0x2a70 0x29d2 0x29c6 0x2da4 0x2bea 0x2a77 0x29d7 0x29ca 0x2dad 0x2bef 0x2a7b 0x29db 0x29cf 0x2dbb 0x2bf3 0x2a7f 0x29df 0x29d3 0x2dcd 0x2bf5 0x2a86 0x29e3 0x29d7 0x2dd3 0x2bf7 0x2a8d 0x29e8 0x29da 0x2dcb 0x2bf9 0x2a94 0x29ec 0x29de 0x2dc2 0x2bfd 0x2a9a 0x29f0 0x29e2 0x2dc3 0x2c01 0x2a9f 0x29f4 0x29e5 0x2dc9 0x2c0a 0x2aa4 0x29f8 0x29e8 0x2dce 0x2c16 0x2aa9 0x29fc 0x29ec 0x2dd6 0x2c17 0x2aaf 0x2a00 0x29ef 0x2dde 0x2c13 0x2ab5 0x2a03 0x29f2 0x2de0 0x2c11 0x2abb 0x2a07 0x29f4 0x2dde 0x2c16 0x2ac0 0x2a0b 0x29f7 0x2dde 0x2c1e 0x2ac5 0x2a0f 0x29fa 0x2de7 0x2c24 0x2acb 0x2a13 0x29fd 0x2df4 0x2c29 0x2ad2 0x2a17 0x2a00 0x2dfe 0x2c2f 0x2ad9 0x2a1a 0x2a02 0x2e08 0x2c38 0x2adf 0x2a1c 0x2a03 0x2e0f 0x2c41 0x2ae3 0x2a1e 0x2a05 0x2e14 0x2c47 0x2ae7 0x2a21 0x2a06 0x2e17 0x2c4d 0x2ae9 0x2a23 0x2a08 0x2e20 0x2c5e 0x2af1 0x2a26 0x2a0a 0x2e40 0x2c66 0x2af7 0x2a29 0x2a0b 0x2e33 0x2c63 0x2af8 0x2a2a 0x2a0d 0x2e3d 0x2c6a 0x2b00 0x2a2a 0x2a0d 0x2e4c 0x2c6d 0x2afb 0x2a2c 0x2a0d 0x2e3c 0x2c64 0x2b00 0x2a2e 0x2a0f 0x2e4b 0x2c64 0x2b04 0x2a30 0x2a10 0x2e42 0x2c6e 0x2b09 0x2a33 0x2a12 0x2e53 0x2c7e 0x2b0e 0x2a38 0x2a15 0x2e5f 0x2c83 0x2b18 0x2a3c 0x2a19 0x2e58 0x2caa 0x2b22 0x2a42 0x2a1f 0x2e58 0x2caa 0x2b22 0x2a42 0x2a1f 0x2e58 0x2caa 0x2b22 0x2a42 0x2a1f>;
					};

					qcom,pc-temp-z2-lut {
						qcom,lut-col-legend = <0x00 0x0a 0x19 0x28 0x32>;
						qcom,lut-row-legend = <0x2710 0x2648 0x2580 0x24b8 0x23f0 0x2328 0x2260 0x2198 0x20d0 0x2008 0x1f40 0x1e78 0x1db0 0x1ce8 0x1c20 0x1b58 0x1a90 0x19c8 0x1900 0x1838 0x1770 0x16a8 0x15e0 0x1518 0x1450 0x1388 0x12c0 0x11f8 0x1130 0x1068 0xfa0 0xed8 0xe10 0xd48 0xc80 0xbb8 0xaf0 0xa28 0x960 0x898 0x7d0 0x708 0x640 0x578 0x4b0 0x3e8 0x384 0x320 0x2bc 0x258 0x1f4 0x190 0x12c 0xc8 0x64 0x00>;
						qcom,lut-data = <0x2ab2 0x287a 0x2a66 0x2c9f 0x2cde 0x29d1 0x298f 0x2afc 0x2b6c 0x2c7d 0x2961 0x29da 0x2b56 0x2c99 0x2c84 0x295b 0x2a09 0x2b22 0x2c7f 0x2ced 0x294d 0x2a05 0x2af0 0x2c60 0x2d58 0x293c 0x29da 0x2ac6 0x2c3a 0x2d46 0x291d 0x29b3 0x2aaa 0x2c0b 0x2d01 0x28ff 0x2998 0x2aa9 0x2c06 0x2ceb 0x28eb 0x2985 0x2aad 0x2c1d 0x2ce0 0x28da 0x2987 0x2aac 0x2c2a 0x2cd7 0x28d6 0x2994 0x2a9f 0x2c22 0x2cd8 0x28dd 0x299f 0x2a96 0x2c13 0x2cdd 0x28e6 0x29a6 0x2a99 0x2c07 0x2cdf 0x28ee 0x29ad 0x2a9e 0x2bfc 0x2ce4 0x28fc 0x29b8 0x2aa2 0x2bf7 0x2cef 0x2908 0x29c6 0x2aa4 0x2bf7 0x2d1a 0x2912 0x29d1 0x2aa6 0x2bf8 0x2d51 0x291c 0x29da 0x2aaa 0x2bfd 0x2d76 0x2926 0x29e0 0x2aaf 0x2c08 0x2d9d 0x2930 0x29e3 0x2aa9 0x2c13 0x2dae 0x2939 0x29e9 0x2a93 0x2c21 0x2dbc 0x293f 0x29f0 0x2a8d 0x2c39 0x2dc6 0x2947 0x2a00 0x2ac7 0x2c8c 0x2e20 0x2954 0x2a0a 0x2b03 0x2d00 0x2eaf 0x2967 0x29f4 0x2b01 0x2d39 0x2e9a 0x296e 0x29cb 0x2af0 0x2d5f 0x2def 0x2966 0x29c8 0x2aef 0x2d68 0x2d54 0x295f 0x29e6 0x2b13 0x2cbb 0x2ccb 0x295f 0x29fb 0x2b2f 0x2be5 0x2c62 0x2962 0x29fa 0x2b0d 0x2ba7 0x2c59 0x2964 0x29f9 0x2acf 0x2b7e 0x2c5b 0x2967 0x29f8 0x2abc 0x2b76 0x2c61 0x296a 0x29f8 0x2ab9 0x2b94 0x2c8d 0x296b 0x29f9 0x2abb 0x2bbf 0x2ccc 0x296e 0x2a03 0x2aca 0x2bf4 0x2d11 0x2971 0x2a11 0x2ae1 0x2c2f 0x2d5c 0x2976 0x2a16 0x2af1 0x2c4e 0x2d90 0x297c 0x2a18 0x2aff 0x2c69 0x2dca 0x2982 0x2a1c 0x2b11 0x2c80 0x2dea 0x298a 0x2a2e 0x2b2f 0x2caf 0x2df6 0x298d 0x2a3e 0x2b48 0x2ce0 0x2e01 0x2982 0x2a35 0x2b37 0x2cd6 0x2df4 0x297a 0x2a1b 0x2b0e 0x2caf 0x2dcd 0x297c 0x2a16 0x2b2d 0x2ca6 0x2dd6 0x2941 0x2a2d 0x2b4d 0x2cbc 0x2dda 0x2a04 0x2a98 0x2b2f 0x2cf2 0x2e1a 0x32f5 0x2a7a 0x2b05 0x2cc5 0x2e50 0x29f9 0x2a9e 0x2aee 0x2cea 0x2e6a 0x3389 0x2b02 0x2ae3 0x2d17 0x2eba 0x2f1a 0x2aea 0x2b23 0x2cf3 0x2d7d 0x3166 0x2b11 0x2b22 0x2c1f 0x2c85 0x29b3 0x2afd 0x2af2 0x2bbb 0x2c33 0x2829 0x2aaa 0x2aa4 0x2b6e 0x2c0d 0x290b 0x29bc 0x2a40 0x2b10 0x2bd2 0x290b 0x29bc 0x2a40 0x2b10 0x2bd2 0x290b 0x29bc 0x2a40 0x2b10 0x2bd2>;
					};

					qcom,pc-temp-z3-lut {
						qcom,lut-col-legend = <0x00 0x0a 0x19 0x28 0x32>;
						qcom,lut-row-legend = <0x2710 0x2648 0x2580 0x24b8 0x23f0 0x2328 0x2260 0x2198 0x20d0 0x2008 0x1f40 0x1e78 0x1db0 0x1ce8 0x1c20 0x1b58 0x1a90 0x19c8 0x1900 0x1838 0x1770 0x16a8 0x15e0 0x1518 0x1450 0x1388 0x12c0 0x11f8 0x1130 0x1068 0xfa0 0xed8 0xe10 0xd48 0xc80 0xbb8 0xaf0 0xa28 0x960 0x898 0x7d0 0x708 0x640 0x578 0x4b0 0x3e8 0x384 0x320 0x2bc 0x258 0x1f4 0x190 0x12c 0xc8 0x64 0x00>;
						qcom,lut-data = <0x4bd2 0x4b88 0x4b83 0x4b62 0x4b62 0x4c28 0x4bf5 0x4baa 0x4b7d 0x4b77 0x4c5a 0x4c09 0x4bbf 0x4b8e 0x4b7a 0x4c69 0x4c12 0x4bc0 0x4b92 0x4b7d 0x4c72 0x4c14 0x4bc1 0x4b93 0x4b7e 0x4c75 0x4c15 0x4bc1 0x4b90 0x4b7d 0x4c76 0x4c14 0x4bc1 0x4b8a 0x4b7b 0x4c76 0x4c12 0x4bbf 0x4b87 0x4b79 0x4c75 0x4c10 0x4bb8 0x4b87 0x4b78 0x4c72 0x4c0b 0x4bb2 0x4b86 0x4b76 0x4c6e 0x4c02 0x4bab 0x4b82 0x4b74 0x4c68 0x4bfc 0x4ba7 0x4b7c 0x4b72 0x4c62 0x4bf9 0x4ba6 0x4b7b 0x4b6f 0x4c5a 0x4bf7 0x4ba5 0x4b7a 0x4b6d 0x4c52 0x4bf3 0x4ba3 0x4b79 0x4b6a 0x4c4d 0x4bf0 0x4b9e 0x4b75 0x4b68 0x4c4a 0x4bed 0x4b9a 0x4b71 0x4b66 0x4c47 0x4bea 0x4b99 0x4b70 0x4b65 0x4c44 0x4be8 0x4b98 0x4b6f 0x4b63 0x4c40 0x4be6 0x4b97 0x4b6f 0x4b62 0x4c3d 0x4be3 0x4b96 0x4b6d 0x4b61 0x4c3b 0x4be3 0x4b95 0x4b6c 0x4b60 0x4c3a 0x4bea 0x4b9c 0x4b6f 0x4b65 0x4c3f 0x4bef 0x4ba3 0x4b77 0x4b6e 0x4c4c 0x4bec 0x4ba0 0x4b7e 0x4b75 0x4c51 0x4be7 0x4b95 0x4b88 0x4b7a 0x4c4e 0x4be5 0x4b92 0x4b8c 0x4b7c 0x4c4a 0x4be5 0x4ba1 0x4b8a 0x4b7b 0x4c48 0x4be6 0x4bae 0x4b88 0x4b79 0x4c46 0x4bec 0x4baf 0x4b85 0x4b77 0x4c44 0x4bf3 0x4baf 0x4b80 0x4b74 0x4c43 0x4bf3 0x4bae 0x4b7d 0x4b70 0x4c43 0x4bf1 0x4ba9 0x4b7a 0x4b6b 0x4c43 0x4bee 0x4ba5 0x4b77 0x4b66 0x4c42 0x4bec 0x4ba2 0x4b73 0x4b62 0x4c41 0x4bea 0x4ba1 0x4b70 0x4b5f 0x4c40 0x4be9 0x4b9f 0x4b70 0x4b5f 0x4c3e 0x4be8 0x4b9e 0x4b70 0x4b62 0x4c3b 0x4be7 0x4b9d 0x4b71 0x4b64 0x4c35 0x4be4 0x4b9a 0x4b70 0x4b66 0x4c30 0x4be0 0x4b97 0x4b70 0x4b67 0x4c2c 0x4bdd 0x4b95 0x4b70 0x4b67 0x4c28 0x4bda 0x4b94 0x4b71 0x4b68 0x4c21 0x4bd8 0x4b94 0x4b72 0x4b69 0x4b9b 0x4bd1 0x4b93 0x4b71 0x4b68 0x4b3d 0x4bc0 0x4b89 0x4b69 0x4b5d 0x4b3c 0x4bbf 0x4b86 0x4b69 0x4b5b 0x4b3d 0x4bb1 0x4b85 0x4b64 0x4b5a 0x4b3a 0x4b92 0x4b84 0x4b61 0x4b57 0x4b3a 0x4b9c 0x4b82 0x4b68 0x4b64 0x4b3b 0x4b93 0x4b85 0x4b72 0x4b68 0x4b3d 0x4b8a 0x4b8b 0x4b74 0x4b68 0x4b41 0x4b85 0x4b8e 0x4b75 0x4b6a 0x4c14 0x4bc9 0x4b91 0x4b79 0x4b6b 0x4c14 0x4bc9 0x4b91 0x4b79 0x4b6b 0x4c14 0x4bc9 0x4b91 0x4b79 0x4b6b>;
					};

					qcom,pc-temp-z4-lut {
						qcom,lut-col-legend = <0x00 0x0a 0x19 0x28 0x32>;
						qcom,lut-row-legend = <0x2710 0x2648 0x2580 0x24b8 0x23f0 0x2328 0x2260 0x2198 0x20d0 0x2008 0x1f40 0x1e78 0x1db0 0x1ce8 0x1c20 0x1b58 0x1a90 0x19c8 0x1900 0x1838 0x1770 0x16a8 0x15e0 0x1518 0x1450 0x1388 0x12c0 0x11f8 0x1130 0x1068 0xfa0 0xed8 0xe10 0xd48 0xc80 0xbb8 0xaf0 0xa28 0x960 0x898 0x7d0 0x708 0x640 0x578 0x4b0 0x3e8 0x384 0x320 0x2bc 0x258 0x1f4 0x190 0x12c 0xc8 0x64 0x00>;
						qcom,lut-data = <0x3d25 0x3ad2 0x3a21 0x39b5 0x39a6 0x3ce9 0x3c09 0x39f0 0x3977 0x395e 0x3c93 0x3b90 0x3a46 0x39a8 0x397d 0x3c02 0x3ac8 0x3a05 0x3995 0x3973 0x3b4a 0x3a60 0x39cd 0x397e 0x3965 0x3ad1 0x3a1d 0x39aa 0x396f 0x395a 0x3a81 0x39eb 0x398e 0x3963 0x3951 0x3a42 0x39c5 0x397d 0x395a 0x394b 0x3a10 0x39a7 0x3970 0x3953 0x3947 0x39e8 0x3993 0x3967 0x394e 0x3943 0x39c7 0x3983 0x3962 0x394b 0x393f 0x39a9 0x3978 0x395e 0x3948 0x393c 0x3995 0x3971 0x3957 0x3943 0x3938 0x398c 0x396c 0x3950 0x393c 0x3935 0x3987 0x3967 0x394b 0x3937 0x3931 0x3982 0x3963 0x3948 0x3934 0x392d 0x397e 0x3960 0x3946 0x3932 0x3929 0x397a 0x395e 0x3942 0x392d 0x3924 0x3978 0x395c 0x393e 0x3928 0x3920 0x3977 0x395a 0x393c 0x3925 0x391d 0x3975 0x3957 0x393b 0x3924 0x391b 0x3972 0x3958 0x393b 0x3924 0x3919 0x3970 0x3963 0x3952 0x3939 0x3929 0x3986 0x3975 0x3975 0x3958 0x3943 0x39c1 0x3998 0x398d 0x395d 0x3948 0x39d9 0x39c3 0x39a2 0x395b 0x3947 0x39d7 0x39c8 0x39a6 0x3959 0x3946 0x39d4 0x39b2 0x398c 0x3951 0x3940 0x39cc 0x399b 0x396f 0x3947 0x3938 0x39bc 0x398b 0x3963 0x3941 0x3933 0x39ae 0x397f 0x395b 0x393c 0x392f 0x39a5 0x397a 0x3956 0x3937 0x392b 0x399e 0x3978 0x3952 0x3933 0x3928 0x399b 0x3977 0x3951 0x3930 0x3926 0x3999 0x3977 0x3951 0x3930 0x3925 0x3996 0x3977 0x3952 0x392f 0x3924 0x3993 0x3977 0x3953 0x3931 0x3926 0x3990 0x3975 0x3955 0x3939 0x392f 0x398a 0x3972 0x3957 0x393d 0x3934 0x3980 0x3970 0x3957 0x393d 0x3932 0x3975 0x396c 0x3958 0x393c 0x392e 0x396d 0x3964 0x3954 0x3939 0x392b 0x3963 0x3955 0x3949 0x3932 0x3928 0x3952 0x394d 0x3943 0x3930 0x3925 0x39b4 0x3942 0x393c 0x392e 0x3922 0x3a03 0x3930 0x392f 0x3926 0x391f 0x3a02 0x392a 0x3929 0x391d 0x3919 0x39fe 0x3932 0x3920 0x3916 0x390f 0x39fa 0x394e 0x391a 0x3913 0x390c 0x39f7 0x3942 0x3921 0x3917 0x390d 0x39f3 0x3954 0x3929 0x3914 0x390f 0x39f4 0x3962 0x3926 0x3914 0x3910 0x3a00 0x396e 0x3923 0x3914 0x3912 0x3962 0x3932 0x3925 0x3915 0x3914 0x3962 0x3932 0x3925 0x3915 0x3914 0x3962 0x3932 0x3925 0x3915 0x3914>;
					};

					qcom,pc-temp-z5-lut {
						qcom,lut-col-legend = <0x00 0x0a 0x19 0x28 0x32>;
						qcom,lut-row-legend = <0x2710 0x2648 0x2580 0x24b8 0x23f0 0x2328 0x2260 0x2198 0x20d0 0x2008 0x1f40 0x1e78 0x1db0 0x1ce8 0x1c20 0x1b58 0x1a90 0x19c8 0x1900 0x1838 0x1770 0x16a8 0x15e0 0x1518 0x1450 0x1388 0x12c0 0x11f8 0x1130 0x1068 0xfa0 0xed8 0xe10 0xd48 0xc80 0xbb8 0xaf0 0xa28 0x960 0x898 0x7d0 0x708 0x640 0x578 0x4b0 0x3e8 0x384 0x320 0x2bc 0x258 0x1f4 0x190 0x12c 0xc8 0x64 0x00>;
						qcom,lut-data = <0x32e2 0x31ea 0x3b11 0x3989 0x3ec6 0x3a95 0x40d1 0x5110 0x5515 0x64f6 0x40cf 0x4567 0x4e67 0x5909 0x5bed 0x4582 0x4b61 0x5204 0x5e4e 0x5f70 0x4976 0x505f 0x562e 0x6162 0x6464 0x4cf9 0x5505 0x5aea 0x6147 0x685a 0x5106 0x59c5 0x5f68 0x60b8 0x6c48 0x5575 0x5f04 0x625c 0x61b6 0x6e8f 0x5a73 0x6438 0x649e 0x6655 0x6f8d 0x607d 0x68ac 0x64f6 0x68fd 0x6fc8 0x67aa 0x6cba 0x62d4 0x6599 0x6fcd 0x721a 0x7091 0x6128 0x612e 0x6ffc 0x798a 0x7492 0x64b0 0x6336 0x7008 0x7a8a 0x77e1 0x6b84 0x6b77 0x6fc1 0x7acd 0x7997 0x6cb3 0x6ea4 0x6f99 0x7bcc 0x7abd 0x6a1d 0x6a7d 0x712d 0x8011 0x7c7e 0x687f 0x6683 0x7431 0x8461 0x7fb4 0x6bd3 0x6a19 0x788b 0x85f9 0x8315 0x7230 0x7320 0x7f27 0x8754 0x85a5 0x76be 0x7845 0x8531 0x8927 0x88bb 0x7aa4 0x7afa 0x8bf3 0x8cd2 0x9068 0x7ff6 0x7cec 0x91a2 0x9335 0xaa9b 0x8ebe 0x7efb 0x94c3 0xa960 0xbd62 0x9cce 0x8077 0x9542 0xd46c 0xac3a 0x8e35 0x7b9e 0x8c5e 0xe3d0 0x8a12 0x62bd 0x6960 0x707e 0xc92e 0x7af5 0x53d5 0x60a8 0x6236 0xa93a 0x7390 0x5d8f 0x667f 0x6723 0x9e05 0x70b2 0x6b6d 0x6d26 0x6fa3 0x9752 0x7d91 0x7a0b 0x6f90 0x7842 0x9570 0x9414 0x8acc 0x74d1 0x81cf 0x99ab 0xa148 0x94c3 0x7a70 0x84b5 0xa0a0 0xaad8 0x9adc 0x84d9 0x83d4 0xa828 0xafa2 0xa10d 0x8f16 0x830d 0xb1f9 0xb0fa 0xab2e 0x95c7 0x84e9 0xb61f 0xb1e9 0xb4a9 0x9aca 0x8892 0xb503 0xb367 0xb51a 0x9ae7 0x891c 0xb38c 0xb645 0xb042 0x963f 0x8762 0xb313 0xb754 0xa90b 0x9048 0x8656 0xb21a 0xb15a 0x985d 0x87c1 0x89ed 0xb08a 0xa8bb 0x8812 0x7fe4 0x9060 0xaa80 0xa211 0x84a9 0x7fc4 0x982f 0xa63b 0x9d07 0x8375 0x82dd 0xa2dc 0xa1a0 0x9eca 0x8375 0x8099 0x9a84 0x5c1f 0x9f73 0x8377 0x76ef 0x8688 0x2e1c 0x96fd 0x7d63 0x6ac6 0x6533 0x2ded 0x97ef 0x7953 0x7d71 0x6a7f 0x2d98 0x6e3f 0x81ff 0x7c67 0x8a5b 0x2d67 0x43c7 0x8ad8 0x7d40 0x87e6 0x2d48 0x539d 0x7404 0x7353 0xbe21 0x2d5c 0x4757 0x6396 0x8fdf 0xc69f 0x2d79 0x3e41 0x6935 0x9f27 0xc073 0x2e87 0x3ad9 0x6f4c 0x93e8 0xbe5f 0xa557 0x8ee4 0x6c3a 0xa992 0xa57e 0xa557 0x8ee4 0x6c3a 0xa992 0xa57e 0xa557 0x8ee4 0x6c3a 0xa992 0xa57e>;
					};

					qcom,pc-temp-z6-lut {
						qcom,lut-col-legend = <0x00 0x0a 0x19 0x28 0x32>;
						qcom,lut-row-legend = <0x2710 0x2648 0x2580 0x24b8 0x23f0 0x2328 0x2260 0x2198 0x20d0 0x2008 0x1f40 0x1e78 0x1db0 0x1ce8 0x1c20 0x1b58 0x1a90 0x19c8 0x1900 0x1838 0x1770 0x16a8 0x15e0 0x1518 0x1450 0x1388 0x12c0 0x11f8 0x1130 0x1068 0xfa0 0xed8 0xe10 0xd48 0xc80 0xbb8 0xaf0 0xa28 0x960 0x898 0x7d0 0x708 0x640 0x578 0x4b0 0x3e8 0x384 0x320 0x2bc 0x258 0x1f4 0x190 0x12c 0xc8 0x64 0x00>;
						qcom,lut-data = <0x3c32 0x39d0 0x38dc 0x3867 0x3856 0x3c15 0x3a82 0x38d9 0x385e 0x3849 0x3be8 0x3a4a 0x3904 0x387a 0x3857 0x3b99 0x39eb 0x38e5 0x3873 0x3854 0x3b30 0x39b4 0x38ca 0x386a 0x384f 0x3ae5 0x398e 0x38b9 0x3861 0x384b 0x3aaf 0x396f 0x38ab 0x3859 0x3846 0x3a82 0x3957 0x38a0 0x3854 0x3842 0x3a5b 0x3943 0x3896 0x3851 0x3840 0x3a39 0x3932 0x3890 0x384e 0x383e 0x3a1c 0x3924 0x388a 0x384b 0x383c 0x3a01 0x391b 0x3886 0x3848 0x383a 0x39ed 0x3915 0x3883 0x3845 0x3838 0x39e3 0x3911 0x3880 0x3843 0x3836 0x39dc 0x390d 0x387d 0x3841 0x3834 0x39d8 0x390a 0x387b 0x383e 0x3832 0x39d5 0x3908 0x3879 0x383b 0x3830 0x39d2 0x3906 0x3878 0x383a 0x382e 0x39d0 0x3905 0x3877 0x3838 0x382c 0x39cf 0x3904 0x3877 0x3838 0x382b 0x39ce 0x3903 0x3877 0x3837 0x382a 0x39cf 0x3903 0x3877 0x3837 0x382a 0x39cf 0x390c 0x3886 0x3842 0x3833 0x39dd 0x3919 0x389a 0x3855 0x3844 0x39ff 0x3929 0x38a3 0x385d 0x384b 0x3a0d 0x393a 0x38a9 0x3862 0x384f 0x3a0d 0x393c 0x38aa 0x3863 0x3850 0x3a0c 0x3933 0x38a7 0x3860 0x384e 0x3a0a 0x392d 0x38a4 0x385b 0x384a 0x3a04 0x392d 0x38a1 0x3857 0x3847 0x3a01 0x392c 0x389f 0x3854 0x3844 0x39fe 0x392c 0x389d 0x3850 0x3841 0x39fc 0x392b 0x3899 0x384d 0x383d 0x39fd 0x392a 0x3898 0x384b 0x383a 0x39fe 0x392c 0x3898 0x3849 0x3838 0x39ff 0x392e 0x3899 0x3848 0x3836 0x3a03 0x3930 0x389a 0x3849 0x3837 0x3a06 0x3931 0x389c 0x384d 0x383d 0x3a06 0x3932 0x389e 0x3850 0x3840 0x3a05 0x3933 0x389f 0x3850 0x3840 0x3a05 0x3933 0x389f 0x3850 0x383f 0x3a08 0x3932 0x389d 0x384f 0x383f 0x3a0b 0x392f 0x389a 0x384d 0x383e 0x3a0a 0x392f 0x389a 0x384d 0x383d 0x3a00 0x392e 0x3899 0x384c 0x383c 0x39fd 0x3924 0x3890 0x3845 0x3836 0x39fa 0x3922 0x388d 0x3841 0x3832 0x39fd 0x3920 0x3888 0x383c 0x382d 0x39fc 0x391e 0x3887 0x3839 0x382a 0x39fc 0x3921 0x388b 0x383f 0x3832 0x3a02 0x3929 0x3891 0x3844 0x3835 0x3a09 0x392f 0x3895 0x3846 0x3837 0x3a19 0x3939 0x3899 0x3847 0x3839 0x3a46 0x394b 0x389f 0x384c 0x383c 0x3a46 0x394b 0x389f 0x384c 0x383c 0x3a46 0x394b 0x389f 0x384c 0x383c>;
					};

					qcom,pc-temp-y1-lut {
						qcom,lut-col-legend = <0xfffffff6 0x00 0x0a 0x19 0x28 0x32>;
						qcom,lut-row-legend = <0x2710 0x2648 0x2580 0x24b8 0x23f0 0x2328 0x2260 0x2198 0x20d0 0x2008 0x1f40 0x1e78 0x1db0 0x1ce8 0x1c20 0x1b58 0x1a90 0x19c8 0x1900 0x1838 0x1770 0x16a8 0x15e0 0x1518 0x1450 0x1388 0x12c0 0x11f8 0x1130 0x1068 0xfa0 0xed8 0xe10 0xd48 0xc80 0xbb8 0xaf0 0xa28 0x960 0x898 0x7d0 0x708 0x640 0x578 0x4b0 0x3e8 0x384 0x320 0x2bc 0x258 0x1f4 0x190 0x12c 0xc8 0x64 0x00>;
						qcom,lut-data = <0x160e 0x14c8 0x13b8 0x12ba 0x124c 0x122d 0x162d 0x14c1 0x13b8 0x12bd 0x124c 0x122f 0x1644 0x14b9 0x13b6 0x12be 0x124b 0x1232 0x1653 0x14b3 0x13b3 0x12bd 0x124b 0x1234 0x165c 0x14af 0x13b0 0x12bc 0x124b 0x1236 0x165e 0x14ae 0x13af 0x12bb 0x124b 0x1238 0x1656 0x14af 0x13af 0x12b9 0x124b 0x123a 0x164a 0x14b2 0x13ae 0x12b7 0x124b 0x123c 0x164b 0x14b4 0x13ae 0x12b7 0x124c 0x123e 0x1658 0x14b5 0x13ad 0x12ba 0x124d 0x1240 0x1665 0x14b7 0x13ad 0x12bb 0x124f 0x1241 0x1673 0x14ba 0x13af 0x12bb 0x1251 0x1244 0x167f 0x14be 0x13b2 0x12bb 0x1252 0x1246 0x167a 0x14c4 0x13b1 0x12bc 0x1254 0x1248 0x1665 0x14cb 0x13b1 0x12bd 0x1255 0x124a 0x165b 0x14d0 0x13b2 0x12bf 0x1257 0x124c 0x1669 0x14d3 0x13b6 0x12c2 0x125a 0x124e 0x1679 0x14d6 0x13b8 0x12c5 0x125c 0x1251 0x167a 0x14d4 0x13b6 0x12c7 0x125e 0x1252 0x1679 0x14cd 0x13b2 0x12c9 0x125f 0x1253 0x1678 0x14cb 0x13b3 0x12ca 0x1261 0x1255 0x167a 0x14ce 0x13b8 0x12cc 0x1263 0x1256 0x167c 0x14d1 0x13bc 0x12ce 0x1265 0x1257 0x1681 0x14d2 0x13c1 0x12d1 0x1266 0x1259 0x168d 0x14d0 0x13c5 0x12d4 0x1268 0x125c 0x1691 0x14d0 0x13c6 0x12d7 0x126a 0x125d 0x168f 0x14d3 0x13c6 0x12da 0x126b 0x125f 0x168c 0x14d6 0x13c6 0x12dc 0x126d 0x1260 0x168c 0x14d9 0x13c8 0x12df 0x126e 0x1261 0x168e 0x14dd 0x13c9 0x12e1 0x1270 0x1262 0x168f 0x14e0 0x13cd 0x12e5 0x1272 0x1263 0x1691 0x14e6 0x13d5 0x12e8 0x1274 0x1265 0x1694 0x14ea 0x13d9 0x12e9 0x1276 0x1266 0x1690 0x14ea 0x13d9 0x12eb 0x1278 0x1268 0x1689 0x14e9 0x13d9 0x12ec 0x127a 0x1269 0x1686 0x14e9 0x13da 0x12ed 0x127b 0x126a 0x1682 0x14ee 0x13dc 0x12ef 0x127c 0x126b 0x167f 0x14f2 0x13dd 0x12f1 0x127e 0x126d 0x1683 0x14ed 0x13de 0x12f4 0x127f 0x126e 0x168a 0x14e4 0x13df 0x12f6 0x1281 0x126f 0x1694 0x14e1 0x13de 0x12f8 0x1282 0x1270 0x16aa 0x14e1 0x13de 0x12fa 0x1283 0x1270 0x16a9 0x14e3 0x13e0 0x12fc 0x1285 0x1272 0x168a 0x14eb 0x13e4 0x12fc 0x1285 0x1273 0x1690 0x14f3 0x13e4 0x1301 0x1286 0x1274 0x168a 0x14eb 0x13fa 0x1303 0x1288 0x1275 0x1694 0x1500 0x13f6 0x12ff 0x128a 0x1276 0x16a2 0x14fa 0x13fb 0x1305 0x1289 0x1275 0x16a5 0x1500 0x13f1 0x1306 0x1289 0x1276 0x16d0 0x14f0 0x13f2 0x1305 0x128a 0x1277 0x16cf 0x14ef 0x13f4 0x130d 0x128b 0x1277 0x1721 0x1506 0x13f4 0x130e 0x128e 0x127a 0x175e 0x1534 0x1411 0x1317 0x1291 0x127c 0x17bd 0x1577 0x1448 0x1323 0x1295 0x1280 0x17bd 0x1577 0x1448 0x1323 0x1295 0x1280 0x17bd 0x1577 0x1448 0x1323 0x1295 0x1280>;
					};

					qcom,pc-temp-y2-lut {
						qcom,lut-col-legend = <0xfffffff6 0x00 0x0a 0x19 0x28 0x32>;
						qcom,lut-row-legend = <0x2710 0x2648 0x2580 0x24b8 0x23f0 0x2328 0x2260 0x2198 0x20d0 0x2008 0x1f40 0x1e78 0x1db0 0x1ce8 0x1c20 0x1b58 0x1a90 0x19c8 0x1900 0x1838 0x1770 0x16a8 0x15e0 0x1518 0x1450 0x1388 0x12c0 0x11f8 0x1130 0x1068 0xfa0 0xed8 0xe10 0xd48 0xc80 0xbb8 0xaf0 0xa28 0x960 0x898 0x7d0 0x708 0x640 0x578 0x4b0 0x3e8 0x384 0x320 0x2bc 0x258 0x1f4 0x190 0x12c 0xc8 0x64 0x00>;
						qcom,lut-data = <0x28c5 0x2ad4 0x2c9a 0x2d7e 0x2ec2 0x307c 0x2909 0x2b15 0x2c8c 0x2d7f 0x2ee1 0x306b 0x2957 0x2b3e 0x2c7a 0x2d75 0x2ee9 0x3045 0x29a4 0x2b54 0x2c65 0x2d63 0x2ee0 0x3017 0x29e3 0x2b5d 0x2c4e 0x2d4c 0x2ecb 0x2ff2 0x2a0a 0x2b5f 0x2c37 0x2d35 0x2eaf 0x2fe3 0x2a1d 0x2b4f 0x2c1d 0x2d18 0x2e79 0x2fc0 0x2a2a 0x2b34 0x2c01 0x2cf7 0x2e47 0x2f90 0x2a33 0x2b20 0x2be5 0x2ccc 0x2e35 0x2f5c 0x2a39 0x2b0e 0x2bc7 0x2c99 0x2e28 0x2f07 0x2a40 0x2b06 0x2bb2 0x2c8d 0x2e24 0x2eec 0x2a48 0x2b09 0x2ba2 0x2cac 0x2e18 0x2f1b 0x2a54 0x2b0f 0x2b99 0x2cc6 0x2e0f 0x2f45 0x2a6f 0x2b1c 0x2ba1 0x2cb9 0x2e12 0x2f34 0x2aa7 0x2b3e 0x2bbb 0x2ca1 0x2e1a 0x2f0e 0x2ad9 0x2b65 0x2bda 0x2ca0 0x2e24 0x2f06 0x2b02 0x2b8f 0x2c05 0x2cbd 0x2e32 0x2f1a 0x2b20 0x2bbd 0x2c37 0x2ce8 0x2e38 0x2f29 0x2b27 0x2bee 0x2c77 0x2d34 0x2e1a 0x2f3b 0x2b25 0x2c23 0x2cb3 0x2d94 0x2df2 0x2f5d 0x2b1e 0x2c34 0x2cb9 0x2de6 0x2e3b 0x2f8b 0x2b12 0x2c08 0x2ca5 0x2e34 0x2f7e 0x2fe8 0x2af9 0x2bd8 0x2c9a 0x2e49 0x301b 0x304a 0x2a0a 0x2be4 0x2ca6 0x2df0 0x2f98 0x30b2 0x27a5 0x2c0e 0x2cbc 0x2d96 0x2f03 0x3108 0x2681 0x2c20 0x2cd1 0x2d94 0x2f06 0x3118 0x2649 0x2c22 0x2ce9 0x2d9b 0x2f31 0x3103 0x2628 0x2c23 0x2cf9 0x2da7 0x2f57 0x310e 0x260e 0x2c24 0x2d02 0x2dc9 0x2f7d 0x3148 0x25fa 0x2c28 0x2d09 0x2dee 0x2fa3 0x317b 0x25f0 0x2c2b 0x2d12 0x2e08 0x2fd0 0x3177 0x25ea 0x2c2a 0x2d21 0x2e1d 0x3000 0x315f 0x25e5 0x2c23 0x2d24 0x2e22 0x300b 0x317d 0x25e0 0x2c10 0x2d19 0x2e1d 0x2fed 0x31b8 0x25db 0x2bea 0x2d0d 0x2e1a 0x2fd7 0x31d7 0x25d6 0x2bc3 0x2cfc 0x2e2f 0x2fea 0x31a9 0x25d2 0x2b9c 0x2ce2 0x2e4e 0x3006 0x315c 0x25ce 0x2b6c 0x2cd1 0x2e44 0x2ffd 0x3154 0x25cb 0x2b30 0x2cc4 0x2e1d 0x2fe3 0x3186 0x25c8 0x2ad8 0x2cb0 0x2e11 0x2fd4 0x31a2 0x25c6 0x29fa 0x2c68 0x2e22 0x2fcf 0x3164 0x25c5 0x2752 0x2c08 0x2e23 0x2fc0 0x310d 0x25c3 0x2639 0x2bb2 0x2de7 0x2f71 0x30a0 0x25c2 0x25ff 0x2b1b 0x2dfd 0x2fa9 0x3105 0x25c0 0x25e0 0x2aaf 0x2d91 0x2f60 0x3096 0x25bf 0x25d4 0x2a19 0x2d94 0x2f36 0x3015 0x25c2 0x25cd 0x291d 0x2d8e 0x2f09 0x2f86 0x25cf 0x25c8 0x2831 0x2da1 0x2ec3 0x2f2c 0x25f2 0x25c3 0x27ae 0x2d81 0x2eb0 0x2f61 0x261f 0x25bf 0x2658 0x2d4f 0x2e92 0x2f64 0x25b8 0x25bd 0x25e2 0x2cdd 0x2e4f 0x2efe 0x25b2 0x25e7 0x25c2 0x2c58 0x2dfd 0x2e92 0x25b0 0x25b9 0x265b 0x2bf3 0x2d73 0x2e2c 0x25b2 0x25b2 0x25f9 0x2c04 0x2cfc 0x2d32 0x25b2 0x25b2 0x25f9 0x2c04 0x2cfc 0x2d32 0x25b2 0x25b2 0x25f9 0x2c04 0x2cfc 0x2d32>;
					};

					qcom,pc-temp-y3-lut {
						qcom,lut-col-legend = <0xfffffff6 0x00 0x0a 0x19 0x28 0x32>;
						qcom,lut-row-legend = <0x2710 0x2648 0x2580 0x24b8 0x23f0 0x2328 0x2260 0x2198 0x20d0 0x2008 0x1f40 0x1e78 0x1db0 0x1ce8 0x1c20 0x1b58 0x1a90 0x19c8 0x1900 0x1838 0x1770 0x16a8 0x15e0 0x1518 0x1450 0x1388 0x12c0 0x11f8 0x1130 0x1068 0xfa0 0xed8 0xe10 0xd48 0xc80 0xbb8 0xaf0 0xa28 0x960 0x898 0x7d0 0x708 0x640 0x578 0x4b0 0x3e8 0x384 0x320 0x2bc 0x258 0x1f4 0x190 0x12c 0xc8 0x64 0x00>;
						qcom,lut-data = <0x3464 0x3412 0x33f5 0x33e0 0x33d7 0x33d3 0x3464 0x3414 0x33f6 0x33e0 0x33d6 0x33d3 0x3464 0x3418 0x33f8 0x33e1 0x33d6 0x33d3 0x3465 0x341b 0x33fa 0x33e1 0x33d6 0x33d3 0x3466 0x341e 0x33fc 0x33e2 0x33d6 0x33d3 0x3467 0x3420 0x33fd 0x33e2 0x33d6 0x33d3 0x3468 0x3420 0x33fd 0x33e3 0x33d6 0x33d4 0x3469 0x3420 0x33fe 0x33e3 0x33d7 0x33d5 0x3469 0x3421 0x33fe 0x33e3 0x33d7 0x33d5 0x3468 0x3422 0x33fe 0x33e3 0x33d7 0x33d5 0x3467 0x3423 0x33fe 0x33e4 0x33d8 0x33d5 0x3464 0x3423 0x33fe 0x33e4 0x33d8 0x33d5 0x3460 0x3423 0x33fe 0x33e5 0x33d8 0x33d6 0x345f 0x3422 0x33ff 0x33e4 0x33d9 0x33d6 0x345e 0x3420 0x3400 0x33e4 0x33d9 0x33d6 0x345d 0x341f 0x3400 0x33e4 0x33d9 0x33d6 0x3459 0x341d 0x33ff 0x33e6 0x33db 0x33d6 0x3454 0x341c 0x33fe 0x33e8 0x33dc 0x33d6 0x344e 0x341b 0x33fd 0x33e9 0x33dc 0x33d7 0x3446 0x341b 0x33fc 0x33ea 0x33db 0x33d8 0x3440 0x341a 0x33fb 0x33ea 0x33db 0x33d9 0x343a 0x3414 0x33f9 0x33e9 0x33dd 0x33da 0x3434 0x340d 0x33f7 0x33e7 0x33de 0x33da 0x342c 0x340a 0x33f4 0x33e3 0x33da 0x33d7 0x3421 0x3408 0x33f2 0x33e0 0x33d6 0x33d3 0x341d 0x3407 0x33f1 0x33e0 0x33d6 0x33d3 0x341f 0x3405 0x33f0 0x33e0 0x33d6 0x33d3 0x3422 0x3404 0x33f0 0x33e0 0x33d5 0x33d3 0x3422 0x3403 0x33ef 0x33df 0x33d5 0x33d3 0x3420 0x3402 0x33ef 0x33df 0x33d5 0x33d3 0x3421 0x3400 0x33ef 0x33df 0x33d6 0x33d3 0x342c 0x33fc 0x33ee 0x33e0 0x33d6 0x33d2 0x343a 0x33f9 0x33ee 0x33e0 0x33d6 0x33d2 0x3448 0x33fa 0x33ee 0x33e0 0x33d6 0x33d3 0x3458 0x33fd 0x33ed 0x33e0 0x33d6 0x33d3 0x346a 0x3400 0x33ed 0x33e0 0x33d6 0x33d3 0x3481 0x3402 0x33ed 0x33df 0x33d6 0x33d2 0x349e 0x3405 0x33ee 0x33df 0x33d6 0x33d2 0x34c2 0x3407 0x33ee 0x33de 0x33d5 0x33d2 0x34f0 0x340a 0x33ef 0x33de 0x33d5 0x33d2 0x3524 0x340e 0x33f0 0x33de 0x33d5 0x33d3 0x3562 0x3414 0x33f2 0x33de 0x33d6 0x33d4 0x35af 0x341d 0x33f4 0x33de 0x33d6 0x33d4 0x3616 0x342c 0x33f5 0x33de 0x33d5 0x33d4 0x36ac 0x3445 0x33f5 0x33dc 0x33d5 0x33d3 0x3770 0x3469 0x33fd 0x33df 0x33d6 0x33d4 0x383f 0x3491 0x3400 0x33e1 0x33d7 0x33d6 0x393b 0x34d8 0x3406 0x33e4 0x33db 0x33d7 0x3a1a 0x3547 0x3419 0x33e7 0x33dc 0x33d8 0x3bdb 0x3609 0x3437 0x33e6 0x33db 0x33d7 0x3970 0x37b3 0x347e 0x33e6 0x33d9 0x33d6 0x3cf7 0x39ef 0x35ef 0x33e8 0x33db 0x33d7 0x4907 0x3737 0x399f 0x33ed 0x33db 0x33d8 0x8142 0x3b50 0x36b6 0x3404 0x33de 0x33da 0x8142 0x3b50 0x36b6 0x3404 0x33de 0x33da 0x8142 0x3b50 0x36b6 0x3404 0x33de 0x33da>;
					};

					qcom,pc-temp-y4-lut {
						qcom,lut-col-legend = <0xfffffff6 0x00 0x0a 0x19 0x28 0x32>;
						qcom,lut-row-legend = <0x2710 0x2648 0x2580 0x24b8 0x23f0 0x2328 0x2260 0x2198 0x20d0 0x2008 0x1f40 0x1e78 0x1db0 0x1ce8 0x1c20 0x1b58 0x1a90 0x19c8 0x1900 0x1838 0x1770 0x16a8 0x15e0 0x1518 0x1450 0x1388 0x12c0 0x11f8 0x1130 0x1068 0xfa0 0xed8 0xe10 0xd48 0xc80 0xbb8 0xaf0 0xa28 0x960 0x898 0x7d0 0x708 0x640 0x578 0x4b0 0x3e8 0x384 0x320 0x2bc 0x258 0x1f4 0x190 0x12c 0xc8 0x64 0x00>;
						qcom,lut-data = <0x40ea 0x409a 0x4071 0x4056 0x403c 0x4035 0x410c 0x40ac 0x407f 0x4054 0x403a 0x4033 0x4148 0x40ca 0x408d 0x4050 0x4036 0x4030 0x418a 0x40eb 0x4098 0x404c 0x4032 0x402c 0x41c1 0x4106 0x40a0 0x4049 0x402f 0x402a 0x41da 0x4110 0x40a2 0x4048 0x402e 0x4028 0x41de 0x410f 0x409f 0x4047 0x402e 0x4027 0x41e0 0x410d 0x409a 0x4047 0x402e 0x4027 0x41de 0x4108 0x4095 0x4047 0x402e 0x4027 0x41d7 0x4100 0x4090 0x4048 0x402f 0x4028 0x41d4 0x40fc 0x408e 0x404a 0x4030 0x4028 0x41d9 0x40fc 0x408e 0x404b 0x4031 0x4029 0x41e3 0x40fc 0x408f 0x404e 0x4033 0x402b 0x41f2 0x4100 0x4092 0x4053 0x4036 0x402c 0x4208 0x4110 0x409a 0x405a 0x403a 0x402f 0x4212 0x4124 0x40a5 0x4061 0x403d 0x4032 0x420f 0x4148 0x40b7 0x4068 0x4040 0x4036 0x4207 0x4169 0x40ce 0x4071 0x4044 0x403b 0x41ef 0x416f 0x40f0 0x4081 0x404d 0x403f 0x41b4 0x4172 0x4113 0x4095 0x4059 0x4044 0x417d 0x4170 0x4112 0x40a3 0x4067 0x404e 0x414f 0x4133 0x40ec 0x40b0 0x407a 0x405f 0x4129 0x40e4 0x40c1 0x40b2 0x4081 0x4067 0x4114 0x40c0 0x4094 0x4080 0x405f 0x404f 0x4106 0x40a8 0x406f 0x404b 0x4038 0x4030 0x40f8 0x4098 0x4064 0x4042 0x4032 0x402c 0x40e3 0x408f 0x405e 0x403f 0x4030 0x402b 0x40d5 0x4088 0x405c 0x403e 0x4030 0x402a 0x40d8 0x4080 0x405d 0x4041 0x4032 0x402c 0x40e1 0x4079 0x405d 0x4044 0x4035 0x402e 0x40e6 0x4073 0x405e 0x404a 0x4039 0x4032 0x40e6 0x406e 0x4060 0x4051 0x403e 0x4037 0x40e7 0x406a 0x4060 0x4057 0x4044 0x403c 0x40ea 0x406c 0x405f 0x405d 0x404d 0x4043 0x40f0 0x4072 0x405d 0x405f 0x4051 0x4047 0x40f6 0x407a 0x405f 0x405f 0x404c 0x4041 0x40fe 0x4088 0x4062 0x405d 0x4041 0x4035 0x4105 0x4098 0x4065 0x4055 0x4039 0x402f 0x410b 0x40a6 0x4068 0x4042 0x4032 0x402c 0x4110 0x40b2 0x406c 0x403b 0x402f 0x402b 0x4111 0x40ba 0x4070 0x403e 0x4030 0x402b 0x410c 0x40c0 0x4074 0x403f 0x4030 0x402b 0x4107 0x40c1 0x407b 0x403f 0x402e 0x4029 0x4103 0x40c1 0x407b 0x403e 0x402d 0x4027 0x4108 0x40be 0x406c 0x4034 0x4025 0x4020 0x4109 0x40b9 0x407d 0x4043 0x402e 0x4027 0x4113 0x40c2 0x4092 0x404c 0x4032 0x402b 0x411a 0x40ce 0x40b0 0x405c 0x403b 0x403a 0x4103 0x40e2 0x40d9 0x4073 0x4062 0x4064 0x40e8 0x40ff 0x40ff 0x406d 0x4048 0x4047 0x594f 0x4127 0x411b 0x4063 0x4035 0x4033 0x791e 0x4135 0x4169 0x4076 0x403e 0x403b 0xe8e9 0x5753 0x428b 0x409d 0x4048 0x4046 0x7146 0x8f46 0x6c6e 0x410d 0x407e 0x4084 0x7146 0x8f46 0x6c6e 0x410d 0x407e 0x4084 0x7146 0x8f46 0x6c6e 0x410d 0x407e 0x4084>;
					};

					qcom,pc-temp-y5-lut {
						qcom,lut-col-legend = <0xfffffff6 0x00 0x0a 0x19 0x28 0x32>;
						qcom,lut-row-legend = <0x2710 0x2648 0x2580 0x24b8 0x23f0 0x2328 0x2260 0x2198 0x20d0 0x2008 0x1f40 0x1e78 0x1db0 0x1ce8 0x1c20 0x1b58 0x1a90 0x19c8 0x1900 0x1838 0x1770 0x16a8 0x15e0 0x1518 0x1450 0x1388 0x12c0 0x11f8 0x1130 0x1068 0xfa0 0xed8 0xe10 0xd48 0xc80 0xbb8 0xaf0 0xa28 0x960 0x898 0x7d0 0x708 0x640 0x578 0x4b0 0x3e8 0x384 0x320 0x2bc 0x258 0x1f4 0x190 0x12c 0xc8 0x64 0x00>;
						qcom,lut-data = <0x4086 0x4ad4 0x5150 0x4df6 0x5622 0x51e5 0x41b2 0x4d34 0x5529 0x53eb 0x5926 0x52be 0x4316 0x4fce 0x57eb 0x574e 0x5b05 0x5731 0x44a9 0x5231 0x59bf 0x58d6 0x5be8 0x5d41 0x4665 0x53ed 0x5ac6 0x5937 0x5bf9 0x62ea 0x4841 0x5491 0x5b25 0x591c 0x5b60 0x6643 0x4ada 0x5437 0x5a87 0x5753 0x59c0 0x6add 0x4d1c 0x538f 0x5950 0x54d7 0x5784 0x6eb6 0x4d66 0x530f 0x57b4 0x52b7 0x5534 0x6ba2 0x4d58 0x528a 0x54dc 0x4f7d 0x529d 0x635a 0x4d38 0x51ce 0x51f1 0x4d1c 0x5069 0x5dcd 0x4b8b 0x4fc8 0x4ec5 0x4b94 0x4ea3 0x5b25 0x497b 0x4cd7 0x4bf6 0x49ee 0x4ccf 0x58be 0x49dc 0x49b6 0x4a01 0x4632 0x4a0d 0x55ba 0x4ca1 0x45f8 0x480e 0x4185 0x4723 0x5264 0x4fe3 0x447c 0x45ce 0x40b9 0x46cc 0x4e75 0x5415 0x4568 0x423a 0x4194 0x48b1 0x490a 0x57db 0x476a 0x401c 0x4256 0x49f3 0x4609 0x5954 0x4d19 0x41ac 0x42bc 0x464c 0x46ad 0x5a60 0x5909 0x4599 0x4354 0x40e7 0x482a 0x5aca 0x5df7 0x4bf4 0x4668 0x418e 0x49e0 0x5b37 0x5d51 0x5808 0x4f8e 0x4870 0x4c52 0x5b62 0x5c9e 0x5f9c 0x5708 0x4f7c 0x4faf 0x5550 0x5d6a 0x6191 0x5beb 0x5643 0x562a 0x44b4 0x5fee 0x6264 0x5fcc 0x5b86 0x5d13 0x3b65 0x616e 0x626c 0x632d 0x5d12 0x60a0 0x384d 0x6215 0x6283 0x665e 0x5e08 0x6331 0x365a 0x6277 0x62e6 0x665c 0x5e03 0x63bc 0x34de 0x6275 0x6381 0x5fc0 0x5a93 0x5fd7 0x3392 0x6214 0x6410 0x5adf 0x5703 0x5a04 0x332f 0x6076 0x6413 0x5d35 0x55d9 0x53c5 0x3450 0x541d 0x639b 0x6144 0x551c 0x4d2a 0x358a 0x4926 0x6405 0x61f1 0x54a0 0x4bc4 0x3650 0x4adb 0x6613 0x613b 0x5321 0x4e0f 0x379c 0x5028 0x678a 0x60d0 0x5232 0x511d 0x384d 0x53fe 0x65c3 0x6353 0x5936 0x540a 0x3894 0x5823 0x6271 0x675c 0x638d 0x5751 0x38d5 0x5b7f 0x6184 0x6a14 0x646f 0x5a95 0x3943 0x5cfb 0x6294 0x6c65 0x6196 0x5dc0 0x39c7 0x5db6 0x630c 0x6c55 0x5fb8 0x61e0 0x3a1a 0x5b00 0x60ec 0x6599 0x5f87 0x69df 0x3a38 0x4b32 0x5dcd 0x61d2 0x5f9d 0x7235 0x396e 0x4098 0x59d1 0x6045 0x5fbd 0x784c 0x36d2 0x3b57 0x56e9 0x60b7 0x611c 0x77ed 0x3656 0x3a04 0x574b 0x58be 0x6821 0x776a 0x350d 0x3915 0x5410 0x56c6 0x575e 0x60d4 0x3549 0x37f2 0x4ce8 0x5393 0x519f 0x63e1 0x36c2 0x37d3 0x45e2 0x57c0 0x6982 0x6ade 0x5266 0x370f 0x494b 0x5be6 0x64c4 0x60c4 0x738b 0x37fa 0x4602 0x631d 0x6afa 0x68c9 0x25bc 0x38fd 0x404e 0x63e5 0x6c11 0x7368 0x22fd 0x4994 0x3811 0x6245 0x7768 0x77e1 0x235d 0x248e 0x3899 0x5ff6 0x6c0c 0x6e4c 0x2312 0x239e 0x2a58 0x5f03 0x67d3 0x6ab3 0x2312 0x239e 0x2a58 0x5f03 0x67d3 0x6ab3 0x2312 0x239e 0x2a58 0x5f03 0x67d3 0x6ab3>;
					};

					qcom,pc-temp-y6-lut {
						qcom,lut-col-legend = <0xfffffff6 0x00 0x0a 0x19 0x28 0x32>;
						qcom,lut-row-legend = <0x2710 0x2648 0x2580 0x24b8 0x23f0 0x2328 0x2260 0x2198 0x20d0 0x2008 0x1f40 0x1e78 0x1db0 0x1ce8 0x1c20 0x1b58 0x1a90 0x19c8 0x1900 0x1838 0x1770 0x16a8 0x15e0 0x1518 0x1450 0x1388 0x12c0 0x11f8 0x1130 0x1068 0xfa0 0xed8 0xe10 0xd48 0xc80 0xbb8 0xaf0 0xa28 0x960 0x898 0x7d0 0x708 0x640 0x578 0x4b0 0x3e8 0x384 0x320 0x2bc 0x258 0x1f4 0x190 0x12c 0xc8 0x64 0x00>;
						qcom,lut-data = <0x15a4 0x145b 0x13dd 0x137a 0x1358 0x1351 0x15ab 0x1466 0x13de 0x1379 0x1357 0x1350 0x15b0 0x146d 0x13df 0x1377 0x1356 0x134f 0x15b2 0x1471 0x13df 0x1376 0x1355 0x134e 0x15b3 0x1472 0x13de 0x1375 0x1354 0x134e 0x15b3 0x1472 0x13dd 0x1375 0x1354 0x134e 0x15b0 0x146f 0x13db 0x1374 0x1354 0x134e 0x15a9 0x1469 0x13d7 0x1374 0x1355 0x134f 0x15a3 0x1464 0x13d4 0x1374 0x1355 0x134f 0x159c 0x1460 0x13d0 0x1374 0x1355 0x1350 0x1598 0x145d 0x13ce 0x1375 0x1356 0x1350 0x1596 0x1459 0x13cc 0x1375 0x1357 0x1351 0x1595 0x1456 0x13cb 0x1377 0x1358 0x1352 0x1596 0x1456 0x13cc 0x1378 0x1359 0x1353 0x1599 0x1458 0x13cd 0x1379 0x135b 0x1354 0x159b 0x145b 0x13d0 0x137c 0x135c 0x1355 0x1599 0x1464 0x13d3 0x137f 0x135e 0x1356 0x1596 0x146d 0x13d8 0x1383 0x1361 0x1358 0x158e 0x146e 0x13e1 0x1389 0x1363 0x135a 0x157b 0x146e 0x13eb 0x138f 0x1366 0x135d 0x156b 0x146d 0x13ea 0x1393 0x136a 0x1360 0x155f 0x1459 0x13de 0x1396 0x1371 0x1366 0x1554 0x143f 0x13d1 0x1396 0x1374 0x1368 0x154a 0x1435 0x13c2 0x1386 0x1368 0x135f 0x1540 0x142e 0x13b7 0x1374 0x135a 0x1354 0x153c 0x142c 0x13b4 0x1372 0x1358 0x1352 0x153f 0x142b 0x13b3 0x1371 0x1357 0x1352 0x1543 0x142b 0x13b3 0x1371 0x1357 0x1352 0x154a 0x142b 0x13b4 0x1372 0x1358 0x1353 0x1557 0x142c 0x13b6 0x1373 0x1359 0x1354 0x1566 0x142d 0x13b7 0x1375 0x135a 0x1355 0x1578 0x142e 0x13b9 0x1378 0x135c 0x1356 0x158c 0x1430 0x13bb 0x137b 0x135e 0x1357 0x15a1 0x1435 0x13bc 0x137d 0x1361 0x135a 0x15b8 0x1442 0x13be 0x137e 0x1362 0x135b 0x15d2 0x144f 0x13c0 0x137e 0x1361 0x1359 0x15f1 0x145d 0x13c3 0x137e 0x135e 0x1356 0x1613 0x146e 0x13c7 0x137c 0x135c 0x1354 0x163b 0x1480 0x13cb 0x1377 0x1359 0x1353 0x1667 0x1493 0x13cf 0x1375 0x1358 0x1353 0x1697 0x14a7 0x13d5 0x1376 0x1359 0x1354 0x16cb 0x14bb 0x13dd 0x1377 0x135a 0x1355 0x170a 0x14d5 0x13e9 0x1378 0x1359 0x1354 0x175c 0x14f9 0x13f4 0x1378 0x1359 0x1353 0x17d1 0x152b 0x13f5 0x1375 0x1356 0x1351 0x1867 0x1562 0x1413 0x137c 0x135a 0x1354 0x18e4 0x159d 0x142b 0x1380 0x135c 0x1356 0x1975 0x15ea 0x144f 0x1388 0x1361 0x135c 0x1a44 0x1656 0x1488 0x1391 0x136e 0x1369 0x1bf5 0x16ff 0x14ce 0x1390 0x1365 0x1360 0x21ad 0x1823 0x1545 0x138d 0x135f 0x135a 0x2dcd 0x1970 0x16a5 0x1397 0x1363 0x135d 0x5694 0x1ed0 0x190a 0x13a9 0x1367 0x1361 0x5b44 0x3267 0x2507 0x13da 0x1379 0x1375 0x5b44 0x3267 0x2507 0x13da 0x1379 0x1375 0x5b44 0x3267 0x2507 0x13da 0x1379 0x1375>;
					};
				};
			};

			qcom_cp_manager {
				compatible = "xiaomi,usbpd-pm";
				status = "ok";
				mi,pd-bat-volt-max = <0x1194>;
				mi,pd-ffc-bat-volt-max = <0x1194>;
				mi,pd-bat-curr-max = <0x1770>;
				mi,pd-bus-volt-max = <0x2ee0>;
				mi,pd-bus-curr-max = <0xbb8>;
				mi,pd-bus-curr-compensate = <0x64>;
				#io-channel-cells = <0x01>;
				io-channels = <0x10 0x04 0x10 0xb2 0x10 0xb3 0x0d 0x90 0x0d 0x76 0x0d 0x8f 0x0d 0x92 0x0d 0x93 0x0d 0x94 0x0d 0x95 0x0d 0x96 0x0d 0x97 0x0d 0x98 0x0d 0x99 0x0d 0x9a 0x0d 0x9b 0x0d 0x91 0x0d 0x9c 0x0d 0x9d 0x0d 0xab 0x0d 0xe9 0x10 0xac 0x10 0xad 0x0f 0x90 0x0f 0x76 0x0f 0x8f 0x0f 0x92 0x0f 0x93 0x0f 0x94 0x0f 0x95 0x0f 0x96 0x0f 0x97 0x0f 0x98 0x0f 0x99 0x0f 0x9a 0x0f 0x9b 0x0f 0x91 0x0f 0x9c 0x0f 0xe9>;
				io-channel-names = "pd_active\0cp_input_suspend\0battery_charging_enabled\0present\0charging_enabled\0status\0sc_battery_present\0sc_vbus_present\0sc_battery_voltage\0sc_battery_current\0sc_battery_temperature\0sc_bus_voltage\0sc_bus_current\0sc_bus_temperature\0sc_die_temperature\0sc_alarm_status\0sc_fault_status\0sc_vbus_error_status\0sc_chip_vendor\0sc_chip_id\0sc_set_cp_workmode\0apdo_volt\0apdo_curr\0bq_present\0bq_charging_enabled\0bq_status\0bq_battery_present\0bq_vbus_present\0bq_battery_voltage\0bq_battery_current\0bq_battery_temperature\0bq_bus_voltage\0bq_bus_current\0bq_bus_temperature\0bq_die_temperature\0bq_alarm_status\0bq_fault_status\0bq_vbus_error_status\0bq_set_cp_workmode";
			};

			cp_qc30 {
				compatible = "xiaomi,cp-qc30";
				status = "ok";
				mi,qc3-bat-volt-max = <0x1162>;
				mi,qc3-ffc-bat-volt-max = <0x1162>;
				mi,qc3-bat-curr-max = <0x1518>;
				mi,qc3-bus-volt-max = <0x2ee0>;
				mi,qc3-bus-curr-max = <0x834>;
				#io-channel-cells = <0x01>;
				io-channels = <0x10 0x0a 0x10 0xea 0x10 0xb2 0x10 0xb3 0x10 0x3e 0x10 0xbf 0x0d 0x90 0x0d 0x76 0x0d 0x8f 0x0d 0x92 0x0d 0x93 0x0d 0x94 0x0d 0x95 0x0d 0x96 0x0d 0x97 0x0d 0x98 0x0d 0x99 0x0d 0x9a 0x0d 0x9b 0x0d 0x91 0x0d 0x9c 0x0d 0x9d 0x0d 0xab 0x0d 0xbc 0x0f 0x90 0x0f 0x76 0x0f 0x8f 0x0f 0x92 0x0f 0x93 0x0f 0x94 0x0f 0x95 0x0f 0x96 0x0f 0x97 0x0f 0x98 0x0f 0x99 0x0f 0x9a 0x0f 0x9b 0x0f 0x91 0x0f 0x9c 0x0f 0xbc>;
				io-channel-names = "real_type\0hvdcp3_type\0cp_input_suspend\0battery_charging_enabled\0battery_dp_dm\0battery_charging_limited\0present\0charging_enabled\0status\0sc_battery_present\0sc_vbus_present\0sc_battery_voltage\0sc_battery_current\0sc_battery_temperature\0sc_bus_voltage\0sc_bus_current\0sc_bus_temperature\0sc_die_temperature\0sc_alarm_status\0sc_fault_status\0sc_vbus_error_status\0sc_chip_vendor\0sc_chip_id\0sc_set_bus_protection\0bq_present\0bq_charging_enabled\0bq_status\0bq_battery_present\0bq_vbus_present\0bq_battery_voltage\0bq_battery_current\0bq_battery_temperature\0bq_bus_voltage\0bq_bus_current\0bq_bus_temperature\0bq_die_temperature\0bq_alarm_status\0bq_fault_status\0bq_vbus_error_status\0bq_set_bus_protection";
			};
		};
	};

	fragment@23 {
		target = <0xffffffff>;

		__overlay__ {
			status = "ok";
			qcom,bus-recovery;

			qcom,smb1355@c {
				compatible = "qcom,i2c-pmic";
				reg = <0x0c>;
				#address-cells = <0x01>;
				#size-cells = <0x00>;
				interrupt-parent = <0xffffffff>;
				interrupts = <0x02 0xc5 0x00 0x08>;
				interrupt_names = "smb1355";
				interrupt-controller;
				#interrupt-cells = <0x03>;
				qcom,periph-map = <0x10 0x12 0x13 0x16>;
				status = "disabled";
				pinctrl-names = "default";
				pinctrl-0 = <0x23>;
				phandle = <0x24>;

				qcom,smb1355-charger@1000 {
					compatible = "qcom,smb1355";
					reg = <0x1000>;
					#address-cells = <0x01>;
					#size-cells = <0x01>;
					interrupt-parent = <0x24>;
					status = "disabled";
					qcom,parallel-mode = <0x01>;
					qcom,hw-die-temp-mitigation;
					phandle = <0x36>;

					qcom,chgr@1000 {
						reg = <0x1000>;
						interrupts = <0x10 0x01 0x01>;
						interrupt-names = "chg-state-change";
					};

					qcom,chgr-misc@1600 {
						reg = <0x1600>;
						interrupts = <0x16 0x01 0x01 0x16 0x06 0x01>;
						interrupt-names = "wdog-bark\0temperature-change";
					};
				};
			};

			qcom,smb1355@8 {
				compatible = "qcom,i2c-pmic";
				reg = <0x08>;
				#address-cells = <0x01>;
				#size-cells = <0x00>;
				interrupt-parent = <0xffffffff>;
				interrupts = <0x00 0xd1 0x00 0x08>;
				interrupt_names = "smb1355_0";
				interrupt-controller;
				#interrupt-cells = <0x03>;
				qcom,periph-map = <0x10 0x12 0x13 0x16>;
				status = "disabled";
				phandle = <0x25>;

				qcom,smb1355-charger@1000 {
					compatible = "qcom,smb1355";
					reg = <0x1000>;
					#address-cells = <0x01>;
					#size-cells = <0x01>;
					interrupt-parent = <0x25>;
					status = "disabled";
					phandle = <0x37>;

					qcom,chgr@1000 {
						reg = <0x1000>;
						interrupts = <0x10 0x01 0x01>;
						interrupt-names = "chg-state-change";
					};

					qcom,chgr-misc@1600 {
						reg = <0x1600>;
						interrupts = <0x16 0x01 0x01 0x16 0x06 0x01>;
						interrupt-names = "wdog-bark\0temperature-change";
					};
				};
			};

			sc8541@6a {
				compatible = "sc,sc8541-standalone";
				status = "ok";
				dep-supply = <0xffffffff>;
				#io-channel-cells = <0x01>;
				reg = <0x6a>;
				sc8541,intr_gpio = <0xffffffff 0x54 0x00>;
				charger_name = "primary_dvchg";
				sc,sc8541,vbat-ovp-dis = <0x00>;
				sc,sc8541,vbat-ovp = <0x5a>;
				sc,sc8541,vbat-ovp-alm-dis = <0x01>;
				sc,sc8541,vbat-ovp-alm = <0x46>;
				sc,sc8541,ibat-ocp-dis = <0x00>;
				sc,sc8541,ibat-ocp = <0x51>;
				sc,sc8541,ibat-ocp-alm-dis = <0x01>;
				sc,sc8541,ibat-ocp-alm = <0x50>;
				sc,sc8541,ibus-ucp-dis = <0x00>;
				sc,sc8541,vbus-in-range-dis = <0x00>;
				sc,sc8541,vbus-pd-en = <0x00>;
				sc,sc8541,vbus-ovp = <0x64>;
				sc,sc8541,vbus-ovp-alm-dis = <0x01>;
				sc,sc8541,vbus-ovp-alm = <0x50>;
				sc,sc8541,ibus-ocp-dis = <0x00>;
				sc,sc8541,ibus-ocp = <0x0d>;
				sc,sc8541,tshut-dis = <0x01>;
				sc,sc8541,tsbus-flt-dis = <0x01>;
				sc,sc8541,tsbat-flt-dis = <0x01>;
				sc,sc8541,tdie-alm = <0xc8>;
				sc,sc8541,tsbus-flt = <0x15>;
				sc,sc8541,tsbat-flt = <0x15>;
				sc,sc8541,vac1-ovp = <0x03>;
				sc,sc8541,vac2-ovp = <0x03>;
				sc,sc8541,vac1-pd-en = <0x00>;
				sc,sc8541,vac2-pd-en = <0x00>;
				sc,sc8541,fsw-set = <0x04>;
				sc,sc8541,wd-timeout = <0x00>;
				sc,sc8541,wd-timeout-dis = <0x01>;
				sc,sc8541,ibat-sns-r = <0x00>;
				sc,sc8541,ss-timeout = <0x07>;
				sc,sc8541,ibus-ucp-fall-dg = <0x01>;
				sc,sc8541,vout-ovp-dis = <0x00>;
				sc,sc8541,ms = <0x00>;
				sc,sc8541,vout-ovp = <0x03>;
				sc,sc8541,pmid2out-uvp = <0x07>;
				sc,sc8541,pmid2out-ovp = <0x07>;
				phandle = <0x0d>;
			};

			bq25960@65 {
				compatible = "bq,bq25960-standalone";
				#io-channel-cells = <0x01>;
				status = "ok";
				dep-supply = <0xffffffff>;
				reg = <0x65>;
				bq25960,intr_gpio = <0xffffffff 0x54 0x00>;
				charger_name = "primary_dvchg";
				bq,bq25960,vbat-ovp-dis = <0x00>;
				bq,bq25960,vbat-ovp = <0x7f>;
				bq,bq25960,vbat-ovp-alm-dis = <0x01>;
				bq,bq25960,vbat-ovp-alm = <0x7a>;
				bq,bq25960,ibat-ocp-dis = <0x00>;
				bq,bq25960,ibat-ocp = <0x3d>;
				bq,bq25960,ibat-ocp-alm-dis = <0x01>;
				bq,bq25960,ibat-ocp-alm = <0x3d>;
				bq,bq25960,ibus-ucp-dis = <0x00>;
				bq,bq25960,ibus-ucp = <0x00>;
				bq,bq25960,chg-config-2 = <0x00>;
				bq,bq25960,vbus-pd-en = <0x00>;
				bq,bq25960,vbus-ovp = <0x64>;
				bq,bq25960,vbus-ovp-alm-dis = <0x00>;
				bq,bq25960,vbus-ovp-alm = <0x64>;
				bq,bq25960,ibus-ocp = <0x0d>;
				bq,bq25960,tsbus-flt-dis = <0x01>;
				bq,bq25960,tsbat-flt-dis = <0x01>;
				bq,bq25960,tdie-alm = <0xc8>;
				bq,bq25960,tsbus-flt = <0x15>;
				bq,bq25960,tsbat-flt = <0x15>;
				bq,bq25960,vac1-ovp = <0x03>;
				bq,bq25960,vac2-ovp = <0x03>;
				bq,bq25960,vac1-pd-en = <0x00>;
				bq,bq25960,vac2-pd-en = <0x00>;
				bq,bq25960,fsw-set = <0x04>;
				bq,bq25960,wd-timeout = <0x00>;
				bq,bq25960,wd-timeout-dis = <0x01>;
				bq,bq25960,ibat-sns-r = <0x00>;
				bq,bq25960,ss-timeout = <0x05>;
				bq,bq25960,ibus-ucp-fall-dg = <0x01>;
				bq,bq25960,vout-ovp-dis = <0x00>;
				bq,bq25960,ms = <0x00>;
				bq,bq25960,vout-ovp = <0x03>;
				phandle = <0x0f>;
			};
		};
	};

	fragment@24 {
		target = <0xffffffff>;

		__overlay__ {
			extcon = <0x26 0x10 0xffffffff>;
		};
	};

	__symbols__ {
		fingerprints_reset_high = "/fragment@2/__overlay__/fingerprints_reset_high";
		fingerprints_reset_low = "/fragment@2/__overlay__/fingerprints_reset_low";
		fingerprints_eint_default = "/fragment@2/__overlay__/fingerprints_eint_default";
		fingerprints_eint_pulldown = "/fragment@2/__overlay__/fingerprints_eint_pulldown";
		fingerprints_pwr_high = "/fragment@2/__overlay__/fingerprints_pwr_high";
		fingerprints_pwr_low = "/fragment@2/__overlay__/fingerprints_pwr_low";
		oled_vci_default = "/fragment@6/__overlay__/oled_vci/oled_vci_default";
		oled_vci_suspend = "/fragment@6/__overlay__/oled_vci/oled_vci_suspend";
		cam_sensor_avdd1_default = "/fragment@6/__overlay__/cam_avdd1/cam_sensor_avdd1_default";
		cam_sensor_avdd1_suspend = "/fragment@6/__overlay__/cam_avdd1/cam_sensor_avdd1_suspend";
		flash_default = "/fragment@6/__overlay__/flash/flash_default";
		flash_suspend = "/fragment@6/__overlay__/flash/flash_suspend";
		rf_pa1_therm_default = "/fragment@6/__overlay__/rf_pa1_therm/rf_pa1_therm_default";
		key_vol_up_default = "/fragment@6/__overlay__/key_vol_up/key_vol_up_default";
		usb_eldo9 = "/fragment@6/__overlay__/eldo9_pin/gpio@c000";
		vdda_usb_ss_dp_core = "/fragment@7/__overlay__/vdda_usb_ss_dp_core";
		pm7250b_charger = "/fragment@15/__overlay__/qcom,pm7250b@2/qcom,qpnp-smb5";
		smb5_vbus = "/fragment@15/__overlay__/qcom,pm7250b@2/qcom,qpnp-smb5/qcom,smb5-vbus";
		smb5_vconn = "/fragment@15/__overlay__/qcom,pm7250b@2/qcom,qpnp-smb5/qcom,smb5-vconn";
		pm7250b_pdphy = "/fragment@15/__overlay__/qcom,pm7250b@2/qcom,usb-pdphy@1700";
		pm7250b_tz = "/fragment@15/__overlay__/qcom,pm7250b@2/qcom,temp-alarm@2400";
		pm7250b_qg = "/fragment@15/__overlay__/qcom,pm7250b@2/qpnp,qg";
		pm7250b_clkdiv = "/fragment@15/__overlay__/qcom,pm7250b@2/clock-controller@5b00";
		pm7250b_gpios = "/fragment@15/__overlay__/qcom,pm7250b@2/pinctrl@c000";
		disp_lcd_bias_en_default = "/fragment@15/__overlay__/qcom,pm7250b@2/pinctrl@c000/disp_lcd_bias_en/disp_lcd_bias_en_default";
		pm7250b_smb_int_default = "/fragment@15/__overlay__/qcom,pm7250b@2/pinctrl@c000/pm7250b_smb_int_default";
		pm7250b_vadc = "/fragment@15/__overlay__/qcom,pm7250b@2/vadc@3100";
		pm7250b_adc_tm = "/fragment@15/__overlay__/qcom,pm7250b@2/adc_tm@3500";
		pm7250b_bcl = "/fragment@15/__overlay__/qcom,pm7250b@2/bcl@1d00";
		bcl_soc = "/fragment@15/__overlay__/qcom,pm7250b@2/bcl-soc";
		pm7250b_vib = "/fragment@15/__overlay__/qcom,pm7250b@3/qcom,vibrator@5300";
		pm7250b_temp_alarm = "/fragment@16/__overlay__/pm7250b-tz";
		pm7250b_trip0 = "/fragment@16/__overlay__/pm7250b-tz/trips/trip0";
		pm7250b_trip1 = "/fragment@16/__overlay__/pm7250b-tz/trips/trip1";
		ibat_lvl0 = "/fragment@16/__overlay__/pm7250b-ibat-lvl0/trips/ibat-lvl0";
		ibat_lvl1 = "/fragment@16/__overlay__/pm7250b-ibat-lvl1/trips/ibat-lvl1";
		b_bcl_lvl0 = "/fragment@16/__overlay__/pm7250b-bcl-lvl0/trips/b-bcl-lvl0";
		b_bcl_lvl1 = "/fragment@16/__overlay__/pm7250b-bcl-lvl1/trips/b-bcl-lvl1";
		b_bcl_lvl2 = "/fragment@16/__overlay__/pm7250b-bcl-lvl2/trips/b-bcl-lvl2";
		soc_trip = "/fragment@16/__overlay__/socd/trips/soc-trip";
		onewire_gpio = "/fragment@19/__overlay__/onewire_gpio";
		maxim_ds28e30 = "/fragment@19/__overlay__/maxim_ds28e30";
		acl_slg = "/fragment@19/__overlay__/acl_slg";
		st_stick = "/fragment@19/__overlay__/st_stick";
		auth_battery = "/fragment@19/__overlay__/auth_battery";
		onewire_gpio_active = "/fragment@20/__overlay__/onewire_gpio_active";
		onewire_gpio_sleep = "/fragment@20/__overlay__/onewire_gpio_sleep";
		xm_smart_chg = "/fragment@21/__overlay__/xm_smart_chg";
		mtp_batterydata = "/fragment@22/__overlay__/qcom,battery-data";
		smb1355 = "/fragment@23/__overlay__/qcom,smb1355@c";
		smb1355_charger = "/fragment@23/__overlay__/qcom,smb1355@c/qcom,smb1355-charger@1000";
		smb1355_0 = "/fragment@23/__overlay__/qcom,smb1355@8";
		smb1355_charger_0 = "/fragment@23/__overlay__/qcom,smb1355@8/qcom,smb1355-charger@1000";
		sc8541_standalone = "/fragment@23/__overlay__/sc8541@6a";
		bq25960_standalone = "/fragment@23/__overlay__/bq25960@65";
	};

	__fixups__ {
		thermal_zones = "/fragment@0:target:0\0/fragment@5:target:0\0/fragment@16:target:0\0/fragment@17:target:0\0/fragment@18:target:0";
		pm6125_trip0 = "/fragment@0/__overlay__/pm6125-tz/cooling-maps/trip0_cpu0:trip:0\0/fragment@0/__overlay__/pm6125-tz/cooling-maps/trip0_cpu4:trip:0";
		CPU0 = "/fragment@0/__overlay__/pm6125-tz/cooling-maps/trip0_cpu0:cooling-device:0";
		CPU4 = "/fragment@0/__overlay__/pm6125-tz/cooling-maps/trip0_cpu4:cooling-device:0\0/fragment@18/__overlay__/pm7250b-bcl-lvl0/cooling-maps/lbat0_cpufreq4:cooling-device:0";
		pm6125_trip1 = "/fragment@0/__overlay__/pm6125-tz/cooling-maps/trip1_cpu1:trip:0\0/fragment@0/__overlay__/pm6125-tz/cooling-maps/trip1_cpu2:trip:0\0/fragment@0/__overlay__/pm6125-tz/cooling-maps/trip1_cpu3:trip:0\0/fragment@0/__overlay__/pm6125-tz/cooling-maps/trip1_cpu4:trip:0\0/fragment@0/__overlay__/pm6125-tz/cooling-maps/trip1_cpu5:trip:0\0/fragment@0/__overlay__/pm6125-tz/cooling-maps/trip1_cpu6:trip:0\0/fragment@0/__overlay__/pm6125-tz/cooling-maps/trip1_cpu7:trip:0";
		cpu1_pause = "/fragment@0/__overlay__/pm6125-tz/cooling-maps/trip1_cpu1:cooling-device:0";
		cpu2_pause = "/fragment@0/__overlay__/pm6125-tz/cooling-maps/trip1_cpu2:cooling-device:0";
		cpu3_pause = "/fragment@0/__overlay__/pm6125-tz/cooling-maps/trip1_cpu3:cooling-device:0";
		cpu4_pause = "/fragment@0/__overlay__/pm6125-tz/cooling-maps/trip1_cpu4:cooling-device:0\0/fragment@18/__overlay__/socd/cooling-maps/soc_cpu4:cooling-device:0\0/fragment@18/__overlay__/pm7250b-bcl-lvl1/cooling-maps/lbat1_cpu4:cooling-device:0";
		cpu5_pause = "/fragment@0/__overlay__/pm6125-tz/cooling-maps/trip1_cpu5:cooling-device:0\0/fragment@18/__overlay__/socd/cooling-maps/soc_cpu5:cooling-device:0\0/fragment@18/__overlay__/pm7250b-bcl-lvl1/cooling-maps/lbat1_cpu5:cooling-device:0";
		cpu6_pause = "/fragment@0/__overlay__/pm6125-tz/cooling-maps/trip1_cpu6:cooling-device:0\0/fragment@18/__overlay__/socd/cooling-maps/soc_cpu6:cooling-device:0\0/fragment@18/__overlay__/pm7250b-bcl-lvl0/cooling-maps/lbat0_cpu6:cooling-device:0";
		cpu7_pause = "/fragment@0/__overlay__/pm6125-tz/cooling-maps/trip1_cpu7:cooling-device:0\0/fragment@18/__overlay__/socd/cooling-maps/soc_cpu7:cooling-device:0\0/fragment@18/__overlay__/pm7250b-bcl-lvl0/cooling-maps/lbat0_cpu7:cooling-device:0";
		soc = "/fragment@1:target:0\0/fragment@7:target:0\0/fragment@19:target:0\0/fragment@21:target:0\0/fragment@22:target:0";
		tlmm = "/fragment@1/__overlay__/fingerprint_xiaomi:xiaomi,gpio_irq:0\0/fragment@1/__overlay__/fingerprint_xiaomi:fp-gpio-pwr:0\0/fragment@2:target:0\0/fragment@7/__overlay__/ant_check:interrupt-parent:0\0/fragment@7/__overlay__/ant_check:ant_check_gpio:0\0/fragment@7/__overlay__/ant_check_div:interrupt-parent:0\0/fragment@7/__overlay__/ant_check_div:ant_check_div_gpio:0\0/fragment@10/__overlay__:cd-gpios:0\0/fragment@12/__overlay__:reset-gpios:0\0/fragment@14/__overlay__/synaptics_tcm@20:interrupt-parent:0\0/fragment@14/__overlay__/synaptics_tcm@20:synaptics,irq-gpio:0\0/fragment@14/__overlay__/synaptics_tcm@20:synaptics,reset-gpio:0\0/fragment@14/__overlay__/novatek@62:interrupt-parent:0\0/fragment@14/__overlay__/novatek@62:novatek,reset-gpio:0\0/fragment@14/__overlay__/novatek@62:novatek,irq-gpio:0\0/fragment@19/__overlay__/onewire_gpio:onewire-gpio:0\0/fragment@20:target:0\0/fragment@23/__overlay__/sc8541@6a:sc8541,intr_gpio:0\0/fragment@23/__overlay__/bq25960@65:bq25960,intr_gpio:0";
		pm6125_l9 = "/fragment@1/__overlay__/fingerprint_xiaomi:vfp-supply:0";
		pm6125_vadc = "/fragment@3:target:0\0/fragment@4/__overlay__/rf_pa1_therm:io-channels:0";
		camera_therm_default = "/fragment@3/__overlay__:pinctrl-0:0";
		emmc_therm_default = "/fragment@3/__overlay__:pinctrl-0:4";
		pm6125_adc_tm = "/fragment@4:target:0\0/fragment@5/__overlay__/rf-pa1-therm-usr:thermal-sensors:0";
		pm6125_gpios = "/fragment@6:target:0\0/fragment@7/__overlay__/gpio_keys/vol_up:gpios:0\0/fragment@7/__overlay__/vdda_usb_ss_dp_core:gpio:0";
		ant_check_default = "/fragment@7/__overlay__/ant_check:pinctrl-0:0";
		ant_check_div_default = "/fragment@7/__overlay__/ant_check_div:pinctrl-0:0";
		usb_qmp_dp_phy = "/fragment@8:target:0";
		sdhc_1 = "/fragment@9:target:0";
		L24A = "/fragment@9/__overlay__:vdd-supply:0\0/fragment@12/__overlay__:vcc-supply:0";
		L11A = "/fragment@9/__overlay__:vdd-io-supply:0\0/fragment@12/__overlay__:vccq2-supply:0";
		sdc1_on = "/fragment@9/__overlay__:pinctrl-0:0";
		sdc1_off = "/fragment@9/__overlay__:pinctrl-1:0";
		sdhc_2 = "/fragment@10:target:0";
		L22A = "/fragment@10/__overlay__:vdd-supply:0";
		L5A = "/fragment@10/__overlay__:vdd-io-supply:0";
		L7A = "/fragment@10/__overlay__:vdd-io-bias-supply:0";
		sdc2_on = "/fragment@10/__overlay__:pinctrl-0:0";
		sdc2_off = "/fragment@10/__overlay__:pinctrl-1:0";
		ufsphy_mem = "/fragment@11:target:0";
		L4A = "/fragment@11/__overlay__:vdda-phy-supply:0";
		L18A = "/fragment@11/__overlay__:vdda-pll-supply:0\0/fragment@12/__overlay__:qcom,vddp-ref-clk-supply:0";
		ufshc_mem = "/fragment@12:target:0";
		gcc_ufs_phy_gdsc = "/fragment@12/__overlay__:vdd-hba-supply:0";
		gcc = "/fragment@12/__overlay__:resets:0";
		pm6125_pwm = "/fragment@13:target:0";
		qupv3_se2_i2c = "/fragment@14:target:0";
		ts_int_active = "/fragment@14/__overlay__/synaptics_tcm@20:pinctrl-0:0\0/fragment@14/__overlay__/novatek@62:pinctrl-0:0";
		ts_reset_active = "/fragment@14/__overlay__/synaptics_tcm@20:pinctrl-0:4\0/fragment@14/__overlay__/novatek@62:pinctrl-0:4";
		ts_int_suspend = "/fragment@14/__overlay__/synaptics_tcm@20:pinctrl-1:0\0/fragment@14/__overlay__/novatek@62:pinctrl-1:0";
		ts_reset_suspend = "/fragment@14/__overlay__/synaptics_tcm@20:pinctrl-1:4\0/fragment@14/__overlay__/novatek@62:pinctrl-1:4";
		ts_release = "/fragment@14/__overlay__/synaptics_tcm@20:pinctrl-2:0\0/fragment@14/__overlay__/novatek@62:pinctrl-2:0";
		spmi_bus = "/fragment@15:target:0\0/fragment@23/__overlay__/qcom,smb1355@c:interrupt-parent:0\0/fragment@23/__overlay__/qcom,smb1355@8:interrupt-parent:0";
		usb2_phy0 = "/fragment@15/__overlay__/qcom,pm7250b@2/qcom,qpnp-smb5:dpdm-supply:0";
		L15A = "/fragment@15/__overlay__/qcom,pm7250b@2/qcom,usb-pdphy@1700:vdd-pdphy-supply:0";
		pm6125_rtc = "/fragment@15/__overlay__/qcom,pm7250b@2/qpnp,qg:depends-on-supply:0";
		rpmcc = "/fragment@15/__overlay__/qcom,pm7250b@2/clock-controller@5b00:clocks:0";
		msm_gpu = "/fragment@18/__overlay__/pm7250b-bcl-lvl0/cooling-maps/lbat0_gpu:cooling-device:0\0/fragment@18/__overlay__/pm7250b-bcl-lvl1/cooling-maps/lbat1_gpu:cooling-device:0\0/fragment@18/__overlay__/pm7250b-bcl-lvl2/cooling-maps/lbat2_gpu:cooling-device:0";
		cdsp_sw = "/fragment@18/__overlay__/pm7250b-bcl-lvl0/cooling-maps/lbat0_cdsp:cooling-device:0\0/fragment@18/__overlay__/pm7250b-bcl-lvl1/cooling-maps/lbat1_cdsp:cooling-device:0\0/fragment@18/__overlay__/pm7250b-bcl-lvl2/cooling-maps/lbat2_cdsp:cooling-device:0";
		qupv3_se1_i2c = "/fragment@23:target:0\0/fragment@23/__overlay__/sc8541@6a:dep-supply:0\0/fragment@23/__overlay__/bq25960@65:dep-supply:0";
		usb0 = "/fragment@24:target:0";
		eud = "/fragment@24/__overlay__:extcon:8";
	};

	__local_fixups__ {

		fragment@1 {

			__overlay__ {

				fingerprint_xiaomi {
					pinctrl-0 = <0x00>;
					pinctrl-1 = <0x00>;
					pinctrl-2 = <0x00>;
					pinctrl-3 = <0x00>;
					pinctrl-4 = <0x00>;
					pinctrl-5 = <0x00>;
				};
			};
		};

		fragment@3 {

			__overlay__ {
				pinctrl-0 = <0x08>;
			};
		};

		fragment@7 {

			__overlay__ {

				gpio_keys {
					pinctrl-0 = <0x00>;
				};

				vdda_usb_ss_dp_core {
					pinctrl-0 = <0x00>;
				};
			};
		};

		fragment@8 {

			__overlay__ {
				vdd-supply = <0x00>;
			};
		};

		fragment@15 {

			__overlay__ {

				qcom,pm7250b@2 {

					qcom,qpnp-smb5 {
						depends-on-supply = <0x00>;
						io-channels = <0x00 0x08 0x10 0x18 0x20 0x28 0x30 0x38 0x40 0x48 0x50 0x58 0x60 0x68 0x70 0x78 0x80 0x88 0x90 0x98 0xa0 0xa8 0xb0 0xb8 0xc0 0xc8 0xd0 0xd8 0xe0 0xe8 0xf0 0xf8 0x100 0x108 0x110 0x118 0x120 0x128 0x130 0x138>;
						qcom,battery-data = <0x00>;
					};

					qcom,usb-pdphy@1700 {
						vbus-supply = <0x00>;
						vconn-supply = <0x00>;
						io-channels = <0x00 0x08 0x10 0x18 0x20 0x28 0x30 0x38 0x40 0x48 0x50 0x58 0x60 0x68>;
					};

					qcom,temp-alarm@2400 {
						io-channels = <0x00>;
					};

					qpnp,qg {
						io-channels = <0x00 0x08 0x10 0x18 0x20 0x28 0x30 0x38 0x40 0x48 0x50>;
						qcom,battery-data = <0x00>;
					};

					clock-controller@5b00 {
						assigned-clocks = <0x00>;
					};

					adc_tm@3500 {

						charger_skin_therm@4d {
							io-channels = <0x00>;
						};

						conn_therm@4f {
							io-channels = <0x00>;
						};
					};
				};
			};
		};

		fragment@16 {

			__overlay__ {

				pm7250b-tz {
					thermal-sensors = <0x00>;
				};

				pm7250b-ibat-lvl0 {
					thermal-sensors = <0x00>;
				};

				pm7250b-ibat-lvl1 {
					thermal-sensors = <0x00>;
				};

				pm7250b-bcl-lvl0 {
					thermal-sensors = <0x00>;
				};

				pm7250b-bcl-lvl1 {
					thermal-sensors = <0x00>;
				};

				pm7250b-bcl-lvl2 {
					thermal-sensors = <0x00>;
				};
			};
		};

		fragment@17 {

			__overlay__ {

				charger-therm-usr {
					thermal-sensors = <0x00>;
				};

				conn-therm-usr {
					thermal-sensors = <0x00>;
				};
			};
		};

		fragment@18 {

			__overlay__ {

				pm7250b-tz {

					cooling-maps {

						trip0_bat {
							trip = <0x00>;
							cooling-device = <0x00>;
						};

						trip1_bat {
							trip = <0x00>;
							cooling-device = <0x00>;
						};
					};
				};

				socd {

					cooling-maps {

						soc_cpu4 {
							trip = <0x00>;
						};

						soc_cpu5 {
							trip = <0x00>;
						};

						soc_cpu6 {
							trip = <0x00>;
						};

						soc_cpu7 {
							trip = <0x00>;
						};
					};
				};

				pm7250b-bcl-lvl0 {

					cooling-maps {

						lbat0_cpufreq4 {
							trip = <0x00>;
						};

						lbat0_cpu6 {
							trip = <0x00>;
						};

						lbat0_cpu7 {
							trip = <0x00>;
						};

						lbat0_gpu {
							trip = <0x00>;
						};

						lbat0_cdsp {
							trip = <0x00>;
						};
					};
				};

				pm7250b-bcl-lvl1 {

					cooling-maps {

						lbat1_cpu4 {
							trip = <0x00>;
						};

						lbat1_cpu5 {
							trip = <0x00>;
						};

						lbat1_gpu {
							trip = <0x00>;
						};

						lbat1_cdsp {
							trip = <0x00>;
						};
					};
				};

				pm7250b-bcl-lvl2 {

					cooling-maps {

						lbat2_gpu {
							trip = <0x00>;
						};

						lbat2_cdsp {
							trip = <0x00>;
						};
					};
				};
			};
		};

		fragment@19 {

			__overlay__ {

				onewire_gpio {
					pinctrl-0 = <0x00>;
					pinctrl-1 = <0x00>;
				};

				acl_slg {
					def-supply = <0x00>;
				};

				st_stick {
					def-supply = <0x00 0x04>;
				};

				auth_battery {
					def-supply = <0x00 0x04 0x08>;
				};
			};
		};

		fragment@21 {

			__overlay__ {

				xm_smart_chg {
					io-channels = <0x00 0x08 0x10>;
				};
			};
		};

		fragment@22 {

			__overlay__ {

				qcom_cp_manager {
					io-channels = <0x00 0x08 0x10 0x18 0x20 0x28 0x30 0x38 0x40 0x48 0x50 0x58 0x60 0x68 0x70 0x78 0x80 0x88 0x90 0x98 0xa0 0xa8 0xb0 0xb8 0xc0 0xc8 0xd0 0xd8 0xe0 0xe8 0xf0 0xf8 0x100 0x108 0x110 0x118 0x120 0x128 0x130>;
				};

				cp_qc30 {
					io-channels = <0x00 0x08 0x10 0x18 0x20 0x28 0x30 0x38 0x40 0x48 0x50 0x58 0x60 0x68 0x70 0x78 0x80 0x88 0x90 0x98 0xa0 0xa8 0xb0 0xb8 0xc0 0xc8 0xd0 0xd8 0xe0 0xe8 0xf0 0xf8 0x100 0x108 0x110 0x118 0x120 0x128 0x130 0x138>;
				};
			};
		};

		fragment@23 {

			__overlay__ {

				qcom,smb1355@c {
					pinctrl-0 = <0x00>;

					qcom,smb1355-charger@1000 {
						interrupt-parent = <0x00>;
					};
				};

				qcom,smb1355@8 {

					qcom,smb1355-charger@1000 {
						interrupt-parent = <0x00>;
					};
				};
			};
		};

		fragment@24 {

			__overlay__ {
				extcon = <0x00 0x04>;
			};
		};
	};
};
